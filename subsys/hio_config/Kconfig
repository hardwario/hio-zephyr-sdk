## subsys/hio_config/Kconfig
```kconfig
config HIO_CONFIG
	bool "HIO_CONFIG"
	select HIO_UTIL
	select HIO_SYS
	select CBPRINTF_FP_SUPPORT
	select EVENTS
	select FLASH
	select FLASH_MAP
	select NVS
	select REBOOT
	select SETTINGS
	select SETTINGS_RUNTIME

if HIO_CONFIG


config HIO_CONFIG_INIT_PRIORITY
	int "Initialization priority"
	default 0

config HIO_CONFIG_SETTINGS_PFX
	string "HIO_CONFIG_SETTINGS_PFX"
	default ""

config HIO_CONFIG_SETTINGS_KEY_MAX
	int "Maximum length of settings key (module/item)"
	default 96

config HIO_CONFIG_VALUE_MAX_SIZE
	int "Maximum size of a config item value in bytes"
	default 128
	help
	  Size of the stack buffer used to read a saved item value back from
	  the storage (config diff, config hash and the config upload to the
	  cloud with unsaved changes). Items larger than this make those
	  operations fail with -ENOSPC.

config HIO_CONFIG_SHELL
	bool "HIO_CONFIG_SHELL"
	default y if SHELL

config HIO_CONFIG_ATCI
	bool "HIO_CONFIG_ATCI"
	default y if HIO_ATCI
	select HIO_TOK

config HIO_CONFIG_ATCI_CMD_AUTH_FLAGS
	int "HIO_CONFIG ATCI commands authentication flags"
	depends on HIO_CONFIG_ATCI
	default 1 if HIO_ATCI_LOGIN
	default 0
	help
	  Authentication flags applied to all HIO_CONFIG ATCI commands
	  (&F, &W, $CONFIG). Used to restrict access via the ATCI auth
	  check callback.

module = HIO_CONFIG
module-str = HIO Configuration Subsystem
source "subsys/logging/Kconfig.template.log_config"

endif # HIO_CONFIG
```

## subsys/hio_lte/Kconfig
```kconfig
config HIO_LTE
	bool "HIO_LTE"
	select HIO_CONFIG
	select HIO_BUF
	select HIO_RTC
	select HIO_UTIL
	select AT_MONITOR
	select EVENTS
	select NRF_MODEM_LIB
	select PM_DEVICE
	select POSIX_API
	select REQUIRES_FULL_LIBC
	select RING_BUFFER

if HIO_LTE

config HIO_LTE_DEFAULT_MODE
	string "HIO_LTE_DEFAULT_MODE"
	default "lte-m,nb-iot"

config HIO_LTE_DEFAULT_BANDS
	string "HIO_LTE_DEFAULT_BANDS"
	default ""
	help
		original value: "2,4,5,8,12,13,17,18,19,20,25,26,28,66"

config HIO_LTE_DEFAULT_NETWORK
	string "HIO_LTE_DEFAULT_NETWORK"
	default ""

config HIO_LTE_DEFAULT_APN
	string "HIO_LTE_DEFAULT_APN"
	default ""
	help
		original value: "hardwario"

config HIO_LTE_INIT_PRIORITY
	int "HIO_LTE_INIT_PRIORITY"
	default 99

config HIO_LTE_THREAD_STACK_SIZE
	int "HIO_LTE_THREAD_STACK_SIZE"
	default 4096

config HIO_LTE_NCELLMEAS
	bool "HIO_LTE_NCELLMEAS"
	default n
	help
		Schedule NCELLMEAS (neighbor cell measurement) request on modem enable.

config HIO_LTE_THREAD_PRIORITY
	int "HIO_LTE_THREAD_PRIORITY"
	default 10

config HIO_LTE_CAUSE_STR
	bool "HIO_LTE_CAUSE_STR"
	default y
	help
		Human-readable EMM/ESM cause texts in logs and shell (about 2 kB
		of flash). Without it only the numbers are shown.

config HIO_LTE_CEREG_HISTORY
	int "HIO_LTE_CEREG_HISTORY"
	default 10
	range 1 50
	help
		Registration status changes (CEREG) kept for 'lte history', e.g. to
		see a device hopping between cells or getting rejected.

config HIO_LTE_SCAN_MAX_ENTRIES
	int "HIO_LTE_SCAN_MAX_ENTRIES"
	default 10
	range 1 32
	help
		Networks stored from the last network scan (AT%COPS=?). More are
		counted but not stored.

config HIO_LTE_SCAN_MAX_CELLS
	int "HIO_LTE_SCAN_MAX_CELLS"
	default 14
	range 1 30
	help
		Cells stored from the scan cell searches (up to 7 per access
		technology).

config HIO_LTE_SCAN_AUTO
	bool "HIO_LTE_SCAN_AUTO"
	default y
	help
		Scan networks during the attach retry delay when attach keeps
		failing, so the result is available for diagnostics.

config HIO_LTE_SCAN_AUTO_EVERY
	int "HIO_LTE_SCAN_AUTO_EVERY"
	default 1
	range 1 100
	depends on HIO_LTE_SCAN_AUTO
	help
		Scan on every N-th non-zero attach retry delay, starting with the
		first one.

config HEAP_MEM_POOL_SIZE
	int "HEAP_MEM_POOL_SIZE"
	default 8192


module = HIO_LTE
module-str = HIO LTE Subsystem
source "subsys/logging/Kconfig.template.log_config"

endif # HIO_LTE
```

## subsys/hio_nvs/Kconfig
```kconfig
config HIO_NVS
	bool "HIO_NVS"
	select HIO_SYS
	select CBPRINTF_FP_SUPPORT
	select CRC
	select EVENTS
	select FLASH
	select FLASH_MAP
	select FLASH_PAGE_LAYOUT
	select NVS
	help
	  Persistent runtime data (counters, timestamps, accumulators) stored
	  periodically in a dedicated `hio_nvs_storage` flash partition.

if HIO_NVS

config HIO_NVS_INIT_PRIORITY
	int "Initialization priority"
	default 0

config HIO_NVS_SAVE_INTERVAL
	int "Periodic save interval in seconds"
	default 3600
	range 15 86400

config HIO_NVS_FIRST_SAVE_DELAY
	int "Delay of the first periodic save after boot in seconds"
	default 300
	range 15 86400
	help
	  Protects the flash against excessive writes during a boot loop. The
	  shorter of this and HIO_NVS_SAVE_INTERVAL is used.

config HIO_NVS_SHELL
	bool "HIO_NVS_SHELL"
	default y if SHELL

module = HIO_NVS
module-str = HIO NVS Subsystem
source "subsys/logging/Kconfig.template.log_config"

endif # HIO_NVS
```

## tests/subsys/hio_atci/testcase.yaml
```yaml
tests:
  hio_atci.core:
    platform_allow: native_sim
    integration_platforms:
      - native_sim
    tags: hio hio_atci
  hio_atci.no_log_backend:
    platform_allow: native_sim
    integration_platforms:
      - native_sim
    extra_configs:
      - CONFIG_HIO_ATCI_LOG_BACKEND=n
    tags: hio hio_atci
```

## tests/subsys/hio_cloud_msg/testcase.yaml
```yaml
tests:
  hio_cloud_msg.core:
    platform_allow: native_sim
    integration_platforms:
      - native_sim
    tags: hio hio_cloud
```
