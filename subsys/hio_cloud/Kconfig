## subsys/hio_cloud/Kconfig
```kconfig
config HIO_CLOUD
	bool "HIO_CLOUD"
	select HIO_BUF
	select HIO_INFO
	select HIO_LTE
	select HIO_RTC
	select HIO_SYS
	select EVENTS
	select ZCBOR
	select ZCBOR_STOP_ON_ERROR
	select SHELL
	select SHELL_BACKEND_DUMMY

if HIO_CLOUD

choice HIO_CLOUD_HASH
	prompt "Hash crypto backend"
	default HIO_CLOUD_HASH_TINYCRYPT if ZEPHYR_VERSION_MAJOR < 3
	default HIO_CLOUD_HASH_PSA if ZEPHYR_VERSION_MAJOR >= 3

config HIO_CLOUD_HASH_MBEDTLS
	bool "mbedTLS"
	select NRF_SECURITY
	select MBEDTLS_LEGACY_CRYPTO_C
	select MBEDTLS_SHA256_C
	select MBEDTLS_ENABLE_HEAP

config HIO_CLOUD_HASH_TINYCRYPT
	bool "TinyCrypt"
	select TINYCRYPT
	select TINYCRYPT_SHA256

config HIO_CLOUD_HASH_PSA
	bool "PSA Crypto"
	select NRF_SECURITY
	# With TF-M the PSA crypto API is provided by the secure image
	select MBEDTLS_PSA_CRYPTO_C if !BUILD_WITH_TFM
	select PSA_WANT_ALG_SHA_256

endchoice

config HIO_CLOUD_ATCI
	bool "HIO_CLOUD_ATCI"
	default y if HIO_ATCI
	help
	  Register the AT$CONFIGHASH command.

config HIO_CLOUD_ATCI_CMD_AUTH_FLAGS
	int "HIO_CLOUD ATCI commands authentication flags"
	depends on HIO_CLOUD_ATCI
	default 1 if HIO_ATCI_LOGIN
	default 0
	help
	  Authentication flags applied to the HIO_CLOUD ATCI commands.

config HIO_CLOUD_DEFAULT_ADDR
	string "HIO_CLOUD_DEFAULT_ADDR"
	default "157.245.24.13"
	#default "192.168.192.4"

config HIO_CLOUD_DEFAULT_ADDR2
	string "HIO_CLOUD_DEFAULT_ADDR2"
	default ""

config HIO_CLOUD_DEFAULT_ADDR3
	string "HIO_CLOUD_DEFAULT_ADDR3"
	default ""

config HIO_CLOUD_DEFAULT_FAILOVER
	int "HIO_CLOUD_DEFAULT_FAILOVER"
	default 3

config HIO_CLOUD_DEFAULT_PORT_HASH
	int "HIO_CLOUD_DEFAULT_PORT_HASH"
	default 5002

config HIO_CLOUD_DEFAULT_PORT_DTLS
	int "HIO_CLOUD_PORT_DTLS"
	default 5005

config SHELL_BACKEND_DUMMY_BUF_SIZE
	int "SHELL_BACKEND_DUMMY_BUF_SIZE"
	default 8192
	help
	  Sizes the dummy shell capture buffer used by the cloud dlshell
	  (remote shell) path. Config upload/downlink no longer goes through
	  the dummy shell, so this does not limit the config size.

config HIO_CLOUD_ENCODE_ZCBOR_STATES
	int "Number of zcbor backup states for message encoding"
	default 2
	range 0 32
	help
	  Number of zcbor backup states available to the encoding callback
	  of a data message. Backup states are consumed only by canonical
	  encoding of maps and lists (CONFIG_ZCBOR_CANONICAL), where each
	  level of nesting needs one, and by zcbor_bstr_start_encode().
	  Encoding with indefinite-length maps and lists, as done today,
	  needs none, so the default 2 is just a small reserve.

	  The states are allocated on the stack of the thread calling the
	  send function, not in static RAM: (N + 2) * sizeof(zcbor_state_t),
	  that is 36 bytes per state on 32-bit targets, 144 bytes at the
	  default of 2. Increase the value when sending fails with -ENOMEM
	  (zcbor ran out of backup states: messages nested deeper with
	  canonical encoding or bstr wrapping), decrease it to save stack.

config AT_MONITOR_HEAP_SIZE
	int "AT_MONITOR_HEAP_SIZE"
	default 1024

module = HIO_CLOUD
module-str = HIO CLOUD Subsystem
source "subsys/logging/Kconfig.template.log_config"

endif # HIO_CLOUD
```

## tests/subsys/hio_cloud_transfer/testcase.yaml
```yaml
tests:
  hio_cloud.transfer:
    tags: hio hio_cloud
    platform_allow:
      - native_sim
    integration_platforms:
      - native_sim
```

## tests/subsys/hio_lte_transaction/testcase.yaml
```yaml
tests:
  hio_lte.transaction:
    sysbuild: true
    platform_allow: native_sim
    integration_platforms:
      - native_sim
    tags: hio sysbuild
  # CONFIG_HIO_LTE_NCELLMEAS=y, as in the ksb application
  hio_lte.transaction.ncellmeas:
    sysbuild: true
    extra_args: HIO_LTE_NCELLMEAS=1
    platform_allow: native_sim
    integration_platforms:
      - native_sim
    tags: hio sysbuild
```
