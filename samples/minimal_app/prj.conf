## sample.yaml
```
sample:
  name: HARDWARIO minimal application template
tests:
  sample.hio.minimal_app:
    build_only: true
    platform_allow: nrf9151dk/nrf9151/ns
    integration_platforms:
      - nrf9151dk/nrf9151/ns
    tags: hio
```

## west.yml
```
# Application manifest: the application (not hio-zephyr-sdk) pins NCS.
#
#   west init -l minimal_app && west update
manifest:
  version: "1.2"

  remotes:
    - name: ncs
      url-base: https://github.com/nrfconnect
    - name: hardwario
      url-base: https://github.com/hardwario

  projects:
    - name: sdk-nrf
      remote: ncs
      path: nrf
      revision: v3.4-branch # prefer a fixed tag or SHA for releases
      import: true
    - name: hio-zephyr-sdk
      remote: hardwario
      path: hio-zephyr-sdk
      revision: main

  self:
    path: minimal_app
```

## prj.conf
```kconfig
CONFIG_HIO_DEFAULTS=y
CONFIG_HIO_LOG=y
CONFIG_HIO_SHELL=y

# hio_info needs the VERSION file (app_version.h) next to CMakeLists.txt
CONFIG_HIO_INFO=y

# Enable more subsystems as needed, e.g. CONFIG_HIO_CLOUD=y (see samples/lte_cloud)

# SHA-256 via PSA Crypto (provided by TF-M on _ns targets); the mbedTLS legacy
# backend does not configure on NCS v3.4 and TinyCrypt is not available.
# PSA is the default; set explicitly once the subsystem is enabled:
#CONFIG_HIO_CLOUD_HASH_PSA=y
#CONFIG_HIO_ATCI_LOGIN_HASH_PSA=y

# Minimal TF-M profile frees flash for the non-secure application
CONFIG_TFM_PROFILE_TYPE_MINIMAL=y
```

## src/main.c
```c
/*
 * Copyright (c) 2026 HARDWARIO a.s.
 *
 * SPDX-License-Identifier: LicenseRef-HARDWARIO-5-Clause
 */

/* HIO includes */
#include <hio/hio_info.h>
#include <hio/hio_log.h>

/* Zephyr includes */
#include <zephyr/kernel.h>

LOG_MODULE_REGISTER(main, LOG_LEVEL_DBG);

int main(void)
{
	int ret;
	const char *fw_version;

	ret = hio_info_get_fw_version(&fw_version);
	if (ret) {
		LOG_ERR("Call `hio_info_get_fw_version` failed: %d", ret);
		return ret;
	}

	LOG_INF("Starting application (version: %s)", fw_version);

	for (;;) {
		LOG_INF("Alive, uptime: %lld ms", k_uptime_get());
		k_sleep(K_SECONDS(60));
	}

	return 0;
}
```
