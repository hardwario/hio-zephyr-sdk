## CMakeLists.txt
```
cmake_minimum_required(VERSION 3.20.0)

find_package(Zephyr REQUIRED HINTS $ENV{ZEPHYR_BASE})

project(application)

target_sources(app PRIVATE src/main.c)
```

## prj.conf
```kconfig
CONFIG_HIO_DEFAULTS=y
CONFIG_HIO_LOG=y
CONFIG_HIO_SHELL=y
CONFIG_HIO_INFO=y

CONFIG_HIO_ATCI=y
CONFIG_HIO_ATCI_LOG_LEVEL_DBG=y

CONFIG_IMG_MANAGER=y
CONFIG_MCUBOOT_IMG_MANAGER=y
CONFIG_MCUBOOT_SHELL=y
CONFIG_FLASH=y
CONFIG_FLASH_SHELL=y
CONFIG_FLASH_MAP=y
CONFIG_FLASH_MAP_SHELL=y
CONFIG_FLASH_MAP_LABELS=y
CONFIG_STREAM_FLASH=y
CONFIG_DFU_TARGET=y
CONFIG_DFU_TARGET_STREAM=y
CONFIG_DFU_TARGET_MCUBOOT=y
CONFIG_DFU_TARGET_LOG_LEVEL_DBG=y

# CONFIG_MCUMGR_GRP_IMG=y
# CONFIG_MCUMGR_GRP_OS=y

CONFIG_LTE_LINK_CONTROL=y

CONFIG_HIO_ATCI_CMD_SHELL_AUTH_FLAGS=1
```

## app.overlay
```dts
&uart0 {
	status = "okay";
};


&gpio0 {
	status = "okay";
};

/ {

	atci_uart0: atci_uart0 {
		compatible = "hio,atci-uart";
		status = "okay";
		uart = <&uart0>;
		detect-gpios = <&gpio0 8 (GPIO_ACTIVE_HIGH | GPIO_PULL_DOWN)>;
		// enable-gpios = <&gpio0 0 GPIO_ACTIVE_HIGH>;
		wakeup-source;
	};

	// Sample for UART1 without detect/enable GPIO
	// atci_uart1: atci_uart1 {
	// 	compatible = "hio,atci-uart";
	// 	status = "okay";
	// 	uart = <&uart1>;
	// };

};
```

## src/main.c
```c
/*
 * Copyright (c) 2025 HARDWARIO a.s.
 *
 * SPDX-License-Identifier: LicenseRef-HARDWARIO-5-Clause
 */

#include <hio/hio_atci.h>

#include <zephyr/kernel.h>
#include <zephyr/logging/log.h>

/* nRF includes */
#include <modem/nrf_modem_lib.h>
#include <modem/lte_lc.h>

LOG_MODULE_REGISTER(main, CONFIG_LOG_DEFAULT_LEVEL);

static int at_test_action(const struct hio_atci *atci)
{
	LOG_INF("AT+TEST action");
	hio_atci_printfln(atci, "$TEST: %d", 123);
	return 0;
}

HIO_ATCI_CMD_REGISTER(at_test, "$TEST", 0, at_test_action, NULL, NULL, NULL, "App test function.");

int main(void)
{
	// turn off modem

	int ret = nrf_modem_lib_init();
	if (ret) {
		LOG_ERR("Call `nrf_modem_lib_init` failed: %d", ret);
		return ret;
	}

	while (1) {
		ret = lte_lc_power_off();
		if (ret) {
			LOG_ERR("Call `lte_lc_power_off` failed: %d", ret);
			return ret;
		}

		LOG_INF("uptime: %lld", k_uptime_get());

		hio_atci_broadcastf("$UPTIME: %lld", k_uptime_get());

		k_sleep(K_SECONDS(10));
	}

	return 0;
}
```
