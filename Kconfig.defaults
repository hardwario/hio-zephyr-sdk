## subsys/hio_log/Kconfig
```kconfig
config HIO_LOG
	bool "HIO_LOG"
	select HIO_CONFIG
if HIO_LOG

config HIO_LOG_DBG
    bool "Enable debug logs items"
    default y

config HIO_LOG_INF
    bool "Enable info logs items"
    default y

config HIO_LOG_WRN
    bool "Enable warning logs items"
    default n

config HIO_LOG_ERR
    bool "Enable error logs items"
    default n

config HIO_LOG_DBG_DEFAULT
	string "Default debug log modules"
	default ""

config HIO_LOG_INF_DEFAULT
	string "Default info log modules"
	default ""

config HIO_LOG_WRN_DEFAULT
	string "Default warning log modules"
	default ""

config HIO_LOG_ERR_DEFAULT
	string "Default error log modules"
	default ""

config HIO_LOG_INIT_PRIORITY
	int "Initialization priority"
	default 10
	help
		Initialization priority of the HIO log subsystem. Useful when diffrent modules dynamically change their
		log levels during runtime. But you would like to apply hio_log rules after all modules are initialized.

config HIO_LOG_HELPER_MACRO_INIT_PRIORITY
	int "Initialization priority"
	default 1
	help
		Used in macro for applications to set default priority. Should have lower priority than HIO_LOG_INIT_PRIORITY so that
		hio_log can override log levels after its initialization.


module = HIO_LOG
module-str = HIO log Subsystem
source "subsys/logging/Kconfig.template.log_config"


endif # HIO_LOG
```

## subsys/hio_rtc/Kconfig
```kconfig
config HIO_RTC
	bool "HIO_RTC"
	depends on SHELL
	select EVENTS
	select NRFX_RTC0 if SOC_SERIES_NRF52X || SOC_SERIES_NRF91X
	# nrfx v4.1+ (NCS 3.4) replaced per-instance NRFX_RTCn symbols
	select NRFX_RTC if SOC_SERIES_NRF52 || SOC_SERIES_NRF91
	select NRFX_GRTC if SOC_SERIES_NRF54LX || SOC_SERIES_NRF54L
	select POLL

if HIO_RTC

module = HIO_RTC
module-str = HIO Real-time Clock Subsystem
source "subsys/logging/Kconfig.template.log_config"

config HIO_RTC_INIT_PRIORITY
	int "Initialization priority"
	default 3

endif # HIO_RTC
```

## subsys/hio_sec/Kconfig
```kconfig
config HIO_SEC
	bool "HIO_SEC"
	select HIO_LTE
	select NRF_SECURITY
	select MODEM_KEY_MGMT
	select MBEDTLS_PSA_CRYPTO_C
	select MBEDTLS_PSA_CRYPTO_C
	select MBEDTLS_PSA_CRYPTO_STORAGE_C
	# select PSA_CRYPTO_CLIENT
	# select PSA_WANT_ALG_CTR
	# select PSA_WANT_ALG_ECDSA
	# select PSA_WANT_ALG_ECDH
	# select PSA_WANT_KEY_TYPE_ECC_KEY_PAIR_IMPORT

config HIO_SEC_SAVE
	bool "HIO_SEC_SAVE"
	default n

config HIO_SEC_EXPORT
	bool "HIO_SEC_EXPORT"
	default n
	select PSA_WANT_KEY_TYPE_ECC_KEY_PAIR_EXPORT

config HIO_SEC_TAG_INDEX
	int "HIO_SEC_TAG_INDEX"
	default 1
```

## subsys/hio_sys/Kconfig
```kconfig
config HIO_SYS
	bool "HIO_SYS"
	select HWINFO
	select REBOOT
if HIO_SYS

module = HIO_SYS
module-str = HIO System Subsystem
source "subsys/logging/Kconfig.template.log_config"


endif # HIO_SYS
```

## subsys/hio_therm/Kconfig
```kconfig
#
# Copyright (c) 2023 HARDWARIO a.s.
#
# SPDX-License-Identifier: LicenseRef-HARDWARIO-5-Clause
#

config HIO_THERM
	bool "HIO_THERM"
	select CBPRINTF_FP_SUPPORT if HIO_THERM_LOG_LEVEL_DBG || HIO_THERM_SHELL
	select I2C
	select SENSOR
	select TMP112

if HIO_THERM

module = HIO_THERM
module-str = CHESTER Thermometer Subsystem
source "subsys/logging/Kconfig.template.log_config"

config HIO_THERM_SHELL
	bool "HIO_THERM_SHELL"
	depends on SHELL
	default y

endif # HIO_THERM
```

## subsys/hio_util/Kconfig
```kconfig
#
# Copyright (c) 2023 HARDWARIO a.s.
#
# SPDX-License-Identifier: LicenseRef-HARDWARIO-5-Clause
#

config HIO_UTIL
	bool "HIO_UTIL"
```

## subsys/hio_wdog/Kconfig
```kconfig
#
# Copyright (c) 2023 HARDWARIO a.s.
#
# SPDX-License-Identifier: LicenseRef-HARDWARIO-5-Clause
#

config HIO_WDOG
	bool "HIO_WDOG"
	select WATCHDOG

if HIO_WDOG

module = HIO_WDOG
module-str = HARDWARIO Watchdog Subsystem
source "subsys/logging/Kconfig.template.log_config"

endif # HIO_WDOG
```

## tests/subsys/hio_config/testcase.yaml
```yaml
tests:
  hio_config.core:
    platform_allow: native_posix
    integration_platforms:
      - native_posix
    tags: hio hio_config
```

## tests/subsys/hio_lte/testcase.yaml
```yaml
tests:
  hio_lte.parser:
    sysbuild: true
    platform_allow: native_sim
    integration_platforms:
      - native_sim
    tags: hio sysbuild
```

## west.yml
```yaml
manifest:
  version: "1.2"
  self:
    path: hio-zephyr-sdk
    west-commands: scripts/west-commands.yml
```
