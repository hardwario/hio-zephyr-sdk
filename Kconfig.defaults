## Kconfig.defaults
```kconfig
config HIO_DEFAULTS
	bool "HIO_DEFAULTS"

config IDLE_STACK_SIZE
	default 2048 if HIO_DEFAULTS

config ISR_STACK_SIZE
	default 4096 if HIO_DEFAULTS

config HEAP_MEM_POOL_SIZE
	default 8192 if HIO_DEFAULTS

config MAIN_STACK_SIZE
	default 4096 if HIO_DEFAULTS

config PRIVILEGED_STACK_SIZE
	default 4096 if HIO_DEFAULTS

config SEGGER_RTT_BUFFER_SIZE_DOWN
	default 4096 if HIO_DEFAULTS && CTR_SHELL

config SEGGER_RTT_BUFFER_SIZE_UP
	default 4096 if HIO_DEFAULTS && CTR_SHELL

config SYSTEM_WORKQUEUE_STACK_SIZE
	default 4096 if HIO_DEFAULTS

config IMG_BLOCK_BUF_SIZE
	default 256 if HIO_DEFAULTS

config SERIAL
	default n if HIO_DEFAULTS

config UART_CONSOLE
	default n if HIO_DEFAULTS

config SPI
	default n if HIO_DEFAULTS

config SPI_NOR
	default n if HIO_DEFAULTS

config FLASH
	default n if HIO_DEFAULTS

config FLASH_MAP
	default n if HIO_DEFAULTS
```

## Kconfig.shell
```kconfig
config HIO_SHELL
	bool "HIO_SHELL"
	select REBOOT
	select SHELL
	select SHELL_BACKEND_RTT
	select SHELL_HELP
	select SHELL_HELP_ON_WRONG_ARGUMENT_COUNT
	select SHELL_MINIMAL
	select SHELL_STATS
	select USE_SEGGER_RTT

config CLOCK_CONTROL_NRF_SHELL
	default n if HIO_SHELL

config KERNEL_SHELL
	default y if HIO_SHELL

config SHELL_CMD_BUFF_SIZE
	default 512 if HIO_SHELL

config SHELL_BACKEND_DUMMY_BUF_SIZE
	default 4096 if HIO_SHELL

config SHELL_CMD_BUFF_SIZE
	default 256 if HIO_SHELL

config SHELL_ECHO_STATUS
	default n if HIO_SHELL

config SHELL_LOG_BACKEND
	default y if HIO_SHELL

config SHELL_PROMPT_RTT
	default "" if HIO_SHELL

config SHELL_RTT_RX_POLL_PERIOD
	default 200 if HIO_SHELL

config SEGGER_RTT_BUFFER_SIZE_DOWN
	default 256 if HIO_SHELL

config SHELL_STACK_SIZE
	default 4096 if HIO_SHELL

config SHELL_VT100_COMMANDS
	default n if HIO_SHELL
```

## dts/bindings/hio/hio,atci-uart.yaml
```yaml
# hio,atci-uart.yaml
compatible: "hio,atci-uart"
include: base.yaml

description: HIO ATCI UART backend node that references an existing UART device.

properties:
  uart:
    type: phandle
    required: true
    description: Reference to the UART device used by the ATCI backend

  detect-gpios:
    type: phandle-array
    required: false
    description: Optional GPIO input for detecting external enable signal (e.g. USB detect)

  enable-gpios:
    type: phandle-array
    required: false
    description: Optional GPIO output to enable/disable hardware (e.g. USB-UART bridge power)
```

## lib/hio_tok/Kconfig
```kconfig
#
# Copyright (c) 2025 HARDWARIO a.s.
#
# SPDX-License-Identifier: LicenseRef-HARDWARIO-5-Clause
#

config HIO_TOK
	bool "HIO_TOK"
	default y
	select REQUIRES_FULL_LIBC
```

## subsys/Kconfig
```kconfig
menu "Subsystems"

rsource "hio_buf/Kconfig"
rsource "hio_config/Kconfig"
rsource "hio_lte/Kconfig"
rsource "hio_rtc/Kconfig"
rsource "hio_util/Kconfig"
rsource "hio_adc/Kconfig"
rsource "hio_edge/Kconfig"
rsource "hio_button/Kconfig"
rsource "hio_therm/Kconfig"
rsource "hio_accel/Kconfig"
rsource "hio_wdog/Kconfig"

endmenu
```

## subsys/hio_accel/Kconfig
```kconfig
#
# Copyright (c) 2023 HARDWARIO a.s.
#
# SPDX-License-Identifier: LicenseRef-HARDWARIO-5-Clause
#

config HIO_ACCEL
	bool "HIO_ACCEL"
	select CBPRINTF_FP_SUPPORT if HIO_ACCEL_LOG_LEVEL_DBG || HIO_ACCEL_SHELL
	select I2C
	select LIS2DH
	select REQUIRES_FULL_LIBC
	select SENSOR

if HIO_ACCEL

module = HIO_ACCEL
module-str = CHESTER Accelerometer Subsystem
source "subsys/logging/Kconfig.template.log_config"

config HIO_ACCEL_SHELL
	bool "HIO_ACCEL_SHELL"
	depends on SHELL
	default y

choice LIS2DH_ACCEL_RANGE
	default LIS2DH_ACCEL_RANGE_4G
endchoice

config LIS2DH_BLOCK_DATA_UPDATE
	default y

choice LIS2DH_ODR
	default LIS2DH_ODR_2
endchoice

choice LIS2DH_TRIGGER_MODE
	default LIS2DH_TRIGGER_GLOBAL_THREAD
endchoice

endif # HIO_ACCEL
```

## subsys/hio_adc/Kconfig
```kconfig
#
# Copyright (c) 2023 HARDWARIO a.s.
#
# SPDX-License-Identifier: LicenseRef-HARDWARIO-5-Clause
#

config HIO_ADC
	bool "HIO_ADC"
	select ADC

if HIO_ADC

module = HIO_ADC
module-str = HARDWARIO ADC Subsystem
source "subsys/logging/Kconfig.template.log_config"

endif # HIO_ADC
```

## subsys/hio_atci/Kconfig
```kconfig
#
# Copyright (c) 2025 HARDWARIO a.s.
#
# SPDX-License-Identifier: LicenseRef-HARDWARIO-5-Clause
#

config HIO_ATCI
	bool "HIO_ATCI"
	select CRC

if HIO_ATCI

rsource "backends/Kconfig.backends"

config HIO_ATCI_STACK_SIZE
	int "ATCI thread stack size"
	default 2048 if MULTITHREADING
	default 0 if !MULTITHREADING
	help
	  Stack size for thread created for each instance.

config HIO_ATCI_CMD_SHELL
	bool "ATCI command shell"
	default y if SHELL
	select SHELL_BACKEND_DUMMY

config HIO_ATCI_CMD_SHELL_AUTH_FLAGS
	int "ATCI command shell authentication flags"
	default 1 if HIO_ATCI_LOGIN
	default 0

config HIO_ATCI_CMD_REBOOT
	bool "ATCI command reboot"
	default y
	select HIO_SYS
	help
	  Enable ATCI command for rebooting the device.

config HIO_ATCI_CMD_REBOOT_AUTH_FLAGS
	int "ATCI command reboot authentication flags"
	default 1 if HIO_ATCI_LOGIN
	default 0
	help
	  Authentication flags for ATCI command reboot.
	  It is used to restrict access to the reboot command.

config HIO_ATCI_LOGIN
	bool "ATCI login authentication"
	select HIO_CONFIG
	help
	  Enable ATCI login authentication. Registers a hio_config module with
	  a "passphrase-hash" item (SHA-256 hash hex string), the
	  AT$LOGIN/AT$LOGOUT commands, and an ATCI auth-check callback that
	  gates commands with non-zero auth flags behind an authenticated
	  session.

config HIO_ATCI_LOGIN_DEFAULT_PASSPHRASE_HASH
	string "Default passphrase hash (SHA-256 hex)"
	depends on HIO_ATCI_LOGIN
	default ""
	help
	  Compile-time default for the "passphrase-hash" config item: a SHA-256
	  hash of the passphrase as a 64-character lowercase hex string. When a
	  device has no stored passphrase, this value is used.

	  Intended for development builds (a known passphrase baked into the
	  firmware). Leave empty for production and provision the hash at
	  runtime via the shell or ATCI. A passphrase set at runtime overrides
	  this default.

	  Example (passphrase "hardwario"):
	    printf '%s' hardwario | sha256sum

config HIO_ATCI_LOGIN_BOOT_DELAY
	int "Login boot delay (seconds)"
	depends on HIO_ATCI_LOGIN
	default 5
	help
	  Authentication attempts are rejected for this many seconds after
	  boot. Prevents brute-force attacks combined with device resets.

config HIO_ATCI_LOGIN_MAX_ATTEMPTS
	int "Failed login attempts before cooldown"
	depends on HIO_ATCI_LOGIN
	default 5
	help
	  Number of consecutive failed authentication attempts after which
	  the login cooldown is activated.

config HIO_ATCI_LOGIN_COOLDOWN
	int "Login cooldown duration (seconds)"
	depends on HIO_ATCI_LOGIN
	default 300
	help
	  Authentication attempts are rejected for this many seconds after
	  too many consecutive failed attempts.

config HIO_ATCI_LOGIN_INIT_PRIORITY
	int "ATCI login init priority"
	depends on HIO_ATCI_LOGIN
	default 99
	help
	  Initialization priority for registering the ATCI login configuration
	  module. Must run after the HIO_CONFIG subsystem is initialized.

choice HIO_ATCI_LOGIN_HASH
	prompt "Login password hash backend"
	depends on HIO_ATCI_LOGIN
	default HIO_ATCI_LOGIN_HASH_MBEDTLS

config HIO_ATCI_LOGIN_HASH_MBEDTLS
	bool "mbedTLS"
	select NRF_SECURITY
	select MBEDTLS_LEGACY_CRYPTO_C
	select MBEDTLS_SHA256_C
	select MBEDTLS_ENABLE_HEAP

config HIO_ATCI_LOGIN_HASH_TINYCRYPT
	bool "TinyCrypt"
	select TINYCRYPT
	select TINYCRYPT_SHA256

config HIO_ATCI_LOGIN_HASH_PSA
	bool "PSA Crypto"
	select NRF_SECURITY
	# With TF-M the PSA crypto API is provided by the secure image
	select MBEDTLS_PSA_CRYPTO_C if !BUILD_WITH_TFM
	select PSA_WANT_ALG_SHA_256

endchoice

config HIO_ATCI_CMD_BUFF_SIZE
	int "ATCI command buffer size"
	default 256
	help
	  Maximum command size in bytes. One byte is reserved for the string
	  terminator character.

config HIO_ATCI_PRINTF_BUFF_SIZE
	int "ATCI print buffer size"
	default 30
	help
	  Maximum text buffer size for fprintf function.
	  It is working like stdio buffering in Linux systems
	  to limit number of peripheral access calls.

config HIO_ATCI_URC_BUFF_SIZE
	int "ATCI deferred URC buffer size"
	default 128
	help
	  Buffer used to defer URC (broadcast) messages emitted while a command
	  is being processed on the same instance. Deferred messages are
	  flushed right after the command response is finished. Messages that
	  do not fit into the buffer are dropped.

choice
	prompt "ATCI CRC mode"
	default HIO_ATCI_CRC_MODE_OPTIONAL

config HIO_ATCI_CRC_MODE_DISABLED
	bool "Disabled"
	help
	  CRC is not used at all.

config HIO_ATCI_CRC_MODE_STRICT
	bool "Strict"
	help
	  CRC must be present and valid. Otherwise, the command is rejected.

config HIO_ATCI_CRC_MODE_OPTIONAL
	bool "Optional"
	help
	  CRC is verified if present. If not present, the command is accepted.
endchoice

config HIO_ATCI_CRC_MODE
	int "ATCI CRC mode"
	default 0 if HIO_ATCI_CRC_MODE_DISABLED
	default 1 if HIO_ATCI_CRC_MODE_STRICT
	default 2 if HIO_ATCI_CRC_MODE_OPTIONAL

config HIO_ATCI_LOG_BACKEND
	bool "ATCI log backend"
	select LOG_OUTPUT
	default y if LOG

config HIO_ATCI_LOG_FORMAT_TIMESTAMP
	bool "Format timestamp"
	default y
	help
	  Enable timestamp formatting.

config HIO_ATCI_MODEM_TRACE
	bool "Modem trace output"
	default n
	select NRF_MODEM_LIB_TRACE
	select BASE64

choice NRF_MODEM_LIB_TRACE_BACKEND
    prompt "Modem trace backend"
    default NRF_MODEM_LIB_TRACE_BACKEND_RAM if HIO_ATCI_MODEM_TRACE
endchoice

config HIO_ATCI_CMD_FW
	bool "HIO ATCI DFU"
	default y if DFU_TARGET_MCUBOOT && MCUBOOT_IMG_MANAGER
	help
	  Enable HIO ATCI DFU support.

config HIO_ATCI_CMD_FW_AUTH_FLAGS
	int "HIO ATCI DFU authentication flags"
	default 1 if HIO_ATCI_LOGIN
	default 0
	help
	  Authentication flags for HIO ATCI DFU command.
	  It is used to restrict access to the DFU command.

module = HIO_ATCI
module-str = HIO ATCI Subsystem
source "subsys/logging/Kconfig.template.log_config"

endif # HIO_ATCI
```

## subsys/hio_atci/backends/Kconfig.backends
```kconfig
#
# Copyright (c) 2025 HARDWARIO a.s.
#
# SPDX-License-Identifier: LicenseRef-HARDWARIO-5-Clause
#

config HIO_ATCI_BACKEND_UART
	bool "Serial backend"
	# Serial (UART) requires interrupts and the RTT backend cannot be used from an ISR context.
	default y
	select SERIAL
	select UART_ASYNC_API
	select UART_ASYNC_RX_HELPER
	select RING_BUFFER
	select EVENTS
	select PM_DEVICE
	select GPIO
	help
	  Enable serial backend.

if HIO_ATCI_BACKEND_UART

config HIO_ATCI_BACKEND_INIT_PRIORITY
	int "HIO_ATCI_BACKEND_INIT_PRIORITY"
	default APPLICATION_INIT_PRIORITY
	range 0 99
	help
	  Initialization priority for UART backend. This must be bigger than
	  the initialization priority of the used serial device.

config HIO_ATCI_BACKEND_UART_ASYNC_RX_TIMEOUT
	int "RX inactivity timeout (in microseconds)"
	default 10000
	help
	  Inactivity timeout after which received data is reported.

config HIO_ATCI_BACKEND_UART_ASYNC_RX_BUFFER_COUNT
	int "Number of RX buffers"
	default 4
	range 2 64
	help
	  Number of RX buffers. Some UART driver implementations changes buffers
	  on timeout so this number should be big enough to cover handling on
	  time incoming data. 4 should be enough for almost all the cases unless
	  CPU load is high and there is very high atci thread latency.

config HIO_ATCI_BACKEND_UART_ASYNC_RX_BUFFER_SIZE
	int "Size of the RX buffer"
	default 16
	help
	  Size of a single RX buffer. Together with buffer count it defines the
	  space that can hold RX data. It may be decreased if atci input is
	  slow and may need to be increased if long messages are pasted directly
	  to the atci prompt.

endif # HIO_ATCI_BACKEND_UART
```

## subsys/hio_buf/Kconfig
```kconfig
config HIO_BUF
	bool "HIO_BUF"

if HIO_BUF

module = HIO_BUF
module-str = HIO BUF Subsystem
source "subsys/logging/Kconfig.template.log_config"

endif # HIO_BUF
```

## subsys/hio_button/Kconfig
```kconfig
#
# Copyright (c) 2023 HARDWARIO a.s.
#
# SPDX-License-Identifier: LicenseRef-HARDWARIO-5-Clause
#

config HIO_BUTTON
	bool "HIO_BUTTON"
	depends on SHELL
	select GPIO
	select HIO_EDGE

if HIO_BUTTON

module = HIO_BUTTON
module-str = HARDWARIO Button Subsystem
source "subsys/logging/Kconfig.template.log_config"

config HIO_BUTTON_INIT_PRIORITY
	int "Initialization priority"
	default APPLICATION_INIT_PRIORITY

endif # HIO_BUTTON
```

## subsys/hio_cloud/Kconfig
```kconfig
config HIO_CLOUD
	bool "HIO_CLOUD"
	select HIO_BUF
	select HIO_INFO
	select HIO_LTE
	select HIO_RTC
	select HIO_SYS
	select EVENTS
	select ZCBOR
	select ZCBOR_STOP_ON_ERROR
	select SHELL
	select SHELL_BACKEND_DUMMY

if HIO_CLOUD

choice HIO_CLOUD_HASH
	prompt "Hash crypto backend"
	default HIO_CLOUD_HASH_TINYCRYPT if ZEPHYR_VERSION_MAJOR < 3
	default HIO_CLOUD_HASH_MBEDTLS if ZEPHYR_VERSION_MAJOR >= 3

config HIO_CLOUD_HASH_MBEDTLS
	bool "mbedTLS"
	select NRF_SECURITY
	select MBEDTLS_LEGACY_CRYPTO_C
	select MBEDTLS_SHA256_C
	select MBEDTLS_ENABLE_HEAP

config HIO_CLOUD_HASH_TINYCRYPT
	bool "TinyCrypt"
	select TINYCRYPT
	select TINYCRYPT_SHA256

config HIO_CLOUD_HASH_PSA
	bool "PSA Crypto"
	select NRF_SECURITY
	select MBEDTLS_PSA_CRYPTO_C
	select PSA_WANT_ALG_SHA_256

endchoice

config HIO_CLOUD_DEFAULT_ADDR
	string "HIO_CLOUD_DEFAULT_ADDR"
	default "157.245.24.13"
	#default "192.168.192.4"

config HIO_CLOUD_DEFAULT_PORT_HASH
	int "HIO_CLOUD_DEFAULT_PORT_HASH"
	default 5002

config HIO_CLOUD_DEFAULT_PORT_DTLS
	int "HIO_CLOUD_PORT_DTLS"
	default 5005

config SHELL_BACKEND_DUMMY_BUF_SIZE
	int "SHELL_BACKEND_DUMMY_BUF_SIZE"
	default 8192

config AT_MONITOR_HEAP_SIZE
	int "AT_MONITOR_HEAP_SIZE"
	default 1024

module = HIO_CLOUD
module-str = HIO CLOUD Subsystem
source "subsys/logging/Kconfig.template.log_config"

endif # HIO_CLOUD
```

## subsys/hio_edge/Kconfig
```kconfig
#
# Copyright (c) 2023 HARDWARIO a.s.
#
# SPDX-License-Identifier: LicenseRef-HARDWARIO-5-Clause
#

config HIO_EDGE
	bool "HIO_EDGE"
	depends on GPIO

if HIO_EDGE

module = HIO_EDGE
module-str = HARDWARIO Edge Filtering Subsystem
source "subsys/logging/Kconfig.template.log_config"

endif # HIO_EDGE
```

## subsys/hio_info/Kconfig
```kconfig
#
# Copyright (c) 2025 HARDWARIO a.s.
#
# SPDX-License-Identifier: LicenseRef-HARDWARIO-5-Clause
#

config HIO_INFO
	bool "HIO_INFO"
	select CRC

if HIO_INFO

config HIO_INFO_SHELL
	bool "HIO_INFO_SHELL"
	default y if SHELL

config HIO_INFO_SHELL_BLE
	bool "HIO_INFO_SHELL_BLE"
	default y if SOC_SERIES_NRF52X

config HIO_INFO_BLE
	bool "HIO_INFO_BLE"
	default y if BT && SOC_SERIES_NRF52X

config HIO_INFO_INIT_PRIORITY
	int "Initialization priority"
	default 0

module = HIO_INFO
module-str = Firmware Information Subsystem
source "subsys/logging/Kconfig.template.log_config"

endif # HIO_INFO
```
