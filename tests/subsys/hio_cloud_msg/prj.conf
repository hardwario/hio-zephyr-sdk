## CMakeLists.txt
```
#
# Copyright (c) 2026 HARDWARIO a.s.
#
# SPDX-License-Identifier: LicenseRef-HARDWARIO-5-Clause
#

cmake_minimum_required(VERSION 3.20.0)

find_package(Zephyr REQUIRED HINTS $ENV{ZEPHYR_BASE})

project(test)

add_compile_definitions(CONFIG_HIO_CLOUD_LOG_LEVEL=3)
add_compile_definitions(CONFIG_HIO_CLOUD_HASH_PSA=1)
add_compile_definitions(CONFIG_HIO_LTE_SCAN_MAX_ENTRIES=10)
add_compile_definitions(CONFIG_HIO_LTE_SCAN_MAX_CELLS=14)
add_compile_definitions(CONFIG_HIO_CONFIG_LOG_LEVEL=3)
add_compile_definitions(CONFIG_HIO_CONFIG_INIT_PRIORITY=0)
add_compile_definitions(CONFIG_HIO_CONFIG_SETTINGS_PFX="")
add_compile_definitions(CONFIG_HIO_CONFIG_SETTINGS_KEY_MAX=96)
add_compile_definitions(CONFIG_HIO_CONFIG_VALUE_MAX_SIZE=128)

set(HIO_CLOUD_DIR ${CMAKE_CURRENT_SOURCE_DIR}/../../../subsys/hio_cloud)
set(HIO_CONFIG_DIR ${CMAKE_CURRENT_SOURCE_DIR}/../../../subsys/hio_config)

include_directories(${HIO_CLOUD_DIR})
include_directories(${HIO_CONFIG_DIR})
target_sources(app PRIVATE ${HIO_CLOUD_DIR}/hio_cloud_msg.c)
target_sources(app PRIVATE ${HIO_CLOUD_DIR}/hio_cloud_util.c)
target_sources(app PRIVATE ${HIO_CONFIG_DIR}/hio_config.c)
target_sources(app PRIVATE ${HIO_CONFIG_DIR}/hio_config_shell.c)
target_sources(app PRIVATE src/stubs.c)
target_sources(app PRIVATE ../hio_config/src/ram_store.c)
include_directories(../hio_config/src)
target_sources(app PRIVATE src/test_module.c)
target_sources(app PRIVATE src/test_config_hash.c)
target_sources(app PRIVATE src/test_hash.c)
target_sources(app PRIVATE src/test_pack_config.c)
target_sources(app PRIVATE src/test_dlconfig.c)
```

## prj.conf
```kconfig
CONFIG_ZTEST=y
CONFIG_MAIN_STACK_SIZE=16384

CONFIG_LOG=y

CONFIG_REQUIRES_FULL_LIBC=y
CONFIG_CBPRINTF_FP_SUPPORT=y

# hio_config deps (manual compile).
CONFIG_EVENTS=y
CONFIG_REBOOT=y
CONFIG_HIO_UTIL=y
CONFIG_SETTINGS=y
CONFIG_SETTINGS_NONE=y
CONFIG_SETTINGS_RUNTIME=y

# hio_cloud_msg deps: buffers, CBOR, SHA-256 via PSA Crypto (Zephyr mbedTLS;
# CONFIG_HIO_CLOUD_HASH_PSA is defined in CMakeLists.txt for manual compile).
CONFIG_HIO_BUF=y
CONFIG_ZCBOR=y
CONFIG_ZCBOR_STOP_ON_ERROR=y
CONFIG_PSA_CRYPTO=y
CONFIG_MBEDTLS=y
CONFIG_MBEDTLS_PSA_CRYPTO_C=y
CONFIG_PSA_WANT_ALG_SHA_256=y
CONFIG_ENTROPY_GENERATOR=y

# Dummy shell: oracle for the pack_config parity test. Shell log backend off
# so deferred log flushes cannot pollute the dummy capture.
CONFIG_SHELL=y
CONFIG_SHELL_BACKEND_DUMMY=y
CONFIG_SHELL_BACKEND_DUMMY_BUF_SIZE=16384
CONFIG_SHELL_LOG_BACKEND=n
```

## src/stubs.c
```c
/*
 * Copyright (c) 2026 HARDWARIO a.s.
 *
 * SPDX-License-Identifier: LicenseRef-HARDWARIO-5-Clause
 */

/* Link stubs for hio_cloud_msg.c / hio_config.c externals not exercised by
 * these tests. */

#include <hio/hio_info.h>
#include <hio/hio_lte.h>
#include <hio/hio_sys.h>

#include <zephyr/sys/__assert.h>

#include <string.h>

void hio_sys_reboot(const char *reason)
{
	__ASSERT(false, "unexpected reboot: %s", reason);
}

int hio_info_get_vendor_name(const char **vendor_name)
{
	*vendor_name = "TEST";
	return 0;
}

int hio_info_get_product_name(const char **product_name)
{
	*product_name = "TEST";
	return 0;
}

int hio_info_get_hw_variant(const char **hw_variant)
{
	*hw_variant = "TEST";
	return 0;
}

int hio_info_get_hw_revision(const char **hw_revision)
{
	*hw_revision = "TEST";
	return 0;
}

int hio_info_get_fw_bundle(const char **fw_bundle)
{
	*fw_bundle = "TEST";
	return 0;
}

int hio_info_get_fw_name(const char **fw_name)
{
	*fw_name = "TEST";
	return 0;
}

int hio_info_get_fw_version(const char **fw_version)
{
	*fw_version = "TEST";
	return 0;
}

int hio_info_get_serial_number_uint32(uint32_t *serial_number)
{
	*serial_number = 0;
	return 0;
}

int hio_lte_get_imei(uint64_t *imei)
{
	*imei = 0;
	return 0;
}

int hio_lte_get_imsi(uint64_t *imsi)
{
	*imsi = 0;
	return 0;
}

int hio_lte_get_iccid(char **iccid)
{
	*iccid = "0";
	return 0;
}

int hio_lte_get_conn_param(struct hio_lte_conn_param *param)
{
	memset(param, 0, sizeof(*param));
	return 0;
}
```

## src/test_config_hash.c
```c
/*
 * Copyright (c) 2026 HARDWARIO a.s.
 *
 * SPDX-License-Identifier: LicenseRef-HARDWARIO-5-Clause
 */

#include "hio_cloud_msg.h"
#include "ram_store.h"
#include "test_module.h"

#include <hio/hio_buf.h>
#include <hio/hio_config.h>

#include <zephyr/ztest.h>

#include <string.h>

/* Suites run in alphabetical order, so this one runs before
 * hio_cloud_pack_config registers its "big" module with items larger than
 * CONFIG_HIO_CONFIG_VALUE_MAX_SIZE. */
static void *suite_setup(void)
{
	zassert_ok(test_module_register(), "test module registration failed");
	ram_store_register();
	return NULL;
}

static void before_each(void *fixture)
{
	ARG_UNUSED(fixture);
	ram_store_clear();
	test_module_set_defaults();
	zassert_ok(hio_config_save_without_reboot());
}

ZTEST_SUITE(hio_cloud_config_hash, NULL, suite_setup, before_each, NULL, NULL);

static int set(const char *name, const char *value)
{
	const struct hio_config_item *item;
	const char *err_msg = NULL;
	char buf[64];

	zassert_ok(hio_config_module_find_item(&g_test_module, name, &item));
	strcpy(buf, value);
	return hio_config_module_item_set_value(&g_test_module, item, buf, &err_msg);
}

static uint64_t upload_hash(void)
{
	HIO_BUF_DEFINE(buf, 4096);
	uint64_t hash;

	zassert_ok(hio_cloud_msg_pack_config(&buf));
	zassert_ok(hio_cloud_msg_get_hash(&buf, &hash));

	return hash;
}

ZTEST(hio_cloud_config_hash, test_hash_matches_upload)
{
	uint64_t hash;

	zassert_ok(hio_cloud_msg_config_hash(&hash));
	zassert_equal(hash, upload_hash());

	zassert_ok(set("apn", "other"));
	zassert_ok(hio_cloud_msg_config_hash(&hash));
	zassert_equal(hash, upload_hash());
}

ZTEST(hio_cloud_config_hash, test_upload_skips_unsaved)
{
	uint64_t before = upload_hash();
	uint64_t hash;

	/* Unsaved change: neither the upload nor the hash moves */
	zassert_ok(set("interval", "120"));
	zassert_equal(upload_hash(), before);
	zassert_ok(hio_cloud_msg_config_hash(&hash));
	zassert_equal(hash, before);

	/* After the save both carry the new value */
	zassert_ok(hio_config_save_without_reboot());
	zassert_ok(hio_cloud_msg_config_hash(&hash));
	zassert_not_equal(hash, before);
	zassert_equal(hash, upload_hash());
}
```

## src/test_dlconfig.c
```c
/*
 * Copyright (c) 2026 HARDWARIO a.s.
 *
 * SPDX-License-Identifier: LicenseRef-HARDWARIO-5-Clause
 */

#include "hio_cloud_msg.h"
#include "test_module.h"

#include <hio/hio_buf.h>
#include <hio/hio_config.h>

#include <zephyr/ztest.h>

#include <zcbor_common.h>
#include <zcbor_encode.h>

#include <string.h>

/* Suites run in alphabetical order and this one runs first in the binary;
 * register the module here (test_module_register is idempotent). */
static void *suite_setup(void)
{
	zassert_ok(test_module_register(), "test module registration failed");
	return NULL;
}

static void before_each(void *fixture)
{
	ARG_UNUSED(fixture);
	test_module_set_defaults();
}

ZTEST_SUITE(hio_cloud_dlconfig, NULL, suite_setup, before_each, NULL, NULL);

/* Build a DL_DOWNLOAD_CONFIG message: [0x82][0x00][CBOR list of tstr]. */
static void build_dlconfig(struct hio_buf *buf, const char **lines, int count)
{
	hio_buf_reset(buf);
	zassert_ok(hio_buf_append_u8(buf, DL_DOWNLOAD_CONFIG));
	zassert_ok(hio_buf_append_u8(buf, 0x00));

	uint8_t *p = hio_buf_get_mem(buf) + 2;

	ZCBOR_STATE_E(zs, 0, p, hio_buf_get_free(buf), 1);
	zassert_true(zcbor_list_start_encode(zs, ZCBOR_VALUE_IS_INDEFINITE_LENGTH));
	for (int i = 0; i < count; i++) {
		zassert_true(zcbor_tstr_put_term(zs, lines[i], strlen(lines[i])));
	}
	zassert_true(zcbor_list_end_encode(zs, ZCBOR_VALUE_IS_INDEFINITE_LENGTH));

	zassert_ok(hio_buf_seek(buf, 2 + (zs->payload - p)));
}

static int apply_dlconfig(struct hio_buf *buf)
{
	struct hio_cloud_msg_dlconfig config;

	int ret = hio_cloud_msg_unpack_config(buf, &config);
	if (ret) {
		return ret;
	}

	HIO_BUF_DEFINE(line, 512);

	/* Mirrors the production loop in hio_cloud_process_dlconfig: count
	 * applied (non-empty) lines, not consumed CBOR entries — get_next_line
	 * consumes entries sequentially including empty ones. */
	for (int i = 0; i < config.lines;) {
		hio_buf_reset(&line);

		ret = hio_cloud_msg_dlconfig_get_next_line(&config, &line);
		if (ret) {
			return ret;
		}

		char *cmd = (char *)hio_buf_get_mem(&line);

		if (cmd[0] == '\0') {
			continue; /* does not count toward config.lines */
		}

		const char *err_msg = NULL;

		ret = hio_config_parse_line(cmd, &err_msg);
		if (ret) {
			return ret;
		}

		i++;
	}

	return 0;
}

ZTEST(hio_cloud_dlconfig, test_apply_lines_all_types)
{
	static const char *lines[] = {
		"app config interval 300",    "app config threshold 9.75",
		"app config enabled false",   "app config mode \"fast\"",
		"app config apn \"new apn\"", "app config key 0102030405060708",
	};

	HIO_BUF_DEFINE(buf, 1024);
	build_dlconfig(&buf, lines, ARRAY_SIZE(lines));

	zassert_ok(apply_dlconfig(&buf));

	static const uint8_t expected_key[8] = {0x01, 0x02, 0x03, 0x04, 0x05, 0x06, 0x07, 0x08};

	zassert_equal(g_test_config_interim.interval, 300);
	zassert_within(g_test_config_interim.threshold, 9.75f, 0.001f);
	zassert_false(g_test_config_interim.enabled);
	zassert_equal(g_test_config_interim.mode, TEST_MODE_FAST);
	zassert_str_equal(g_test_config_interim.apn, "new apn");
	zassert_mem_equal(g_test_config_interim.key, expected_key, 8);
}

ZTEST(hio_cloud_dlconfig, test_first_error_aborts)
{
	static const char *lines[] = {
		"app config interval 300",
		"app config nonexistent 1",
		"app config enabled false",
	};

	HIO_BUF_DEFINE(buf, 1024);
	build_dlconfig(&buf, lines, ARRAY_SIZE(lines));

	zassert_true(apply_dlconfig(&buf) < 0);

	/* First line applied, third line NOT applied (abort after error). */
	zassert_equal(g_test_config_interim.interval, 300);
	zassert_true(g_test_config_interim.enabled);
}

ZTEST(hio_cloud_dlconfig, test_empty_line_mid_stream)
{
	/* build_dlconfig's count feeds 3 zcbor entries, but unpack_config
	 * only counts the 2 non-empty ones into config.lines. The line
	 * after the empty entry must still be consumed and applied. */
	static const char *lines[] = {
		"app config interval 300",
		"",
		"app config enabled false",
	};

	HIO_BUF_DEFINE(buf, 1024);
	build_dlconfig(&buf, lines, ARRAY_SIZE(lines));

	zassert_ok(apply_dlconfig(&buf));

	zassert_equal(g_test_config_interim.interval, 300);
	zassert_false(g_test_config_interim.enabled);
}

ZTEST(hio_cloud_dlconfig, test_read_only_rejected)
{
	static const char *lines[] = {"app config rovalue 7"};

	HIO_BUF_DEFINE(buf, 1024);
	build_dlconfig(&buf, lines, ARRAY_SIZE(lines));

	zassert_equal(apply_dlconfig(&buf), -EPERM);
	zassert_equal(g_test_config_interim.rovalue, 42);
}
```

## src/test_hash.c
```c
/*
 * Copyright (c) 2026 HARDWARIO a.s.
 *
 * SPDX-License-Identifier: LicenseRef-HARDWARIO-5-Clause
 */

#include "hio_cloud_util.h"

#include <zephyr/ztest.h>

#include <string.h>

ZTEST_SUITE(hio_cloud_hash, NULL, NULL, NULL, NULL, NULL);

ZTEST(hio_cloud_hash, test_incremental_matches_oneshot)
{
	static const char data[] = "The quick brown fox jumps over the lazy dog";

	uint8_t oneshot[8];
	zassert_ok(hio_cloud_calculate_hash(oneshot, (const uint8_t *)data, strlen(data), NULL,
					    0));

	struct hio_cloud_hash h;
	uint8_t incremental[8];

	zassert_ok(hio_cloud_hash_begin(&h));
	/* Feed in uneven chunks to exercise streaming. */
	zassert_ok(hio_cloud_hash_update(&h, data, 7));
	zassert_ok(hio_cloud_hash_update(&h, data + 7, 1));
	zassert_ok(hio_cloud_hash_update(&h, data + 8, strlen(data) - 8));
	zassert_ok(hio_cloud_hash_finish(&h, incremental));

	zassert_mem_equal(oneshot, incremental, 8);
}

ZTEST(hio_cloud_hash, test_two_buffer_oneshot_matches_incremental)
{
	static const char part1[] = "0123456789abcdef";
	static const char part2[] = "ghijklmnop";

	uint8_t oneshot[8];
	zassert_ok(hio_cloud_calculate_hash(oneshot, (const uint8_t *)part1, strlen(part1),
					    (const uint8_t *)part2, strlen(part2)));

	struct hio_cloud_hash h;
	uint8_t incremental[8];

	zassert_ok(hio_cloud_hash_begin(&h));
	zassert_ok(hio_cloud_hash_update(&h, part1, strlen(part1)));
	zassert_ok(hio_cloud_hash_update(&h, part2, strlen(part2)));
	zassert_ok(hio_cloud_hash_finish(&h, incremental));

	zassert_mem_equal(oneshot, incremental, 8);
}
```

## src/test_module.h
```c
/*
 * Copyright (c) 2026 HARDWARIO a.s.
 *
 * SPDX-License-Identifier: LicenseRef-HARDWARIO-5-Clause
 */

#ifndef TEST_MODULE_H_
#define TEST_MODULE_H_

#include <hio/hio_config.h>

enum test_mode {
	TEST_MODE_OFF = 0,
	TEST_MODE_SLOW = 1,
	TEST_MODE_FAST = 2,
};

struct test_config {
	int interval;
	float threshold;
	bool enabled;
	enum test_mode mode;
	char apn[32];
	uint8_t key[8];
	char secret[16];
	int rovalue;
};

extern struct test_config g_test_config_interim;
extern struct hio_config g_test_module;

int test_module_register(void);
void test_module_set_defaults(void);

#endif /* TEST_MODULE_H_ */
```

## src/test_pack_config.c
```c
/*
 * Copyright (c) 2026 HARDWARIO a.s.
 *
 * SPDX-License-Identifier: LicenseRef-HARDWARIO-5-Clause
 */

#include "hio_cloud_msg.h"
#include "hio_cloud_util.h"
#include "ram_store.h"
#include "test_module.h"

#include <hio/hio_buf.h>

#include <zephyr/shell/shell.h>
#include <zephyr/shell/shell_dummy.h>
#include <zephyr/sys/byteorder.h>
#include <zephyr/ztest.h>

#include <zcbor_common.h>
#include <zcbor_decode.h>

#include <string.h>

static void *suite_setup(void)
{
	zassert_ok(test_module_register(), "test module registration failed");
	ram_store_register();

	const struct shell *sh = shell_backend_dummy_get_ptr();
	WAIT_FOR(shell_ready(sh), 20000, k_msleep(1));
	zassert_true(shell_ready(sh), "dummy shell backend did not become ready");

	return NULL;
}

static void before_each(void *fixture)
{
	ARG_UNUSED(fixture);
	test_module_set_defaults();
	/* Clean config: the current values are packed, as "config show" prints
	 * them (earlier suites leave unsaved changes) */
	zassert_ok(hio_config_save_without_reboot());
}

ZTEST_SUITE(hio_cloud_pack_config, NULL, suite_setup, before_each, NULL, NULL);

/* Oracle: reproduce the legacy dummy-shell derived message and compare. */
ZTEST(hio_cloud_pack_config, test_matches_dummy_shell_oracle)
{
	const struct shell *sh = shell_backend_dummy_get_ptr();

	shell_backend_dummy_clear_output(sh);
	zassert_ok(shell_execute_cmd(sh, "config show"));

	size_t raw_size;
	const char *raw = shell_backend_dummy_get_output(sh, &raw_size);
	zassert_not_null(raw);

	uint8_t expected_hash[8];
	zassert_ok(hio_cloud_calculate_hash(expected_hash, (const uint8_t *)raw, raw_size, NULL,
					    0));

	/* 16K: tests run alphabetically, so test_large_config's "big" module
	 * (~11 KB of lines) is already registered when this oracle runs. */
	HIO_BUF_DEFINE(buf, 16384);
	zassert_ok(hio_cloud_msg_pack_config(&buf));

	uint8_t *p = hio_buf_get_mem(&buf);
	size_t used = hio_buf_get_used(&buf);

	zassert_true(used > 10);
	zassert_equal(p[0], UL_UPLOAD_CONFIG);
	zassert_mem_equal(&p[1], expected_hash, 8, "wire hash mismatch");
	zassert_equal(p[9], 0x00, "expected UL_CONFIG_HEADER_NOCOMPRESSION");

	/* Decode the CBOR list and compare against the shell output lines. */
	ZCBOR_STATE_D(zs, 1, p + 10, used - 10, 1, 0);
	zassert_true(zcbor_list_start_decode(zs));

	const char *cursor = raw;
	const char *end = raw + raw_size;
	int lines = 0;

	while (cursor < end) {
		const char *eol = strstr(cursor, "\r\n");
		if (eol == NULL) {
			break;
		}
		if (eol == cursor) {
			cursor += 2;
			continue;
		}

		struct zcbor_string tstr;
		zassert_true(zcbor_tstr_decode(zs, &tstr), "fewer CBOR lines than shell lines");
		zassert_equal(tstr.len, (size_t)(eol - cursor));
		zassert_mem_equal(tstr.value, cursor, tstr.len, "line %d differs", lines);

		lines++;
		cursor = eol + 2;
	}

	struct zcbor_string extra;
	zassert_false(zcbor_tstr_decode(zs, &extra), "more CBOR lines than shell lines");
	zassert_true(zcbor_list_end_decode(zs));
	zassert_true(lines > 0);
}

/* The dummy shell would truncate >8K output; the iterator path must not. */
ZTEST(hio_cloud_pack_config, test_large_config)
{
	static char m_big_strings[40][300];
	static struct hio_config_item m_big_items[40];
	static struct hio_config m_big_module = {
		.name = "big",
		.items = m_big_items,
		.nitems = ARRAY_SIZE(m_big_items),
		.interim = m_big_strings,
		.final = m_big_strings,
		.size = sizeof(m_big_strings),
	};
	static char m_names[40][8];
	static bool m_registered;

	for (int i = 0; i < 40; i++) {
		snprintf(m_names[i], sizeof(m_names[i]), "s%02d", i);

		m_big_items[i] = (struct hio_config_item){
			.name = m_names[i],
			.type = HIO_CONFIG_TYPE_STRING,
			.variable = m_big_strings[i],
			.size = sizeof(m_big_strings[i]),
			.help = "big",
			.default_string = "",
		};
	}
	if (!m_registered) {
		zassert_ok(hio_config_register(&m_big_module));
		m_registered = true;
	}

	/* Fill values AFTER registration — item_init() inside
	 * hio_config_register() resets every item to its default.
	 *
	 * Value length is 220, not the naively larger 250: a 250-char value
	 * makes format_line() produce a 267-byte line, which overflows
	 * item_print_value()'s CONFIG_SHELL_CMD_BUFF_SIZE=256 line buffer and
	 * makes the *oracle's own* "config show" shell command fail with
	 * -ENOSPC (independent of hio_cloud_msg_pack_config) — that would
	 * break test_matches_dummy_shell_oracle once this module is
	 * registered. 220 keeps each line under 256 B while the aggregate
	 * (~40 * 232 B) still exceeds the old 8K dummy-shell total-output
	 * limit that this test targets. */
	for (int i = 0; i < 40; i++) {
		memset(m_big_strings[i], 'x', 220);
		m_big_strings[i][220] = '\0';
	}

	/* ~40 * (10 + 220 + 2) B of lines: over the 8K dummy-shell limit. */
	HIO_BUF_DEFINE(buf, 16384);
	zassert_ok(hio_cloud_msg_pack_config(&buf));

	uint8_t *p = hio_buf_get_mem(&buf);
	size_t used = hio_buf_get_used(&buf);

	ZCBOR_STATE_D(zs, 1, p + 10, used - 10, 1, 0);
	zassert_true(zcbor_list_start_decode(zs));

	int lines = 0;
	bool seen_last = false;
	struct zcbor_string tstr;

	while (zcbor_tstr_decode(zs, &tstr)) {
		lines++;
		if (tstr.len > 15 && memcmp(tstr.value, "big config s39 ", 15) == 0) {
			seen_last = true;
		}
	}
	zassert_true(zcbor_list_end_decode(zs));

	zassert_true(lines >= 40, "expected all big-module lines, got %d", lines);
	zassert_true(seen_last, "last big-module item missing (truncation?)");
}
```
