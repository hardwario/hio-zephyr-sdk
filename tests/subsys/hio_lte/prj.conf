## CMakeLists.txt
```
cmake_minimum_required(VERSION 3.20.0)

find_package(Zephyr REQUIRED HINTS $ENV{ZEPHYR_BASE})

project(test)

add_compile_definitions(CONFIG_HIO_LTE_LOG_LEVEL=3)
add_compile_definitions(CONFIG_HIO_LTE_SCAN_MAX_ENTRIES=10)
add_compile_definitions(CONFIG_HIO_LTE_CAUSE_STR=1)

set(HIO_LTE_DIR ${CMAKE_CURRENT_SOURCE_DIR}/../../../subsys/hio_lte)

include_directories(${HIO_LTE_DIR})
target_sources(app PRIVATE ${HIO_LTE_DIR}/hio_lte_parse.c)
target_sources(app PRIVATE ${HIO_LTE_DIR}/hio_lte_state.c)
target_sources(app PRIVATE ${HIO_LTE_DIR}/hio_lte_util.c)
target_sources(app PRIVATE ${HIO_LTE_DIR}/hio_lte_str.c)
target_sources(app PRIVATE src/test_parse.c)
target_sources(app PRIVATE src/test_state.c)
target_sources(app PRIVATE src/test_util.c)
target_sources(app PRIVATE src/test_str.c)
```

## prj.conf
```kconfig
CONFIG_ZTEST=y
CONFIG_HEAP_MEM_POOL_SIZE=256
CONFIG_MAIN_STACK_SIZE=2048

CONFIG_LOG=y
CONFIG_CBPRINTF_FP_SUPPORT=y

CONFIG_REQUIRES_FULL_LIBC=y
```

## src/test_fmt_duration.c
```c
#include <zephyr/kernel.h>
#include <zephyr/ztest.h>

#include <hio/hio_util.h>

static void expect(uint32_t sec, const char *exp)
{
	char buf[24];

	zassert_ok(hio_util_fmt_duration(sec, buf, sizeof(buf)));
	zassert_str_equal(buf, exp, "%u s -> '%s'", sec, buf);
}

ZTEST(util_fmt_duration, test_units)
{
	expect(0, "0s");
	expect(45, "45s");
	expect(2210, "36m 50s");
	expect(3723, "1h 02m 03s");
	expect(93784, "1d 02h 03m 04s");
	expect(UINT32_MAX, "49710d 06h 28m 15s");
}

ZTEST(util_fmt_duration, test_too_small)
{
	char buf[4];

	zassert_equal(hio_util_fmt_duration(2210, buf, sizeof(buf)), -ENOSPC);
}

ZTEST_SUITE(util_fmt_duration, NULL, NULL, NULL, NULL, NULL);
```

## src/test_state.c
```c
#include <zephyr/kernel.h>
#include <zephyr/ztest.h>

#include <hio_lte_state.h>

ZTEST(state_ceer, test_ceer_round_trip)
{
	/* Unset state reports no data (must run before the set below — the
	 * state is a static singleton shared by all tests). */
	char *ceer = NULL;
	zassert_equal(hio_lte_state_get_ceer(&ceer), -ENODATA);

	hio_lte_state_set_ceer("RRC connection release, extended wait time 300 s");

	zassert_ok(hio_lte_state_get_ceer(&ceer));
	zassert_not_null(ceer);
	zassert_equal(strcmp(ceer, "RRC connection release, extended wait time 300 s"), 0,
		      "unexpected ceer: %s", ceer);
}

ZTEST(state_ceer, test_ceer_null_arg)
{
	zassert_equal(hio_lte_state_get_ceer(NULL), -EINVAL);
}

ZTEST_SUITE(state_ceer, NULL, NULL, NULL, NULL, NULL);

/* History holds CONFIG_HIO_LTE_CEREG_HISTORY (3 here) entries. */
static void add_cereg(int stat, const char *tac, int cid, int cause_type, int cause)
{
	struct hio_lte_cereg_param param = {
		.valid = true,
		.stat = stat,
		.cid = cid,
		.act = HIO_LTE_CEREG_PARAM_ACT_LTE,
		.cause_type = cause_type,
		.reject_cause = cause,
	};

	strcpy(param.tac, tac);
	hio_lte_state_add_cereg_event(&param);
}

ZTEST(state_cereg_history, test_history)
{
	struct hio_lte_cereg_event e[5];
	size_t count;

	zassert_equal(hio_lte_state_get_last_reject(&e[0]), -ENODATA);

	add_cereg(2, "8DCC", 0xAE5CA, 0, 0);
	/* Repeat is not stored. */
	add_cereg(2, "8DCC", 0xAE5CA, 0, 0);
	add_cereg(2, "8DCC", 0xAE5CA, 0, 15);

	zassert_ok(hio_lte_state_get_cereg_history(e, ARRAY_SIZE(e), &count));
	zassert_equal(count, 2);
	zassert_equal(e[0].reject_cause, 15, "newest first");
	zassert_equal(e[0].tac, 0x8DCC);
	zassert_equal(e[0].cid, 0xAE5CA);

	/* Manufacturer-specific cause is not an EMM cause. */
	add_cereg(3, "8DCC", 0xAE5CA, 1, 42);
	add_cereg(5, "05F2", 0x74FEB50, 0, 0);
	add_cereg(1, "05F2", 0x74FEB50, 0, 0);

	zassert_ok(hio_lte_state_get_cereg_history(e, ARRAY_SIZE(e), &count));
	zassert_equal(count, 3, "ring keeps the newest 3");
	zassert_equal(e[0].stat, 1);
	zassert_equal(e[2].stat, 3);
	zassert_equal(e[2].reject_cause, 0);

	/* The reject survives the ring rolling over. */
	zassert_ok(hio_lte_state_get_last_reject(&e[0]));
	zassert_equal(e[0].reject_cause, 15);
	zassert_equal(e[0].tac, 0x8DCC);
}

ZTEST_SUITE(state_cereg_history, NULL, NULL, NULL, NULL, NULL);
```

## src/test_str.c
```c
#include <zephyr/kernel.h>
#include <zephyr/ztest.h>

#include <hio/hio_lte.h>

ZTEST(str_cause, test_emm_cause)
{
	zassert_str_equal(hio_lte_str_emm_cause(15), "No suitable cells in tracking area");
	zassert_not_null(hio_lte_str_emm_cause_hint(15));
	zassert_str_equal(hio_lte_str_emm_cause(111), "Protocol error, unspecified");
}

ZTEST(str_cause, test_esm_cause)
{
	zassert_str_equal(hio_lte_str_esm_cause(27), "Missing or unknown APN");
	zassert_not_null(hio_lte_str_esm_cause_hint(27));
}

ZTEST(str_cause, test_unknown_cause)
{
	zassert_str_equal(hio_lte_str_emm_cause(0), "unknown");
	zassert_str_equal(hio_lte_str_esm_cause(255), "unknown");
	zassert_is_null(hio_lte_str_emm_cause_hint(0));
	zassert_is_null(hio_lte_str_emm_cause_hint(16));
}

ZTEST_SUITE(str_cause, NULL, NULL, NULL, NULL, NULL);
```

## src/test_util.c
```c
#include <zephyr/kernel.h>
#include <zephyr/ztest.h>

#include <hio_lte_util.h>

ZTEST(util_recv_timeout, test_default_without_cereg)
{
	zassert_equal(hio_lte_util_recv_timeout_sec(NULL), HIO_LTE_UTIL_RECV_TIMEOUT_DEFAULT_SEC);

	struct hio_lte_cereg_param cereg = {.valid = false};
	zassert_equal(hio_lte_util_recv_timeout_sec(&cereg),
		      HIO_LTE_UTIL_RECV_TIMEOUT_DEFAULT_SEC);
}

ZTEST(util_recv_timeout, test_granted_active_time_extends_window)
{
	/* Network granted T3324 of 10 s (the China Unicom NB-IoT case): the
	 * device stays reachable for paging that long after RRC release, so
	 * the receive window covers twice that to absorb RRC hold and server
	 * processing on top of the paging window. */
	struct hio_lte_cereg_param cereg = {
		.valid = true,
		.act = HIO_LTE_CEREG_PARAM_ACT_NBIOT,
		.active_time = 10,
	};
	zassert_equal(hio_lte_util_recv_timeout_sec(&cereg),
		      10 * HIO_LTE_UTIL_RECV_TIMEOUT_T3324_MULT);
}

ZTEST(util_recv_timeout, test_small_active_time_floors_to_default)
{
	struct hio_lte_cereg_param cereg = {
		.valid = true,
		.act = HIO_LTE_CEREG_PARAM_ACT_NBIOT,
		.active_time = 2,
	};
	zassert_equal(hio_lte_util_recv_timeout_sec(&cereg),
		      HIO_LTE_UTIL_RECV_TIMEOUT_DEFAULT_SEC);
}

ZTEST(util_recv_timeout, test_granted_active_time_is_capped)
{
	struct hio_lte_cereg_param cereg = {
		.valid = true,
		.act = HIO_LTE_CEREG_PARAM_ACT_NBIOT,
		.active_time = 180,
	};
	zassert_equal(hio_lte_util_recv_timeout_sec(&cereg), HIO_LTE_UTIL_RECV_TIMEOUT_MAX_SEC);
}

ZTEST(util_recv_timeout, test_nbiot_without_psm_uses_nbiot_default)
{
	struct hio_lte_cereg_param cereg = {
		.valid = true,
		.act = HIO_LTE_CEREG_PARAM_ACT_NBIOT,
		.active_time = -1,
	};
	zassert_equal(hio_lte_util_recv_timeout_sec(&cereg), HIO_LTE_UTIL_RECV_TIMEOUT_NBIOT_SEC);

	/* T3324 of 0 s means immediate PSM, there is no usable paging
	 * window, fall back to the NB-IoT default as well. */
	cereg.active_time = 0;
	zassert_equal(hio_lte_util_recv_timeout_sec(&cereg), HIO_LTE_UTIL_RECV_TIMEOUT_NBIOT_SEC);
}

ZTEST(util_recv_timeout, test_ltem_without_psm_keeps_default)
{
	struct hio_lte_cereg_param cereg = {
		.valid = true,
		.act = HIO_LTE_CEREG_PARAM_ACT_LTE,
		.active_time = -1,
	};
	zassert_equal(hio_lte_util_recv_timeout_sec(&cereg),
		      HIO_LTE_UTIL_RECV_TIMEOUT_DEFAULT_SEC);
}

ZTEST_SUITE(util_recv_timeout, NULL, NULL, NULL, NULL, NULL);

ZTEST(util_send_timeout, test_no_deadline_uses_max)
{
	/* K_FOREVER (init transfers) reaches us as "no deadline" -> the hard
	 * ceiling, so a stuck bearer setup is still eventually abandoned. */
	zassert_equal(hio_lte_util_send_timeout_sec(-1), HIO_LTE_UTIL_SEND_TIMEOUT_MAX_SEC);
}

ZTEST(util_send_timeout, test_generous_deadline_capped_to_max)
{
	/* Plenty of time left, but one send must not block longer than the
	 * ceiling regardless. */
	zassert_equal(hio_lte_util_send_timeout_sec(600), HIO_LTE_UTIL_SEND_TIMEOUT_MAX_SEC);
}

ZTEST(util_send_timeout, test_deadline_within_range_passed_through)
{
	/* Caller has 40 s left -> the send may wait up to 40 s, never past the
	 * caller's own deadline. */
	zassert_equal(hio_lte_util_send_timeout_sec(40), 40);
}

ZTEST(util_send_timeout, test_almost_expired_deadline_floors_to_min)
{
	/* Deadline nearly up: still give the send a usable minimum window
	 * rather than a doomed sub-second attempt. */
	zassert_equal(hio_lte_util_send_timeout_sec(1), HIO_LTE_UTIL_SEND_TIMEOUT_MIN_SEC);
	zassert_equal(hio_lte_util_send_timeout_sec(0), HIO_LTE_UTIL_SEND_TIMEOUT_MIN_SEC);
}

ZTEST(util_send_timeout, test_boundaries)
{
	zassert_equal(hio_lte_util_send_timeout_sec(HIO_LTE_UTIL_SEND_TIMEOUT_MAX_SEC),
		      HIO_LTE_UTIL_SEND_TIMEOUT_MAX_SEC);
	zassert_equal(hio_lte_util_send_timeout_sec(HIO_LTE_UTIL_SEND_TIMEOUT_MIN_SEC),
		      HIO_LTE_UTIL_SEND_TIMEOUT_MIN_SEC);
}

ZTEST_SUITE(util_send_timeout, NULL, NULL, NULL, NULL, NULL);
```
