## CMakeLists.txt
```
#
# Copyright (c) 2026 HARDWARIO a.s.
#
# SPDX-License-Identifier: LicenseRef-HARDWARIO-5-Clause
#

cmake_minimum_required(VERSION 3.20.0)

find_package(Zephyr REQUIRED HINTS $ENV{ZEPHYR_BASE})

project(test)

# hio_config sources are compiled directly (same pattern as tests/subsys/hio_lte);
# the Kconfig-derived macros the sources expect are provided here.
add_compile_definitions(CONFIG_HIO_CONFIG_LOG_LEVEL=3)
add_compile_definitions(CONFIG_HIO_CONFIG_INIT_PRIORITY=0)
add_compile_definitions(CONFIG_HIO_CONFIG_SETTINGS_PFX="")
add_compile_definitions(CONFIG_HIO_CONFIG_SETTINGS_KEY_MAX=96)
add_compile_definitions(CONFIG_HIO_CONFIG_VALUE_MAX_SIZE=128)

set(HIO_CONFIG_DIR ${CMAKE_CURRENT_SOURCE_DIR}/../../../subsys/hio_config)

include_directories(${HIO_CONFIG_DIR})
target_sources(app PRIVATE ${HIO_CONFIG_DIR}/hio_config.c)
target_sources(app PRIVATE ${HIO_CONFIG_DIR}/hio_config_shell.c)
target_sources(app PRIVATE src/stubs.c)
target_sources(app PRIVATE src/ram_store.c)
target_sources(app PRIVATE src/test_module.c)
target_sources(app PRIVATE src/test_dirty.c)
target_sources(app PRIVATE src/test_format_line.c)
target_sources(app PRIVATE src/test_parse_line.c)
target_sources(app PRIVATE src/test_saved.c)
target_sources(app PRIVATE src/test_show_parity.c)
target_sources(app PRIVATE src/main.c)
```

## prj.conf
```kconfig
CONFIG_ZTEST=y
CONFIG_MAIN_STACK_SIZE=8192

CONFIG_LOG=y

# Full libc + FP for snprintf ("%.2f") used by the config formatter.
CONFIG_REQUIRES_FULL_LIBC=y
CONFIG_CBPRINTF_FP_SUPPORT=y

# hio_config dependencies (subsystem compiled manually, so its Kconfig
# `select`s do not apply and the needed options are set here).
CONFIG_EVENTS=y
CONFIG_REBOOT=y
CONFIG_HIO_UTIL=y
CONFIG_SETTINGS=y
CONFIG_SETTINGS_NONE=y
CONFIG_SETTINGS_RUNTIME=y

# Shell with dummy backend for the parity test (Task 3). The shell log
# backend is disabled so deferred log flushes cannot pollute the dummy
# capture between clear_output() and get_output() (production HIO_SHELL
# disables it too).
CONFIG_SHELL=y
CONFIG_SHELL_BACKEND_DUMMY=y
CONFIG_SHELL_BACKEND_DUMMY_BUF_SIZE=16384
CONFIG_SHELL_LOG_BACKEND=n
```

## src/main.c
```c
/*
 * Copyright (c) 2026 HARDWARIO a.s.
 *
 * SPDX-License-Identifier: LicenseRef-HARDWARIO-5-Clause
 */

#include "test_module.h"

#include <zephyr/ztest.h>

static void *suite_setup(void)
{
	zassert_ok(test_module_register(), "test module registration failed");
	return NULL;
}

static void before_each(void *fixture)
{
	ARG_UNUSED(fixture);
	test_module_set_defaults();
}

ZTEST_SUITE(hio_config_smoke, NULL, suite_setup, before_each, NULL, NULL);

ZTEST(hio_config_smoke, test_module_registered)
{
	struct hio_config *module;

	zassert_ok(hio_config_find_module("app", &module));
	zassert_equal_ptr(module, &g_test_module);
}
```

## src/ram_store.c
```c
/*
 * Copyright (c) 2026 HARDWARIO a.s.
 *
 * SPDX-License-Identifier: LicenseRef-HARDWARIO-5-Clause
 */

#include "ram_store.h"

#include <zephyr/settings/settings.h>
#include <zephyr/sys/util.h>
#include <zephyr/ztest.h>

#include <string.h>

struct entry {
	bool used;
	char name[64];
	/* Fits the 300 B strings of the "big" module in hio_cloud_msg tests */
	uint8_t value[320];
	size_t len;
};

static struct entry m_entries[64];

static struct entry *find(const char *name)
{
	for (size_t i = 0; i < ARRAY_SIZE(m_entries); i++) {
		if (m_entries[i].used && strcmp(m_entries[i].name, name) == 0) {
			return &m_entries[i];
		}
	}

	return NULL;
}

void ram_store_put(const char *name, const void *value, size_t len)
{
	struct entry *e = find(name);

	if (e == NULL) {
		for (size_t i = 0; i < ARRAY_SIZE(m_entries); i++) {
			if (!m_entries[i].used) {
				e = &m_entries[i];
				break;
			}
		}
	}

	zassert_not_null(e, "RAM store full");
	zassert_true(strlen(name) < sizeof(e->name));
	zassert_true(len <= sizeof(e->value));

	e->used = true;
	strcpy(e->name, name);
	memcpy(e->value, value, len);
	e->len = len;
}

void ram_store_clear(void)
{
	memset(m_entries, 0, sizeof(m_entries));
}

static ssize_t read_cb(void *cb_arg, void *data, size_t len)
{
	struct entry *e = cb_arg;
	size_t n = MIN(len, e->len);

	memcpy(data, e->value, n);

	return n;
}

static int ram_load(struct settings_store *cs, const struct settings_load_arg *arg)
{
	for (size_t i = 0; i < ARRAY_SIZE(m_entries); i++) {
		struct entry *e = &m_entries[i];

		if (!e->used) {
			continue;
		}

		int ret = settings_call_set_handler(e->name, e->len, read_cb, e, arg);
		if (ret) {
			return ret;
		}
	}

	return 0;
}

static int ram_save(struct settings_store *cs, const char *name, const char *value,
		    size_t val_len)
{
	/* A zero-length value deletes the key */
	if (value == NULL || val_len == 0) {
		struct entry *e = find(name);

		if (e != NULL) {
			e->used = false;
		}
		return 0;
	}

	ram_store_put(name, value, val_len);

	return 0;
}

static const struct settings_store_itf m_itf = {
	.csi_load = ram_load,
	.csi_save = ram_save,
};

static struct settings_store m_store = {
	.cs_itf = &m_itf,
};

void ram_store_register(void)
{
	static bool registered;

	if (!registered) {
		settings_src_register(&m_store);
		settings_dst_register(&m_store);
		registered = true;
	}
}
```

## src/ram_store.h
```c
/*
 * Copyright (c) 2026 HARDWARIO a.s.
 *
 * SPDX-License-Identifier: LicenseRef-HARDWARIO-5-Clause
 */

#ifndef RAM_STORE_H_
#define RAM_STORE_H_

#include <stddef.h>

/* Register a RAM-backed settings store as both the load source and the save
 * destination (SETTINGS_NONE provides neither); repeated calls are no-ops. */
void ram_store_register(void);

/* Write a raw value to the store, bypassing the settings handlers */
void ram_store_put(const char *name, const void *value, size_t len);

/* Remove all values from the store */
void ram_store_clear(void);

#endif /* RAM_STORE_H_ */
```

## src/stubs.c
```c
/*
 * Copyright (c) 2026 HARDWARIO a.s.
 *
 * SPDX-License-Identifier: LicenseRef-HARDWARIO-5-Clause
 */

/* Link stubs for hio_config.c externals not exercised by these tests. */

#include <hio/hio_sys.h>

#include <zephyr/sys/__assert.h>

void hio_sys_reboot(const char *reason)
{
	/* Tests never save/reset; rebooting the test binary is a bug. */
	__ASSERT(false, "unexpected reboot: %s", reason);
}
```

## src/test_dirty.c
```c
/*
 * Copyright (c) 2026 HARDWARIO a.s.
 *
 * SPDX-License-Identifier: LicenseRef-HARDWARIO-5-Clause
 */

#include "ram_store.h"
#include "test_module.h"

#include <zephyr/ztest.h>

#include <string.h>

/* Suites run in alphabetical order; register here too (idempotent). */
static void *suite_setup(void)
{
	zassert_ok(test_module_register(), "test module registration failed");
	ram_store_register();
	return NULL;
}

static void before_each(void *fixture)
{
	ARG_UNUSED(fixture);
	test_module_set_defaults();
	zassert_ok(hio_config_save_without_reboot());
}

ZTEST_SUITE(hio_config_dirty, NULL, suite_setup, before_each, NULL, NULL);

static int set(const char *name, const char *value, const char **err_msg)
{
	const struct hio_config_item *item;
	char buf[64];

	zassert_ok(hio_config_module_find_item(&g_test_module, name, &item));
	strcpy(buf, value);
	return hio_config_module_item_set_value(&g_test_module, item, buf, err_msg);
}

ZTEST(hio_config_dirty, test_clean_after_save)
{
	zassert_false(hio_config_is_dirty());
}

ZTEST(hio_config_dirty, test_set_marks_dirty)
{
	const char *err_msg = NULL;

	zassert_ok(set("interval", "120", &err_msg));
	zassert_true(hio_config_is_dirty());
}

ZTEST(hio_config_dirty, test_same_value_marks_dirty)
{
	const char *err_msg = NULL;

	zassert_ok(set("interval", "60", &err_msg));
	zassert_true(hio_config_is_dirty());
}

ZTEST(hio_config_dirty, test_failed_set_keeps_clean)
{
	const char *err_msg = NULL;

	zassert_not_ok(set("interval", "0", &err_msg));
	zassert_not_ok(set("rovalue", "50", &err_msg));
	zassert_false(hio_config_is_dirty());
}

ZTEST(hio_config_dirty, test_parse_line_marks_dirty)
{
	char line[] = "app config apn \"example\"";

	zassert_ok(hio_config_parse_line(line, NULL));
	zassert_true(hio_config_is_dirty());
}

ZTEST(hio_config_dirty, test_save_clears)
{
	const char *err_msg = NULL;

	zassert_ok(set("enabled", "false", &err_msg));
	zassert_true(hio_config_is_dirty());
	zassert_ok(hio_config_save_without_reboot());
	zassert_false(hio_config_is_dirty());
}

ZTEST(hio_config_dirty, test_gen_counts_writes)
{
	const char *err_msg = NULL;
	char line[] = "app config apn \"example\"";
	uint32_t gen = hio_config_get_gen();

	zassert_ok(set("interval", "120", &err_msg));
	zassert_equal(hio_config_get_gen(), gen + 1);
	zassert_ok(set("interval", "120", &err_msg));
	zassert_equal(hio_config_get_gen(), gen + 2);
	zassert_not_ok(set("interval", "0", &err_msg));
	zassert_equal(hio_config_get_gen(), gen + 2);
	zassert_ok(hio_config_parse_line(line, NULL));
	zassert_equal(hio_config_get_gen(), gen + 3);
}

ZTEST(hio_config_dirty, test_save_keeps_gen)
{
	const char *err_msg = NULL;

	zassert_ok(set("interval", "120", &err_msg));
	uint32_t gen = hio_config_get_gen();

	zassert_ok(hio_config_save_without_reboot());
	zassert_equal(hio_config_get_gen(), gen);
	zassert_false(hio_config_is_dirty());
}

ZTEST(hio_config_dirty, test_reset_marks_dirty)
{
	uint32_t gen = hio_config_get_gen();

	zassert_ok(hio_config_reset_without_reboot());
	zassert_equal(hio_config_get_gen(), gen + 1);
	zassert_true(hio_config_is_dirty());
}

ZTEST(hio_config_dirty, test_module_reset_keeps_clean)
{
	uint32_t gen = hio_config_get_gen();

	zassert_ok(hio_config_module_reset_without_reboot(&g_test_module));
	zassert_equal(hio_config_get_gen(), gen + 1);
	zassert_false(hio_config_is_dirty());
}

ZTEST(hio_config_dirty, test_module_reset_keeps_dirty)
{
	const char *err_msg = NULL;

	zassert_ok(set("interval", "120", &err_msg));
	zassert_ok(hio_config_module_reset_without_reboot(&g_test_module));
	zassert_true(hio_config_is_dirty());
}

ZTEST(hio_config_dirty, test_store_keeps_clean)
{
	const struct hio_config_item *item;
	uint32_t gen = hio_config_get_gen();
	int value = 300;

	zassert_ok(hio_config_module_find_item(&g_test_module, "interval", &item));
	zassert_ok(hio_config_module_item_store(&g_test_module, item, &value));
	zassert_equal(g_test_config_interim.interval, 300);
	zassert_equal(hio_config_get_gen(), gen + 1);
	zassert_false(hio_config_is_dirty());
}

ZTEST(hio_config_dirty, test_store_keeps_dirty)
{
	const struct hio_config_item *item;
	const char *err_msg = NULL;
	int value = 300;

	zassert_ok(set("apn", "other", &err_msg));
	zassert_ok(hio_config_module_find_item(&g_test_module, "interval", &item));
	zassert_ok(hio_config_module_item_store(&g_test_module, item, &value));
	zassert_true(hio_config_is_dirty());
}
```

## src/test_format_line.c
```c
/*
 * Copyright (c) 2026 HARDWARIO a.s.
 *
 * SPDX-License-Identifier: LicenseRef-HARDWARIO-5-Clause
 */

#include "test_module.h"

#include <zephyr/ztest.h>

#include <stdio.h>
#include <string.h>

/* Suites run in alphabetical order, so each suite registers the module
 * itself (test_module_register is idempotent). */
static void *suite_setup(void)
{
	zassert_ok(test_module_register(), "test module registration failed");
	return NULL;
}

static void before_each(void *fixture)
{
	ARG_UNUSED(fixture);
	test_module_set_defaults();
}

ZTEST_SUITE(hio_config_format_line, NULL, suite_setup, before_each, NULL, NULL);

static const char *format_item(const char *name, char *buf, size_t size)
{
	const struct hio_config_item *item;
	int ret;

	zassert_ok(hio_config_module_find_item(&g_test_module, name, &item));
	ret = hio_config_item_format_line(&g_test_module, item, buf, size);
	zassert_true(ret > 0, "format_line failed: %d", ret);
	zassert_equal(ret, strlen(buf));
	return buf;
}

ZTEST(hio_config_format_line, test_int)
{
	char buf[128];
	zassert_str_equal(format_item("interval", buf, sizeof(buf)),
			  "app config interval 60");
}

ZTEST(hio_config_format_line, test_float)
{
	char buf[128];
	zassert_str_equal(format_item("threshold", buf, sizeof(buf)),
			  "app config threshold 1.50");
}

ZTEST(hio_config_format_line, test_bool)
{
	char buf[128];
	zassert_str_equal(format_item("enabled", buf, sizeof(buf)),
			  "app config enabled true");
}

ZTEST(hio_config_format_line, test_enum)
{
	char buf[128];
	zassert_str_equal(format_item("mode", buf, sizeof(buf)),
			  "app config mode \"slow\"");
}

ZTEST(hio_config_format_line, test_enum_invalid)
{
	char buf[128];
	g_test_config_interim.mode = (enum test_mode)7;
	zassert_str_equal(format_item("mode", buf, sizeof(buf)),
			  "app config mode <invalid: 7>");
}

ZTEST(hio_config_format_line, test_string)
{
	char buf[128];
	zassert_str_equal(format_item("apn", buf, sizeof(buf)),
			  "app config apn \"internet\"");
}

ZTEST(hio_config_format_line, test_hex)
{
	char buf[128];
	zassert_str_equal(format_item("key", buf, sizeof(buf)),
			  "app config key deadbeef00010203");
}

ZTEST(hio_config_format_line, test_enospc)
{
	char buf[8];
	const struct hio_config_item *item;

	zassert_ok(hio_config_module_find_item(&g_test_module, "interval", &item));
	zassert_equal(hio_config_item_format_line(&g_test_module, item, buf, sizeof(buf)),
		      -ENOSPC);
}

ZTEST(hio_config_format_line, test_exact_size)
{
	const struct hio_config_item *item;
	const char *expected = "app config interval 60";
	size_t len = strlen(expected);
	char buf[64];

	zassert_ok(hio_config_module_find_item(&g_test_module, "interval", &item));

	/* No room for the terminator */
	zassert_equal(hio_config_item_format_line(&g_test_module, item, buf, len), -ENOSPC);
	zassert_equal(hio_config_item_format_line(&g_test_module, item, buf, len + 1), len);
	zassert_str_equal(buf, expected);
}

ZTEST(hio_config_format_line, test_hex_multiple_pieces)
{
	static uint8_t value[32];
	static const struct hio_config_item item = {
		.name = "long", .type = HIO_CONFIG_TYPE_HEX, .variable = value, .size = sizeof(value),
	};
	char expected[128];
	char buf[128];
	size_t n;

	for (size_t i = 0; i < sizeof(value); i++) {
		value[i] = 0xa0 + i;
	}

	n = snprintf(expected, sizeof(expected), "app config long ");
	for (size_t i = 0; i < sizeof(value); i++) {
		n += snprintf(expected + n, sizeof(expected) - n, "%02x", value[i]);
	}

	zassert_equal(hio_config_item_format_line(&g_test_module, &item, buf, sizeof(buf)), n);
	zassert_str_equal(buf, expected);
}
```

## src/test_module.c
```c
/*
 * Copyright (c) 2026 HARDWARIO a.s.
 *
 * SPDX-License-Identifier: LicenseRef-HARDWARIO-5-Clause
 */

#include "test_module.h"

#include <string.h>

static const char *m_mode_labels[] = {"off", "slow", "fast"};
static const uint8_t m_key_default[8] = {0xde, 0xad, 0xbe, 0xef, 0x00, 0x01, 0x02, 0x03};

struct test_config g_test_config_interim;
static struct test_config m_config_final;

static struct hio_config_item m_items[] = {
	HIO_CONFIG_ITEM_INT("interval", g_test_config_interim.interval, 1, 86400,
			    "Sampling interval", 60),
	HIO_CONFIG_ITEM_FLOAT("threshold", g_test_config_interim.threshold, 0.f, 100.f,
			      "Alert threshold", 1.5f),
	HIO_CONFIG_ITEM_BOOL("enabled", g_test_config_interim.enabled, "Feature enable", true),
	HIO_CONFIG_ITEM_ENUM("mode", g_test_config_interim.mode, m_mode_labels, "Operating mode",
			     TEST_MODE_SLOW),
	HIO_CONFIG_ITEM_STRING("apn", g_test_config_interim.apn, "Network APN", "internet"),
	HIO_CONFIG_ITEM_HEX("key", g_test_config_interim.key, "Encryption key", m_key_default),
	HIO_CONFIG_ITEM_STRING("secret", g_test_config_interim.secret, "Hidden secret", "s3cret"),
	HIO_CONFIG_ITEM_INT("rovalue", g_test_config_interim.rovalue, 0, 100, "Read-only value",
			    42),
};

struct hio_config g_test_module = {
	.name = "app",
	.items = m_items,
	.nitems = ARRAY_SIZE(m_items),
	.interim = &g_test_config_interim,
	.final = &m_config_final,
	.size = sizeof(struct test_config),
};

static int access_cb(const struct hio_config *module, const struct hio_config_item *item)
{
	if (strcmp(item->name, "secret") == 0) {
		return HIO_CONFIG_ACCESS_HIDDEN_RW;
	}
	if (strcmp(item->name, "rovalue") == 0) {
		return HIO_CONFIG_ACCESS_RO;
	}
	return HIO_CONFIG_ACCESS_RW;
}

int test_module_register(void)
{
	hio_config_set_access_cb(access_cb);

	/* Ztest runs suites in alphabetical order (iterable sections are
	 * SORT_BY_NAME), so every suite's setup calls this; tolerate repeats. */
	int ret = hio_config_register(&g_test_module);
	return ret == -EALREADY ? 0 : ret;
}

void test_module_set_defaults(void)
{
	g_test_config_interim.interval = 60;
	g_test_config_interim.threshold = 1.5f;
	g_test_config_interim.enabled = true;
	g_test_config_interim.mode = TEST_MODE_SLOW;
	strcpy(g_test_config_interim.apn, "internet");
	memcpy(g_test_config_interim.key, m_key_default, sizeof(m_key_default));
	strcpy(g_test_config_interim.secret, "s3cret");
	g_test_config_interim.rovalue = 42;
}
```

## src/test_parse_line.c
```c
/*
 * Copyright (c) 2026 HARDWARIO a.s.
 *
 * SPDX-License-Identifier: LicenseRef-HARDWARIO-5-Clause
 */

#include "test_module.h"

#include <zephyr/ztest.h>

#include <string.h>

/* Suites run in alphabetical order; register here too (idempotent). */
static void *suite_setup(void)
{
	zassert_ok(test_module_register(), "test module registration failed");
	return NULL;
}

static void before_each(void *fixture)
{
	ARG_UNUSED(fixture);
	test_module_set_defaults();
}

ZTEST_SUITE(hio_config_parse_line, NULL, suite_setup, before_each, NULL, NULL);

static int parse(const char *input, const char **err_msg)
{
	char line[128];

	strcpy(line, input);
	return hio_config_parse_line(line, err_msg);
}

ZTEST(hio_config_parse_line, test_int)
{
	zassert_ok(parse("app config interval 120", NULL));
	zassert_equal(g_test_config_interim.interval, 120);
}

ZTEST(hio_config_parse_line, test_float)
{
	zassert_ok(parse("app config threshold 2.25", NULL));
	zassert_within(g_test_config_interim.threshold, 2.25f, 0.001f);
}

ZTEST(hio_config_parse_line, test_bool)
{
	zassert_ok(parse("app config enabled false", NULL));
	zassert_false(g_test_config_interim.enabled);
}

ZTEST(hio_config_parse_line, test_enum_quoted)
{
	zassert_ok(parse("app config mode \"fast\"", NULL));
	zassert_equal(g_test_config_interim.mode, TEST_MODE_FAST);
}

ZTEST(hio_config_parse_line, test_string_quoted_with_space)
{
	zassert_ok(parse("app config apn \"my apn\"", NULL));
	zassert_str_equal(g_test_config_interim.apn, "my apn");
}

ZTEST(hio_config_parse_line, test_string_empty)
{
	zassert_ok(parse("app config apn \"\"", NULL));
	zassert_str_equal(g_test_config_interim.apn, "");
}

ZTEST(hio_config_parse_line, test_hex_unquoted)
{
	static const uint8_t expected[8] = {0x01, 0x02, 0x03, 0x04, 0x05, 0x06, 0x07, 0x08};

	zassert_ok(parse("app config key 0102030405060708", NULL));
	zassert_mem_equal(g_test_config_interim.key, expected, sizeof(expected));
}

ZTEST(hio_config_parse_line, test_roundtrip_all_visible_items)
{
	for (int i = 0; i < g_test_module.nitems; i++) {
		const struct hio_config_item *item = &g_test_module.items[i];

		if (!(hio_config_item_access(&g_test_module, item) & HIO_CONFIG_ACCESS_WRITE) ||
		    !(hio_config_item_access(&g_test_module, item) & HIO_CONFIG_ACCESS_SHOW)) {
			continue;
		}

		char line[128];
		char copy[128];
		const char *err_msg = NULL;

		int len = hio_config_item_format_line(&g_test_module, item, line, sizeof(line));
		zassert_true(len > 0);
		strcpy(copy, line);

		zassert_ok(hio_config_parse_line(copy, &err_msg), "roundtrip failed for: %s (%s)",
			   line, err_msg ? err_msg : "");

		char line2[128];
		zassert_true(hio_config_item_format_line(&g_test_module, item, line2,
							 sizeof(line2)) > 0);
		zassert_str_equal(line, line2, "value changed by roundtrip");
	}
}

ZTEST(hio_config_parse_line, test_unknown_module)
{
	const char *err_msg = NULL;
	zassert_true(parse("nope config interval 1", &err_msg) < 0);
}

ZTEST(hio_config_parse_line, test_unknown_item)
{
	const char *err_msg = NULL;
	zassert_true(parse("app config nope 1", &err_msg) < 0);
}

ZTEST(hio_config_parse_line, test_malformed_missing_keyword)
{
	const char *err_msg = NULL;
	zassert_equal(parse("app interval 1", &err_msg), -EINVAL);
	zassert_not_null(err_msg);
}

ZTEST(hio_config_parse_line, test_malformed_missing_value)
{
	const char *err_msg = NULL;
	zassert_equal(parse("app config interval", &err_msg), -EINVAL);
}

ZTEST(hio_config_parse_line, test_out_of_range)
{
	const char *err_msg = NULL;
	zassert_true(parse("app config interval 999999", &err_msg) < 0);
	zassert_equal(g_test_config_interim.interval, 60, "value must not change on error");
}

ZTEST(hio_config_parse_line, test_read_only_item)
{
	const char *err_msg = NULL;
	zassert_equal(parse("app config rovalue 7", &err_msg), -EPERM);
	zassert_equal(g_test_config_interim.rovalue, 42);
}
```

## src/test_saved.c
```c
/*
 * Copyright (c) 2026 HARDWARIO a.s.
 *
 * SPDX-License-Identifier: LicenseRef-HARDWARIO-5-Clause
 */

#include "ram_store.h"
#include "test_module.h"

#include <zephyr/ztest.h>

#include <string.h>

struct seen {
	int count;
	char names[8][16];
	char lines[8][128];
};

static int collect_cb(const struct hio_config *module, const struct hio_config_item *item,
		      const void *value, void *user_data)
{
	struct seen *seen = user_data;

	zassert_true(seen->count < ARRAY_SIZE(seen->names));
	strcpy(seen->names[seen->count], item->name);
	zassert_true(hio_config_item_format_line_value(module, item, value,
						       seen->lines[seen->count],
						       sizeof(seen->lines[0])) > 0);
	seen->count++;

	return 0;
}

static const char *find_line(const struct seen *seen, const char *name)
{
	for (int i = 0; i < seen->count; i++) {
		if (strcmp(seen->names[i], name) == 0) {
			return seen->lines[i];
		}
	}

	return NULL;
}

static int set(const char *name, const char *value)
{
	const struct hio_config_item *item;
	const char *err_msg = NULL;
	char buf[64];

	zassert_ok(hio_config_module_find_item(&g_test_module, name, &item));
	strcpy(buf, value);
	return hio_config_module_item_set_value(&g_test_module, item, buf, &err_msg);
}

/* Suites run in alphabetical order; register here too (idempotent). */
static void *suite_setup(void)
{
	zassert_ok(test_module_register(), "test module registration failed");
	ram_store_register();
	return NULL;
}

static void before_each(void *fixture)
{
	ARG_UNUSED(fixture);
	ram_store_clear();
	test_module_set_defaults();
	zassert_ok(hio_config_save_without_reboot());
}

ZTEST_SUITE(hio_config_saved, NULL, suite_setup, before_each, NULL, NULL);

ZTEST(hio_config_saved, test_format_line_value)
{
	const struct hio_config_item *item;
	char line[64];
	int value = 7;

	zassert_ok(hio_config_module_find_item(&g_test_module, "interval", &item));
	zassert_true(hio_config_item_format_line_value(&g_test_module, item, &value, line,
						       sizeof(line)) > 0);
	zassert_str_equal(line, "app config interval 7");
}

ZTEST(hio_config_saved, test_saved_equals_current_after_save)
{
	struct seen seen = {0};

	zassert_ok(set("interval", "120"));
	zassert_ok(set("apn", "other"));
	zassert_ok(hio_config_save_without_reboot());
	zassert_ok(hio_config_iter_saved(collect_cb, &seen));

	/* All shown items, hidden one excluded */
	zassert_equal(seen.count, 7);
	zassert_is_null(find_line(&seen, "secret"));
	zassert_str_equal(find_line(&seen, "interval"), "app config interval 120");
	zassert_str_equal(find_line(&seen, "apn"), "app config apn \"other\"");
}

ZTEST(hio_config_saved, test_saved_keeps_old_values)
{
	struct seen seen = {0};

	zassert_ok(set("interval", "120"));
	zassert_ok(hio_config_iter_saved(collect_cb, &seen));
	zassert_str_equal(find_line(&seen, "interval"), "app config interval 60");
}

ZTEST(hio_config_saved, test_saved_missing_uses_default)
{
	struct seen seen = {0};

	ram_store_clear();
	zassert_ok(hio_config_iter_saved(collect_cb, &seen));
	zassert_equal(seen.count, 7);
	zassert_str_equal(find_line(&seen, "apn"), "app config apn \"internet\"");
	zassert_str_equal(find_line(&seen, "rovalue"), "app config rovalue 42");
}

ZTEST(hio_config_saved, test_saved_size_mismatch_uses_default)
{
	struct seen seen = {0};
	const uint16_t bad = 5;

	ram_store_put("app/interval", &bad, sizeof(bad));
	zassert_ok(hio_config_iter_saved(collect_cb, &seen));
	zassert_str_equal(find_line(&seen, "interval"), "app config interval 60");
}

ZTEST(hio_config_saved, test_diff_empty_when_clean)
{
	struct seen seen = {0};

	/* A clean config must not even read the storage */
	ram_store_clear();
	ram_store_put("app/interval", &(int){999}, sizeof(int));
	zassert_ok(hio_config_iter_diff(collect_cb, &seen));
	zassert_equal(seen.count, 0);
}

ZTEST(hio_config_saved, test_diff_reports_changes)
{
	struct seen seen = {0};

	zassert_ok(set("interval", "120"));
	zassert_ok(set("apn", "other"));
	zassert_ok(set("enabled", "true"));
	zassert_ok(hio_config_iter_diff(collect_cb, &seen));

	zassert_equal(seen.count, 2);
	zassert_str_equal(find_line(&seen, "interval"), "app config interval 60");
	zassert_str_equal(find_line(&seen, "apn"), "app config apn \"internet\"");
}

ZTEST(hio_config_saved, test_diff_skips_reverted_and_hidden)
{
	struct seen seen = {0};

	zassert_ok(set("interval", "120"));
	zassert_ok(set("interval", "60"));
	zassert_ok(set("secret", "changed"));
	zassert_true(hio_config_is_dirty());
	zassert_ok(hio_config_iter_diff(collect_cb, &seen));
	zassert_equal(seen.count, 0);
}

ZTEST(hio_config_saved, test_diff_string_ignores_bytes_after_nul)
{
	struct seen seen = {0};
	char stored[sizeof(g_test_config_interim.apn)];

	/* Same string, different padding after the terminator */
	memset(stored, 'x', sizeof(stored));
	strcpy(stored, "internet");
	ram_store_put("app/apn", stored, sizeof(stored));

	zassert_ok(set("interval", "60"));
	zassert_ok(hio_config_iter_diff(collect_cb, &seen));
	zassert_equal(seen.count, 0);
}

ZTEST(hio_config_saved, test_store_is_saved)
{
	const struct hio_config_item *item;
	struct seen seen = {0};
	int value = 300;

	zassert_ok(set("apn", "other"));
	zassert_ok(hio_config_module_find_item(&g_test_module, "interval", &item));
	zassert_ok(hio_config_module_item_store(&g_test_module, item, &value));

	/* Only the unsaved APN differs, the stored interval does not */
	zassert_ok(hio_config_iter_diff(collect_cb, &seen));
	zassert_equal(seen.count, 1);
	zassert_not_null(find_line(&seen, "apn"));
}
```

## src/test_show_parity.c
```c
/*
 * Copyright (c) 2026 HARDWARIO a.s.
 *
 * SPDX-License-Identifier: LicenseRef-HARDWARIO-5-Clause
 */

#include "test_module.h"

#include <zephyr/shell/shell.h>
#include <zephyr/shell/shell_dummy.h>
#include <zephyr/ztest.h>

#include <string.h>

/* Calibrated against the real dummy-shell capture in this test: the shell
 * emits a single leading CRLF before the first line. If this test starts
 * failing on the prefix, the cloud hash input rule (hio_cloud_msg_pack_config)
 * must be updated in lockstep — wire-hash compatibility depends on it. */
#define SHOW_STREAM_LEADING_CRLF 1

struct stream_ctx {
	char buf[16384];
	size_t len;
};

static int build_stream_cb(const struct hio_config *module, const struct hio_config_item *item,
			   void *user_data)
{
	struct stream_ctx *ctx = user_data;
	char line[512];

	if (!(hio_config_item_access(module, item) & HIO_CONFIG_ACCESS_SHOW)) {
		return 0;
	}

	int len = hio_config_item_format_line(module, item, line, sizeof(line));
	zassert_true(len > 0);

	zassert_true(ctx->len + len + 2 < sizeof(ctx->buf));
	memcpy(ctx->buf + ctx->len, line, len);
	ctx->len += len;
	memcpy(ctx->buf + ctx->len, "\r\n", 2);
	ctx->len += 2;

	return 0;
}

/* Suites run in alphabetical order; register here too (idempotent). */
static void *suite_setup(void)
{
	zassert_ok(test_module_register(), "test module registration failed");

	/* shell_init() spawns the shell processing thread and returns before it
	 * reaches SHELL_STATE_ACTIVE; shell_execute_cmd() run too early is
	 * silently swallowed by shell_vfprintf() (state != ACTIVE -> no-op), so
	 * the dummy backend would capture nothing. Wait for readiness once here. */
	const struct shell *sh = shell_backend_dummy_get_ptr();
	WAIT_FOR(shell_ready(sh), 20000, k_msleep(1));
	zassert_true(shell_ready(sh), "dummy shell backend did not become ready");

	return NULL;
}

ZTEST_SUITE(hio_config_show_parity, NULL, suite_setup, NULL, NULL, NULL);

ZTEST(hio_config_show_parity, test_dummy_shell_show_parity)
{
	const struct shell *sh = shell_backend_dummy_get_ptr();

	test_module_set_defaults();

	shell_backend_dummy_clear_output(sh);
	zassert_ok(shell_execute_cmd(sh, "config show"));

	size_t raw_size;
	const char *raw = shell_backend_dummy_get_output(sh, &raw_size);
	zassert_not_null(raw);

	struct stream_ctx ctx = {0};
#if SHOW_STREAM_LEADING_CRLF
	memcpy(ctx.buf, "\r\n", 2);
	ctx.len = 2;
#endif
	zassert_ok(hio_config_iter_items(NULL, build_stream_cb, &ctx));

	/* Guard against a vacuously-passing comparison of two empty streams. */
	zassert_true(ctx.len > 2, "generated stream is empty — module not registered?");
	zassert_not_null(strstr(ctx.buf, "app config interval"));

	/* Hidden item must not appear in either stream. */
	zassert_is_null(strstr(raw, "secret"));
	zassert_is_null(strstr(ctx.buf, "secret"));

	zassert_equal(raw_size, ctx.len, "size mismatch: shell %u vs generated %u\n"
		      "shell:\n%.*s\ngenerated:\n%.*s",
		      (unsigned)raw_size, (unsigned)ctx.len, (int)raw_size, raw, (int)ctx.len,
		      ctx.buf);
	zassert_mem_equal(raw, ctx.buf, raw_size, "byte mismatch\nshell:\n%.*s\ngenerated:\n%.*s",
			  (int)raw_size, raw, (int)ctx.len, ctx.buf);
}
```
