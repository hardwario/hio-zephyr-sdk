## CMakeLists.txt
```
#
# Copyright (c) 2026 HARDWARIO a.s.
#
# SPDX-License-Identifier: LicenseRef-HARDWARIO-5-Clause
#

cmake_minimum_required(VERSION 3.20.0)

find_package(Zephyr REQUIRED HINTS $ENV{ZEPHYR_BASE})

project(test)

# Kconfig of the hio_cloud subsystem is not enabled here (sources are compiled
# manually), so the symbols the sources need are defined on the command line.
add_compile_definitions(
	CONFIG_HIO_CLOUD_LOG_LEVEL=3
	CONFIG_HIO_CLOUD_HASH_PSA=1
	CONFIG_HIO_CLOUD_ENCODE_ZCBOR_STATES=2
	CONFIG_HIO_CLOUD_TRANSFER_BUF_SIZE=16384
	CONFIG_HIO_LTE_SCAN_MAX_ENTRIES=10
	CONFIG_HIO_LTE_SCAN_MAX_CELLS=14
)

set(HIO_CLOUD_DIR ${CMAKE_CURRENT_SOURCE_DIR}/../../../subsys/hio_cloud)

# Firmware update confirmed by the init work, see src/mock_fw.c
if(NOT DEFINED TEST_FW)
  set(TEST_FW 1)
endif()
add_compile_definitions(TEST_FW=${TEST_FW})
# The config cannot be packed, see src/stubs.c
if(NOT DEFINED TEST_CONFIG_PACK_FAIL)
  set(TEST_CONFIG_PACK_FAIL 0)
endif()
add_compile_definitions(TEST_CONFIG_PACK_FAIL=${TEST_CONFIG_PACK_FAIL})
# Only hio_cloud.c: MCUboot itself is mocked (src/mock_fw.c)
set_source_files_properties(${HIO_CLOUD_DIR}/hio_cloud.c PROPERTIES COMPILE_DEFINITIONS
                            CONFIG_MCUBOOT_IMG_MANAGER=1)

# The real hio_cloud.c with a fake transport behind the backend seam
# (hio_cloud_backend_udp_lte), so sends go the real way into m_transfer_buf.
include_directories(${HIO_CLOUD_DIR})
target_sources(app PRIVATE
	${HIO_CLOUD_DIR}/hio_cloud.c
	${HIO_CLOUD_DIR}/hio_cloud_msg_data.c
	${HIO_CLOUD_DIR}/hio_cloud_cbor.c
	src/main.c
	src/fake_backend.c
	src/stubs.c
	src/mock_fw.c
	src/test_firmware.c
	src/test_send_data.c
	src/test_send_data_cb.c
)
```

## prj.conf
```kconfig
CONFIG_ZTEST=y
CONFIG_ZTEST_STACK_SIZE=8192
CONFIG_MAIN_STACK_SIZE=8192

CONFIG_LOG=y

# hio_cloud.c deps (manual compile)
CONFIG_EVENTS=y
CONFIG_HIO_BUF=y
CONFIG_ZCBOR=y
CONFIG_ZCBOR_STOP_ON_ERROR=y

# hio_cloud_util.h (included by hio_cloud.c) needs the PSA Crypto headers
# (CONFIG_HIO_CLOUD_HASH_PSA is defined in CMakeLists.txt for manual compile).
CONFIG_PSA_CRYPTO=y
CONFIG_MBEDTLS=y
CONFIG_MBEDTLS_PSA_CRYPTO_C=y
CONFIG_PSA_WANT_ALG_SHA_256=y
CONFIG_ENTROPY_GENERATOR=y
CONFIG_CRC=y
```

## src/main.c
```c
/*
 * Copyright (c) 2026 HARDWARIO a.s.
 *
 * SPDX-License-Identifier: LicenseRef-HARDWARIO-5-Clause
 */

#include "fake_backend.h"

/* HIO includes */
#include <hio/hio_cloud.h>

/* Zephyr includes */
#include <zephyr/kernel.h>
#include <zephyr/sys/printk.h>
#include <zephyr/ztest.h>

static struct hio_cloud_options m_options = {
	.decoder_hash = HASH,
	.encoder_hash = ENCODER_HASH,
};

/* hio_cloud_init() cannot be undone: the suites for the uninitialized subsystem
 * run first, then the subsystem is initialized over the fake transport and the
 * rest runs. If the init fails, the second run is empty and the check that every
 * suite ran fails the test. Suites and tests run in alphabetical order. */
void test_main(void)
{
	struct test_state state = {.started = false};

	ztest_run_all(&state, false, 1, 1);

	fake_reset();

	/* Before the init, which confirms a firmware update */
	mock_fw_setup();

	int ret = hio_cloud_init(&m_options);

	if (!ret) {
		ret = hio_cloud_wait_initialized(TEST_INIT_TIMEOUT);
	}

	if (ret) {
		printk("hio_cloud init failed: %d\n", ret);
	}

	state.started = !ret;

	ztest_run_all(&state, false, 1, 1);

	ztest_verify_all_test_suites_ran();
}
```

## src/fake_backend.c
```c
/*
 * Copyright (c) 2026 HARDWARIO a.s.
 *
 * SPDX-License-Identifier: LicenseRef-HARDWARIO-5-Clause
 */

/* Fake transport behind the hio_cloud backend seam and shared test helpers */

#include "fake_backend.h"

#include "hio_cloud_backend.h"
#include "hio_cloud_msg.h"

/* HIO includes */
#include <hio/hio_buf.h>
#include <hio/hio_cloud.h>

/* Zephyr includes */
#include <zephyr/kernel.h>
#include <zephyr/sys/crc.h>
#include <zephyr/ztest.h>

/* Standard includes */
#include <errno.h>
#include <limits.h>
#include <string.h>

#define HELPER_STACK_SIZE 4096

struct fake g_fake;

const uint8_t g_payload[] = {0xbf, 0x01, 0x18, 0x2a, 0xff};
const uint8_t g_payload2[] = {0xa1, 0x02, 0x03};
uint8_t g_big[HIO_CLOUD_TRANSFER_BUF_SIZE];

static K_SEM_DEFINE(m_gate, 0, 1);
static K_SEM_DEFINE(m_uplink_blocked, 0, 1);
static K_SEM_DEFINE(m_downlink_sem, 0, 1);

/* Set by the CREATE SESSION uplink, answered by the next downlink */
static bool m_session_pending;

bool phase_before_init(const void *state)
{
	return !((const struct test_state *)state)->started;
}

bool phase_started(const void *state)
{
	return ((const struct test_state *)state)->started;
}

void fake_reset(void)
{
	memset(&g_fake, 0, sizeof(g_fake));
	k_sem_reset(&m_gate);
	k_sem_reset(&m_uplink_blocked);
	k_sem_reset(&m_downlink_sem);
}

void fake_before(void *fixture)
{
	ARG_UNUSED(fixture);
	/* Deferred poll work of a previous test must not leak into this one */
	settle();
	fake_reset();
}

void fake_release(void)
{
	k_sem_give(&m_gate);
}

int fake_wait_uplink_blocked(k_timeout_t timeout)
{
	return k_sem_take(&m_uplink_blocked, timeout);
}

int fake_wait_downlink(k_timeout_t timeout)
{
	return k_sem_take(&m_downlink_sem, timeout);
}

static int fake_init(uint32_t serial_number, const uint8_t token[16])
{
	return g_fake.init_ret;
}

static int fake_wait_ready(k_timeout_t timeout)
{
	return 0;
}

static int m_log_count;
static struct fake_log_entry m_log[FAKE_LOG_MAX];
static uint8_t m_fail_type;
static int m_fail_type_err;

int fake_log_count(void)
{
	return m_log_count;
}

const struct fake_log_entry *fake_log(int index)
{
	if (index < 0 || index >= MIN(m_log_count, FAKE_LOG_MAX)) {
		return NULL;
	}

	return &m_log[index];
}

int fake_log_find(uint8_t type)
{
	for (int i = 0; i < MIN(m_log_count, FAKE_LOG_MAX); i++) {
		if (m_log[i].len && m_log[i].head[0] == type) {
			return i;
		}
	}

	return -1;
}

void fake_fail_first_of_type(uint8_t type, int err)
{
	m_fail_type = type;
	m_fail_type_err = err;
}

static int fake_uplink(struct hio_buf *buf, bool *has_downlink, k_timeout_t timeout)
{
	size_t len = hio_buf_get_used(buf);
	uint8_t *mem = hio_buf_get_mem(buf);
	struct fake_log_entry *e = NULL;

	if (m_log_count < FAKE_LOG_MAX) {
		e = &m_log[m_log_count];
		memcpy(e->head, mem, MIN(len, sizeof(e->head)));
		e->len = len;
		e->at = k_uptime_get();
	}

	m_log_count++;

	if (len > 0 && mem[0] == UL_CREATE_SESSION) {
		m_session_pending = true;
		*has_downlink = true;
		return 0;
	}

	if (m_fail_type_err && len > 0 && mem[0] == m_fail_type) {
		int err = m_fail_type_err;

		m_fail_type_err = 0;

		if (e) {
			e->ret = err;
		}

		return err;
	}

	if (g_fake.uplink_count < FAKE_MAX_UPLINKS) {
		struct fake_uplink *up = &g_fake.uplinks[g_fake.uplink_count];

		memcpy(up->head, mem, MIN(len, sizeof(up->head)));
		up->len = len;
		up->crc = crc32_ieee(mem, len);
		up->buf_size = buf->size;
		up->timeout = timeout;
		up->thread = k_current_get();
	}

	g_fake.uplink_count++;

	if (g_fake.uplink_block > 0) {
		g_fake.uplink_block--;
		k_sem_give(&m_uplink_blocked);
		/* Bounded, so that a broken test cannot hang the run */
		k_sem_take(&m_gate, K_SECONDS(2));
	}

	*has_downlink = g_fake.uplink_has_downlink;

	return g_fake.uplink_ret;
}

static int fake_downlink(struct hio_buf *buf, bool *has_downlink, k_timeout_t timeout)
{
	*has_downlink = false;

	if (m_session_pending) {
		m_session_pending = false;
		return hio_buf_append_u8(buf, DL_SET_SESSION);
	}

	/* Distinct bytes, so that a downlink overwriting a message is noticed */
	static const uint8_t dl_bytes[] = {0xde, 0xad, 0xbe, 0xef};

	hio_buf_append_mem(buf, dl_bytes, sizeof(dl_bytes));

	g_fake.downlink_count++;
	g_fake.downlink_thread = k_current_get();
	k_sem_give(&m_downlink_sem);

	return 0;
}

const struct hio_cloud_backend hio_cloud_backend_udp_lte = {
	.init = fake_init,
	.wait_ready = fake_wait_ready,
	.uplink = fake_uplink,
	.downlink = fake_downlink,
};

void settle(void)
{
	k_sleep(K_MSEC(100));
}

void assert_data_msg(int idx, const uint8_t *payload, size_t len)
{
	static const uint8_t hdr[HDR_LEN] = {0x06, 0x01, 0x02, 0x03, 0x04, 0x05, 0x06, 0x07, 0x08};

	zassert_true(idx < g_fake.uplink_count, "uplink %d missing", idx);

	const struct fake_uplink *up = &g_fake.uplinks[idx];

	zassert_equal(up->len, HDR_LEN + len, "uplink %d length %zu", idx, up->len);
	zassert_mem_equal(up->head, hdr, HDR_LEN, "uplink %d header", idx);
	zassert_mem_equal(up->head + HDR_LEN, payload, MIN(len, FAKE_HEAD_LEN - HDR_LEN),
			  "uplink %d payload", idx);
}

void assert_data_msg_crc(int idx, const uint8_t *payload, size_t len)
{
	static const uint8_t hdr[HDR_LEN] = {0x06, 0x01, 0x02, 0x03, 0x04, 0x05, 0x06, 0x07, 0x08};

	zassert_true(idx < g_fake.uplink_count, "uplink %d missing", idx);

	uint32_t crc = crc32_ieee_update(0, hdr, HDR_LEN);

	crc = crc32_ieee_update(crc, payload, len);

	zassert_equal(g_fake.uplinks[idx].len, HDR_LEN + len, "uplink %d length", idx);
	zassert_equal(g_fake.uplinks[idx].crc, crc, "uplink %d message differs", idx);
}

void assert_timeout_in_ms(int idx, int lo_ms, int hi_ms)
{
	zassert_true(idx < g_fake.uplink_count, "uplink %d missing", idx);

	k_ticks_t ticks = g_fake.uplinks[idx].timeout.ticks;

	zassert_true(ticks >= K_MSEC(lo_ms).ticks && ticks <= K_MSEC(hi_ms).ticks,
		     "transfer timeout %lld ticks", (long long)ticks);
}

int send_payload2(void *arg)
{
	return hio_cloud_send_data(g_payload2, sizeof(g_payload2), K_MSEC(10));
}

/* ---- Helper threads ---- */

static K_THREAD_STACK_ARRAY_DEFINE(m_helper_stacks, HELPER_COUNT + 1, HELPER_STACK_SIZE);

struct helper {
	struct k_thread thread;
	int (*fn)(void *arg);
	void *arg;
	int result;
};

/* The last one is the lock probe of assert_lock_free() */
static struct helper m_helpers[HELPER_COUNT + 1];

static void helper_entry(void *p1, void *p2, void *p3)
{
	struct helper *h = p1;

	h->result = h->fn(h->arg);
}

void helper_start(int idx, int (*fn)(void *arg), void *arg)
{
	struct helper *h = &m_helpers[idx];

	h->fn = fn;
	h->arg = arg;
	h->result = INT_MIN;

	k_thread_create(&h->thread, m_helper_stacks[idx], HELPER_STACK_SIZE, helper_entry, h, NULL,
			NULL, k_thread_priority_get(k_current_get()), 0, K_NO_WAIT);
}

int helper_join(int idx, k_timeout_t timeout, int *result)
{
	struct helper *h = &m_helpers[idx];

	if (k_thread_join(&h->thread, timeout)) {
		k_thread_abort(&h->thread);
		return -EAGAIN;
	}

	if (result) {
		*result = h->result;
	}

	return 0;
}

static int probe_lock(void *arg)
{
	/* Takes and releases the cloud lock (m_lock) without touching the transfer buffer */
	return hio_cloud_set_callback(NULL, NULL);
}

void assert_lock_free(void)
{
	int result = INT_MIN;

	helper_start(HELPER_COUNT, probe_lock, NULL);

	zassert_ok(helper_join(HELPER_COUNT, K_MSEC(500), &result), "cloud lock still held");
	zassert_ok(result);
}
```

## src/fake_backend.h
```c
/*
 * Copyright (c) 2026 HARDWARIO a.s.
 *
 * SPDX-License-Identifier: LicenseRef-HARDWARIO-5-Clause
 */

#ifndef TEST_HIO_CLOUD_FAKE_BACKEND_H_
#define TEST_HIO_CLOUD_FAKE_BACKEND_H_

/* Zephyr includes */
#include <zephyr/kernel.h>

/* HIO includes */
#include <hio/hio_cloud.h>

/* Standard includes */
#include <stdbool.h>
#include <stddef.h>
#include <stdint.h>

#define HASH         0x0102030405060708ULL
#define ENCODER_HASH 0x1112131415161718ULL
#define HDR_LEN      9

#define FAKE_HEAD_LEN    64
#define FAKE_MAX_UPLINKS 4

/* Two-phase test_main(): suites run before and after hio_cloud_init() */
struct test_state {
	bool started;
};

bool phase_before_init(const void *state);
bool phase_started(const void *state);

struct fake_uplink {
	uint8_t head[FAKE_HEAD_LEN]; /* First bytes of the message */
	size_t len;                  /* Full message length */
	uint32_t crc;                /* CRC32 of the whole message */
	size_t buf_size;             /* Size of the buffer handed to the transport */
	k_timeout_t timeout;
	k_tid_t thread;
};

struct fake {
	/* Recorded by the fake transport */
	int uplink_count;
	struct fake_uplink uplinks[FAKE_MAX_UPLINKS];
	int downlink_count;
	k_tid_t downlink_thread;

	/* Set by the tests */
	int init_ret;
	int uplink_ret;
	bool uplink_has_downlink;
	int uplink_block; /* The next N uplinks wait for fake_release() */
};

extern struct fake g_fake;

/* Every uplink since the start, also the session request of the init work; unlike
 * g_fake, not cleared by fake_reset() */
#define FAKE_LOG_MAX 16

struct fake_log_entry {
	uint8_t head[FAKE_HEAD_LEN];
	size_t len;
	int ret;
	int64_t at; /* k_uptime_get() */
};

int fake_log_count(void);
const struct fake_log_entry *fake_log(int index);
/* Index of the first logged uplink of message `type`, or -1 */
int fake_log_find(uint8_t type);
/* The first uplink of message `type` fails with `err`; not cleared by fake_reset() */
void fake_fail_first_of_type(uint8_t type, int err);

/* ---- Mock MCUboot image state and stored update id (src/mock_fw.c) ---- */

/* TEST_FW 0: no update id stored, 1: id stored and acked, 2: id stored, the first ack fails,
 * 3: id stored, but the image is confirmed (MCUboot reverted the update), 4: id stored, but the
 * image cannot be confirmed */
extern const uint8_t TEST_FW_UPDATE_ID[16];

/* Before hio_cloud_init(): the image state and the update id of TEST_FW */
void mock_fw_setup(void);
int mock_boot_confirm_calls(void);
bool mock_fw_update_id_stored(void);

/* For the init work, which pauses 10 s between the failed attempts of a step (TEST_FW 2) */
#define TEST_INIT_TIMEOUT K_SECONDS(60)

/* Clears the records and the configuration */
void fake_reset(void);

/* Lets one blocked uplink continue */
void fake_release(void);

/* Waits until an uplink is blocked in the fake transport */
int fake_wait_uplink_blocked(k_timeout_t timeout);

/* Waits for a downlink */
int fake_wait_downlink(k_timeout_t timeout);

/* Lets the cloud work queue run whatever was submitted, for asserting that nothing happened */
void settle(void);

/* Asserts the message of uplink @p idx is the data header followed by @p payload */
void assert_data_msg(int idx, const uint8_t *payload, size_t len);

/* Asserts the whole message of uplink @p idx (not just its head) is the data header
 * followed by @p payload, by CRC32 */
void assert_data_msg_crc(int idx, const uint8_t *payload, size_t len);

/* Asserts the transfer timeout of uplink @p idx is within [lo_ms, hi_ms] */
void assert_timeout_in_ms(int idx, int lo_ms, int hi_ms);

/* Asserts the cloud lock can be taken from another thread */
void assert_lock_free(void);

/* Shared fixtures */

/* {1: 42} in an indefinite-length map */
extern const uint8_t g_payload[5];

/* {2: 3} */
extern const uint8_t g_payload2[3];

extern uint8_t g_big[HIO_CLOUD_TRANSFER_BUF_SIZE];

/* Common before() of the suites: resets the fake transport */
void fake_before(void *fixture);

/* Sends g_payload2 with a 10 ms timeout; a helper thread entry */
int send_payload2(void *arg);

/* Helper threads: index 0 and 1 (the slot after them is the lock probe) */
#define HELPER_COUNT 2

void helper_start(int idx, int (*fn)(void *arg), void *arg);

/* Joins the helper (aborted on timeout); returns its result or -EAGAIN on timeout */
int helper_join(int idx, k_timeout_t timeout, int *result);

#endif /* TEST_HIO_CLOUD_FAKE_BACKEND_H_ */
```

## src/mock_fw.c
```c
/*
 * Copyright (c) 2026 HARDWARIO a.s.
 *
 * SPDX-License-Identifier: LicenseRef-HARDWARIO-5-Clause
 */

/* Mock MCUboot image state and the stored firmware update id (hio_cloud_util.c is not
 * compiled here) for the firmware confirmation of hio_cloud.c (compiled with
 * CONFIG_MCUBOOT_IMG_MANAGER), in the scenario selected by TEST_FW. */

#include "fake_backend.h"
#include "hio_cloud_msg.h"
#include "hio_cloud_util.h"

/* Zephyr includes */
#include <zephyr/dfu/mcuboot.h>

/* Standard includes */
#include <errno.h>
#include <stdbool.h>
#include <string.h>

const uint8_t TEST_FW_UPDATE_ID[16] = {0xf0, 0xe1, 0xd2, 0xc3, 0xb4, 0xa5, 0x96, 0x87,
				       0x78, 0x69, 0x5a, 0x4b, 0x3c, 0x2d, 0x1e, 0x0f};

static bool m_confirmed = true;
static int m_confirm_calls;
static bool m_id_stored;

bool boot_is_img_confirmed(void)
{
	return m_confirmed;
}

int boot_write_img_confirmed(void)
{
	m_confirm_calls++;

#if TEST_FW == 4
	/* The flash write fails */
	return -EIO;
#else
	m_confirmed = true;

	return 0;
#endif
}

int hio_cloud_util_get_firmware_update_id(hio_cloud_uuid_t uuid)
{
	if (!m_id_stored) {
		return -ENOENT;
	}

	memcpy(uuid, TEST_FW_UPDATE_ID, sizeof(hio_cloud_uuid_t));

	return 0;
}

int hio_cloud_util_delete_firmware_update_id(void)
{
	m_id_stored = false;

	return 0;
}

int mock_boot_confirm_calls(void)
{
	return m_confirm_calls;
}

bool mock_fw_update_id_stored(void)
{
	return m_id_stored;
}

void mock_fw_setup(void)
{
	/* 3: MCUboot reverted the update, the old image runs confirmed; otherwise the image
	 * has just been swapped in and is not confirmed yet */
	m_confirmed = TEST_FW == 3;
	m_id_stored = TEST_FW >= 1;

#if TEST_FW == 2
	fake_fail_first_of_type(UL_UPLOAD_FIRMWARE, -EIO);
#endif
}
```

## src/stubs.c
```c
/*
 * Copyright (c) 2026 HARDWARIO a.s.
 *
 * SPDX-License-Identifier: LicenseRef-HARDWARIO-5-Clause
 */

/* Link stubs for the hio_cloud.c externals. Only the init handshake (CREATE
 * SESSION answered by SET SESSION) and the packets of the guarded functions
 * are functional; config/decoder/encoder uploads are skipped (no decoder and
 * encoder set, the config hash matches the session). */

#include "hio_cloud_config.h"
#include "hio_cloud_msg.h"
#include "hio_cloud_process.h"

/* HIO includes */
#include <hio/hio_buf.h>
#include <hio/hio_cloud.h>
#include <hio/hio_config.h>
#include <hio/hio_info.h>
#include <hio/hio_rtc.h>

/* Standard includes */
#include <errno.h>
#include <string.h>

int hio_cloud_msg_pack_create_session(struct hio_buf *buf)
{
	return hio_buf_append_u8(buf, UL_CREATE_SESSION);
}

int hio_cloud_msg_unpack_set_session(struct hio_buf *buf, struct hio_cloud_session *session)
{
	memset(session, 0, sizeof(*session));
	session->id = 1;

	return 0;
}

int hio_cloud_msg_unpack_set_timestamp(struct hio_buf *buf, int64_t *timestamp)
{
	return -ENOTSUP;
}

int hio_cloud_msg_pack_decoder(struct hio_buf *buf, uint64_t hash, const uint8_t *decoder_buf,
			       size_t decoder_len)
{
	return -ENOTSUP;
}

int hio_cloud_msg_pack_encoder(struct hio_buf *buf, uint64_t hash, const uint8_t *encoder_buf,
			       size_t encoder_len)
{
	return -ENOTSUP;
}

int hio_cloud_msg_pack_config(struct hio_buf *buf)
{
#if TEST_CONFIG_PACK_FAIL
	/* e.g. the config does not fit */
	return -ENOSPC;
#else
	return 0;
#endif
}

int hio_cloud_msg_unpack_config(struct hio_buf *buf, struct hio_cloud_msg_dlconfig *config)
{
	return -ENOTSUP;
}

int hio_cloud_msg_get_hash(struct hio_buf *buf, uint64_t *hash)
{
	/* Same as the session config hash: no config upload */
	*hash = 0;

	return 0;
}

int hio_cloud_msg_config_hash(uint64_t *hash)
{
	return -ENOTSUP;
}

int hio_cloud_msg_unpack_dlshell(struct hio_buf *buf, struct hio_cloud_msg_dlshell *msg)
{
	return -ENOTSUP;
}

int hio_cloud_msg_pack_firmware(struct hio_buf *buf, const struct hio_cloud_upfirmware *upfirmware)
{
	/* A real packet type, different from the data packet, so that a nested
	 * hio_cloud_firmware_update() that gets through visibly breaks the message */
	int ret = hio_buf_append_u8(buf, UL_UPLOAD_FIRMWARE);

	if (ret) {
		return ret;
	}

	if (!upfirmware->firmware) {
		/* The ack of an update: its id, for the test to check */
		return hio_buf_append_mem(buf, upfirmware->id, sizeof(hio_cloud_uuid_t));
	}

	return hio_buf_append_str(buf, upfirmware->firmware);
}

int hio_cloud_msg_unpack_dlfirmware(struct hio_buf *buf,
				    struct hio_cloud_msg_dlfirmware *dlfirmware)
{
	return -ENOTSUP;
}

int hio_cloud_process_dlconfig(struct hio_cloud_msg_dlconfig *msg)
{
	return -ENOTSUP;
}

int hio_cloud_process_dlshell(struct hio_cloud_msg_dlshell *msg, struct hio_buf *buf)
{
	return -ENOTSUP;
}

int hio_cloud_process_dlfirmware(struct hio_cloud_msg_dlfirmware *msg, struct hio_buf *buf)
{
	return -ENOTSUP;
}

void hio_cloud_process_get_dfu_status(struct hio_cloud_dfu_status *status)
{
	memset(status, 0, sizeof(*status));
}

int hio_cloud_config_init(void)
{
	return 0;
}

int hio_info_get_serial_number_uint32(uint32_t *serial_number)
{
	*serial_number = 1;

	return 0;
}

int hio_info_get_claim_token(const char **claim_token)
{
	*claim_token = "00112233445566778899aabbccddeeff";

	return 0;
}

int hio_rtc_set_ts(int64_t ts)
{
	return 0;
}

int hio_rtc_get_ts(int64_t *ts)
{
	*ts = 0;

	return 0;
}

uint32_t hio_config_get_gen(void)
{
	return 0;
}

bool hio_config_is_dirty(void)
{
	return false;
}

int hio_config_iter_modules(hio_config_module_cb_t cb, void *user_data)
{
	return 0;
}
```

## src/test_firmware.c
```c
/*
 * Copyright (c) 2026 HARDWARIO a.s.
 *
 * SPDX-License-Identifier: LicenseRef-HARDWARIO-5-Clause
 */

/* The confirmation of the running image and the ack of a firmware update done by the
 * init work, in the scenario TEST_FW (see mock_fw_setup()). */

#include "fake_backend.h"
#include "hio_cloud_msg.h"

/* Zephyr includes */
#include <zephyr/kernel.h>
#include <zephyr/ztest.h>

/* Standard includes */
#include <errno.h>
#include <string.h>

ZTEST_SUITE(hio_cloud_firmware, phase_started, NULL, NULL, NULL, NULL);

#if TEST_CONFIG_PACK_FAIL
/* A local error of the config comes again on every attempt: the init goes on without it */
ZTEST(hio_cloud_firmware, test_init_without_config)
{
	zassert_true(fake_log_find(UL_CREATE_SESSION) >= 0);
	zassert_equal(fake_log_find(UL_UPLOAD_CONFIG), -1);
}
#endif

ZTEST(hio_cloud_firmware, test_firmware_update_ack)
{
	int session = fake_log_find(UL_CREATE_SESSION);
	int ack = fake_log_find(UL_UPLOAD_FIRMWARE);

	zassert_true(session >= 0);

#if TEST_FW == 0
	/* No update id stored (an update by AT$FW, or the id got lost): the image is
	 * confirmed, but there is nothing to ack (no ack with an uninitialized id) */
	zassert_equal(ack, -1, "ack at %d", ack);
	zassert_equal(mock_boot_confirm_calls(), 1);
	zassert_false(mock_fw_update_id_stored());
#elif TEST_FW == 3
	/* An update id stored, but the image was confirmed before (MCUboot reverted the
	 * update): no ack, and the id is dropped */
	zassert_equal(ack, -1, "ack at %d", ack);
	zassert_equal(mock_boot_confirm_calls(), 0);
	zassert_false(mock_fw_update_id_stored());
#elif TEST_FW == 4
	/* The image cannot be confirmed, so MCUboot reverts it at the next reset: no ack, but
	 * the init goes on, and the id stays for the old image to drop */
	zassert_equal(ack, -1, "ack at %d", ack);
	zassert_equal(mock_boot_confirm_calls(), 1);
	zassert_true(mock_fw_update_id_stored());
#else
	/* Confirmed and acked right after the session */
	zassert_equal(ack, session + 1, "ack at %d, session at %d", ack, session);
	zassert_equal(mock_boot_confirm_calls(), 1);

	const struct fake_log_entry *e = fake_log(ack);

	zassert_equal(e->len, 1 + sizeof(TEST_FW_UPDATE_ID));
	zassert_mem_equal(&e->head[1], TEST_FW_UPDATE_ID, sizeof(TEST_FW_UPDATE_ID));

#if TEST_FW == 2
	/* The first ack fails and goes again 10 s later, in the same boot: that the image is
	 * confirmed by then must not drop the id */
	zassert_equal(e->ret, -EIO);

	const struct fake_log_entry *again = fake_log(ack + 1);

	zassert_not_null(again);
	zassert_equal(again->head[0], UL_UPLOAD_FIRMWARE, "uplink after the failed ack: 0x%02x",
		      again->head[0]);
	zassert_mem_equal(&again->head[1], TEST_FW_UPDATE_ID, sizeof(TEST_FW_UPDATE_ID));
	zassert_within(again->at - e->at, 10000, 100, "ack again %lld ms after the failed one",
		       again->at - e->at);

	e = again;
#endif

	zassert_equal(e->ret, 0);
	/* Acked: the id is dropped */
	zassert_false(mock_fw_update_id_stored());
#endif
}
```

## src/test_send_data.c
```c
/*
 * Copyright (c) 2026 HARDWARIO a.s.
 *
 * SPDX-License-Identifier: LicenseRef-HARDWARIO-5-Clause
 */

/* Characterization of the buffer API (hio_cloud_send_data). Uses nothing but
 * the buffer API, so the same file also runs against the hio_cloud.c of the
 * commit before the callback API (byte-identical messages and return codes). */

#include "fake_backend.h"

/* HIO includes */
#include <hio/hio_cloud.h>

/* Zephyr includes */
#include <zephyr/kernel.h>
#include <zephyr/ztest.h>

/* Standard includes */
#include <errno.h>
#include <limits.h>
#include <string.h>

/* ---- Before hio_cloud_init() ---- */

ZTEST_SUITE(hio_cloud_send_data_before_init, phase_before_init, NULL, fake_before, NULL, NULL);

ZTEST(hio_cloud_send_data_before_init, test_einval_before_init)
{
	/* Arguments are checked first */
	zassert_equal(hio_cloud_send_data(NULL, 1, K_FOREVER), -EINVAL);
	zassert_equal(hio_cloud_send_data(g_payload, 0, K_FOREVER), -EINVAL);
}

ZTEST(hio_cloud_send_data_before_init, test_eperm_before_init)
{
	zassert_equal(hio_cloud_send_data(g_payload, sizeof(g_payload), K_FOREVER), -EPERM);
	zassert_equal(g_fake.uplink_count, 0);
}

/* Runs after the *_before_init suites (alphabetical order) */
ZTEST_SUITE(hio_cloud_send_data_failed_init, phase_before_init, NULL, fake_before, NULL, NULL);

ZTEST(hio_cloud_send_data_failed_init, test_eperm_after_failed_init)
{
	static struct hio_cloud_options options = {.decoder_hash = HASH};

	g_fake.init_ret = -EIO;

	zassert_equal(hio_cloud_init(&options), -EIO);
	zassert_equal(hio_cloud_send_data(g_payload, sizeof(g_payload), K_FOREVER), -EPERM);
	zassert_equal(g_fake.uplink_count, 0);
}

/* ---- After hio_cloud_init() ---- */

ZTEST_SUITE(hio_cloud_send_data, phase_started, NULL, fake_before, NULL, NULL);

ZTEST(hio_cloud_send_data, test_capacity)
{
	const size_t max = HIO_CLOUD_TRANSFER_BUF_SIZE - HDR_LEN;

	for (size_t i = 0; i < sizeof(g_big); i++) {
		g_big[i] = i;
	}

	zassert_ok(hio_cloud_send_data(g_big, max, K_FOREVER));
	zassert_equal(g_fake.uplink_count, 1);
	assert_data_msg(0, g_big, max);
	assert_data_msg_crc(0, g_big, max);
	zassert_equal(g_fake.uplinks[0].len, HIO_CLOUD_TRANSFER_BUF_SIZE);

	zassert_equal(hio_cloud_send_data(g_big, max + 1, K_FOREVER), -ENOSPC);
	settle();
	zassert_equal(g_fake.uplink_count, 1);
	zassert_equal(g_fake.downlink_count, 0);
	assert_lock_free();
}

ZTEST(hio_cloud_send_data, test_downlink_deferred)
{
	g_fake.uplink_has_downlink = true;

	zassert_ok(hio_cloud_send_data(g_payload, sizeof(g_payload), K_FOREVER));
	zassert_equal(g_fake.uplink_count, 1);

	/* Fetched by the poll worker, not on the caller's stack */
	zassert_ok(fake_wait_downlink(K_SECONDS(1)));
	zassert_equal(g_fake.downlink_count, 1);
	zassert_not_equal(g_fake.downlink_thread, k_current_get());
}

ZTEST(hio_cloud_send_data, test_einval)
{
	zassert_equal(hio_cloud_send_data(NULL, 1, K_FOREVER), -EINVAL);
	zassert_equal(hio_cloud_send_data(g_payload, 0, K_FOREVER), -EINVAL);
	settle();
	zassert_equal(g_fake.uplink_count, 0);
	zassert_equal(g_fake.downlink_count, 0);
}

ZTEST(hio_cloud_send_data, test_msg_bytes)
{
	zassert_ok(hio_cloud_send_data(g_payload, sizeof(g_payload), K_MSEC(1234)));

	zassert_equal(g_fake.uplink_count, 1);
	assert_data_msg(0, g_payload, sizeof(g_payload));
	zassert_equal(g_fake.uplinks[0].buf_size, HIO_CLOUD_TRANSFER_BUF_SIZE);
	zassert_equal(g_fake.uplinks[0].thread, k_current_get());

	/* The timeout goes to the transfer unchanged */
	zassert_equal(g_fake.uplinks[0].timeout.ticks, K_MSEC(1234).ticks);
}

static int send_payload(void *arg)
{
	return hio_cloud_send_data(g_payload, sizeof(g_payload), K_MSEC(10));
}

ZTEST(hio_cloud_send_data, test_lock_waits_forever)
{
	int ret1 = INT_MIN;
	int ret2 = INT_MIN;

	g_fake.uplink_block = 1;

	/* Helper 0 holds the cloud lock in the transfer */
	helper_start(0, send_payload, NULL);
	zassert_ok(fake_wait_uplink_blocked(K_SECONDS(1)));

	/* Helper 1 waits for the lock longer than its timeout */
	helper_start(1, send_payload2, NULL);
	k_sleep(K_MSEC(100));
	zassert_equal(g_fake.uplink_count, 1);

	fake_release();

	zassert_ok(helper_join(0, K_SECONDS(1), &ret1));
	zassert_ok(helper_join(1, K_SECONDS(1), &ret2));
	zassert_ok(ret1);
	zassert_ok(ret2);

	zassert_equal(g_fake.uplink_count, 2);
	assert_data_msg(0, g_payload, sizeof(g_payload));
	assert_data_msg(1, g_payload2, sizeof(g_payload2));

	/* The timeout applies to the transfer only, not to the lock wait */
	zassert_equal(g_fake.uplinks[1].timeout.ticks, K_MSEC(10).ticks);
}

ZTEST(hio_cloud_send_data, test_transfer_error)
{
	g_fake.uplink_ret = -EIO;

	zassert_equal(hio_cloud_send_data(g_payload, sizeof(g_payload), K_FOREVER), -EIO);
	zassert_equal(g_fake.uplink_count, 1);
	assert_lock_free();
}
```

## src/test_send_data_cb.c
```c
/*
 * Copyright (c) 2026 HARDWARIO a.s.
 *
 * SPDX-License-Identifier: LicenseRef-HARDWARIO-5-Clause
 */

/* The callback API (hio_cloud_send_data_cb) and the reentrancy guard */

#include "fake_backend.h"

/* HIO includes */
#include <hio/hio_cloud.h>

/* Zephyr includes */
#include <zephyr/kernel.h>
#include <zephyr/sys/byteorder.h>
#include <zephyr/ztest.h>

/* Third-party includes */
#include <zcbor_encode.h>

/* Standard includes */
#include <errno.h>
#include <limits.h>
#include <string.h>

static K_SEM_DEFINE(m_entered, 0, 1);
static K_SEM_DEFINE(m_release, 0, 1);

static void *m_last_user_data;

/* Calls of the callback of the nested send_data_cb() */
static int m_inner_calls;

struct cb_ctx {
	int calls;
	int ret;           /* Returned by the callback */
	bool entered;      /* Give m_entered when called */
	bool release;      /* Then wait for m_release */
	k_timeout_t sleep; /* Sleep after encoding */
};

static int cb_map_1_42(zcbor_state_t *zs, void *user_data)
{
	struct cb_ctx *ctx = user_data;

	m_last_user_data = user_data;
	ctx->calls++;

	if (ctx->entered) {
		k_sem_give(&m_entered);
	}

	if (ctx->release) {
		/* Bounded, so that a broken test cannot hang the run */
		k_sem_take(&m_release, K_SECONDS(2));
	}

	zcbor_map_start_encode(zs, 1);
	zcbor_uint32_put(zs, 1);
	zcbor_uint32_put(zs, 42);
	zcbor_map_end_encode(zs, 1);

	if (!K_TIMEOUT_EQ(ctx->sleep, K_NO_WAIT)) {
		k_sleep(ctx->sleep);
	}

	return ctx->ret;
}

static void before(void *fixture)
{
	fake_before(fixture);
	k_sem_reset(&m_entered);
	k_sem_reset(&m_release);
	m_last_user_data = NULL;
	m_inner_calls = 0;
}

/* Nothing sent or fetched, also not by the poll worker */
static void assert_nothing_transferred(void)
{
	settle();
	zassert_equal(g_fake.uplink_count, 0);
	zassert_equal(g_fake.downlink_count, 0);
}

/* ---- Before hio_cloud_init() ---- */

ZTEST_SUITE(hio_cloud_send_data_cb_before_init, phase_before_init, NULL, before, NULL, NULL);

ZTEST(hio_cloud_send_data_cb_before_init, test_einval_before_init)
{
	/* Arguments are checked first */
	zassert_equal(hio_cloud_send_data_cb(NULL, NULL, K_FOREVER), -EINVAL);
}

ZTEST(hio_cloud_send_data_cb_before_init, test_eperm_before_init)
{
	struct cb_ctx ctx = {0};

	zassert_equal(hio_cloud_send_data_cb(cb_map_1_42, &ctx, K_FOREVER), -EPERM);
	zassert_equal(ctx.calls, 0);
	zassert_equal(g_fake.uplink_count, 0);
}

/* Runs after the *_before_init suites (alphabetical order) */
ZTEST_SUITE(hio_cloud_send_data_cb_failed_init, phase_before_init, NULL, before, NULL, NULL);

ZTEST(hio_cloud_send_data_cb_failed_init, test_eperm_after_failed_init)
{
	static struct hio_cloud_options options = {.decoder_hash = HASH};
	struct cb_ctx ctx = {0};

	g_fake.init_ret = -EIO;

	zassert_equal(hio_cloud_init(&options), -EIO);
	zassert_equal(hio_cloud_send_data_cb(cb_map_1_42, &ctx, K_FOREVER), -EPERM);
	zassert_equal(ctx.calls, 0);
	zassert_equal(g_fake.uplink_count, 0);
}

/* ---- After hio_cloud_init() ---- */

ZTEST_SUITE(hio_cloud_send_data_cb, phase_started, NULL, before, NULL, NULL);

ZTEST(hio_cloud_send_data_cb, test_cb_error_nothing_sent)
{
	struct cb_ctx ctx = {.ret = -EIO};

	zassert_equal(hio_cloud_send_data_cb(cb_map_1_42, &ctx, K_FOREVER), -EIO);
	zassert_equal(ctx.calls, 1);
	assert_nothing_transferred();
	assert_lock_free();
}

ZTEST(hio_cloud_send_data_cb, test_deadline_expired_after_encode)
{
	struct cb_ctx ctx = {.sleep = K_MSEC(100)};

	zassert_equal(hio_cloud_send_data_cb(cb_map_1_42, &ctx, K_MSEC(50)), -ETIMEDOUT);
	zassert_equal(ctx.calls, 1);
	assert_nothing_transferred();
	assert_lock_free();
}

ZTEST(hio_cloud_send_data_cb, test_downlink_deferred)
{
	struct cb_ctx ctx = {0};

	g_fake.uplink_has_downlink = true;

	zassert_ok(hio_cloud_send_data_cb(cb_map_1_42, &ctx, K_FOREVER));
	zassert_equal(g_fake.uplink_count, 1);

	/* Fetched by the poll worker, not on the caller's stack */
	zassert_ok(fake_wait_downlink(K_SECONDS(1)));
	zassert_equal(g_fake.downlink_count, 1);
	zassert_not_equal(g_fake.downlink_thread, k_current_get());
}

static int send_cb_held(void *arg)
{
	return hio_cloud_send_data_cb(cb_map_1_42, arg, K_FOREVER);
}

ZTEST(hio_cloud_send_data_cb, test_eagain_lock_busy)
{
	struct cb_ctx held = {.entered = true, .release = true};
	struct cb_ctx ctx = {0};
	int ret = INT_MIN;

	/* Helper 0 holds the cloud lock in its callback */
	helper_start(0, send_cb_held, &held);
	zassert_ok(k_sem_take(&m_entered, K_SECONDS(1)));

	int64_t start = k_uptime_get();

	zassert_equal(hio_cloud_send_data_cb(cb_map_1_42, &ctx, K_MSEC(50)), -EAGAIN);
	zassert_true(k_uptime_get() - start >= 50);

	/* Not -EBUSY of k_mutex_lock() */
	zassert_equal(hio_cloud_send_data_cb(cb_map_1_42, &ctx, K_NO_WAIT), -EAGAIN);
	zassert_equal(ctx.calls, 0);

	k_sem_give(&m_release);

	zassert_ok(helper_join(0, K_SECONDS(1), &ret));
	zassert_ok(ret);
	zassert_equal(held.calls, 1);
	zassert_equal(g_fake.uplink_count, 1);
	assert_data_msg(0, g_payload, sizeof(g_payload));
}

static int cb_empty(zcbor_state_t *zs, void *user_data)
{
	(*(int *)user_data)++;

	return 0;
}

ZTEST(hio_cloud_send_data_cb, test_empty_nothing_sent)
{
	int calls = 0;

	zassert_equal(hio_cloud_send_data_cb(cb_empty, &calls, K_FOREVER), -EINVAL);
	zassert_equal(calls, 1);
	assert_nothing_transferred();
	assert_lock_free();
}

struct fill_ctx {
	size_t extra; /* Bytes over the exact fit */
	size_t free_before;
	size_t free_after;
};

static int cb_fill(zcbor_state_t *zs, void *user_data)
{
	struct fill_ctx *ctx = user_data;

	ctx->free_before = hio_cloud_cbor_free(zs);

	/* 3 bytes of the bstr head (0x59 + u16 length) */
	zcbor_bstr_encode_ptr(zs, g_big, ctx->free_before - 3 + ctx->extra);

	ctx->free_after = hio_cloud_cbor_free(zs);

	return 0;
}

ZTEST(hio_cloud_send_data_cb, test_exact_capacity)
{
	const size_t max = HIO_CLOUD_TRANSFER_BUF_SIZE - HDR_LEN;
	struct fill_ctx exact = {0};
	struct fill_ctx over = {.extra = 1};
	uint8_t expected[FAKE_HEAD_LEN - HDR_LEN];
	static uint8_t full[HIO_CLOUD_TRANSFER_BUF_SIZE];

	for (size_t i = 0; i < sizeof(g_big); i++) {
		g_big[i] = i;
	}

	zassert_ok(hio_cloud_send_data_cb(cb_fill, &exact, K_FOREVER));
	zassert_equal(exact.free_before, max);
	zassert_equal(exact.free_after, 0);

	full[0] = 0x59;
	sys_put_be16(max - 3, &full[1]);
	expected[0] = 0x59;
	sys_put_be16(max - 3, &expected[1]);
	memcpy(&expected[3], g_big, sizeof(expected) - 3);

	zassert_equal(g_fake.uplink_count, 1);
	assert_data_msg(0, expected, max);
	memcpy(&full[3], g_big, max - 3);
	assert_data_msg_crc(0, full, max);
	zassert_equal(g_fake.uplinks[0].len, HIO_CLOUD_TRANSFER_BUF_SIZE);
	zassert_equal(g_fake.uplinks[0].buf_size, HIO_CLOUD_TRANSFER_BUF_SIZE);

	zassert_equal(hio_cloud_send_data_cb(cb_fill, &over, K_FOREVER), -ENOSPC);
	settle();
	zassert_equal(g_fake.uplink_count, 1);
	zassert_equal(g_fake.downlink_count, 0);
}

ZTEST(hio_cloud_send_data_cb, test_flag_cleared_after_error)
{
	struct cb_ctx fail = {.ret = -EIO};
	struct cb_ctx ctx = {0};

	zassert_equal(hio_cloud_send_data_cb(cb_map_1_42, &fail, K_FOREVER), -EIO);

	/* Not taken for a call from a callback */
	zassert_ok(hio_cloud_send_data(g_payload2, sizeof(g_payload2), K_FOREVER));
	zassert_ok(hio_cloud_send_data_cb(cb_map_1_42, &ctx, K_FOREVER));

	zassert_equal(g_fake.uplink_count, 2);
	assert_data_msg(0, g_payload2, sizeof(g_payload2));
	assert_data_msg(1, g_payload, sizeof(g_payload));
}

ZTEST(hio_cloud_send_data_cb, test_forever_timeout)
{
	struct cb_ctx ctx = {0};

	zassert_ok(hio_cloud_send_data_cb(cb_map_1_42, &ctx, K_FOREVER));
	zassert_equal(g_fake.uplink_count, 1);
	zassert_true(K_TIMEOUT_EQ(g_fake.uplinks[0].timeout, K_FOREVER));
}

ZTEST(hio_cloud_send_data_cb, test_msg_bytes)
{
	struct cb_ctx ctx = {0};

	zassert_ok(hio_cloud_send_data_cb(cb_map_1_42, &ctx, K_MSEC(1234)));
	zassert_equal(ctx.calls, 1);
	zassert_equal_ptr(m_last_user_data, &ctx);

	zassert_equal(g_fake.uplink_count, 1);
	assert_data_msg(0, g_payload, sizeof(g_payload));
	zassert_equal(g_fake.uplinks[0].buf_size, HIO_CLOUD_TRANSFER_BUF_SIZE);
	zassert_equal(g_fake.uplinks[0].thread, k_current_get());
}

ZTEST(hio_cloud_send_data_cb, test_matches_send_data)
{
	struct cb_ctx ctx = {0};

	zassert_ok(hio_cloud_send_data(g_payload, sizeof(g_payload), K_FOREVER));
	zassert_ok(hio_cloud_send_data_cb(cb_map_1_42, &ctx, K_FOREVER));

	zassert_equal(g_fake.uplink_count, 2);
	zassert_equal(g_fake.uplinks[0].len, g_fake.uplinks[1].len);
	zassert_mem_equal(g_fake.uplinks[0].head, g_fake.uplinks[1].head, g_fake.uplinks[0].len);
}

ZTEST(hio_cloud_send_data_cb, test_no_wait_never_encodes)
{
	struct cb_ctx ctx = {0};

	/* The lock is free, but the deadline has passed before the callback */
	zassert_equal(hio_cloud_send_data_cb(cb_map_1_42, &ctx, K_NO_WAIT), -ETIMEDOUT);
	zassert_equal(ctx.calls, 0);
	assert_nothing_transferred();
	assert_lock_free();
}

ZTEST(hio_cloud_send_data_cb, test_other_thread_send_data_waits)
{
	struct cb_ctx held = {.entered = true, .release = true};
	int ret0 = INT_MIN;
	int ret1 = INT_MIN;

	/* Helper 0 holds the cloud lock in its callback */
	helper_start(0, send_cb_held, &held);
	zassert_ok(k_sem_take(&m_entered, K_SECONDS(1)));

	/* Another thread is not mistaken for a nested call: it waits */
	helper_start(1, send_payload2, NULL);
	k_sleep(K_MSEC(100));
	zassert_equal(g_fake.uplink_count, 0);

	k_sem_give(&m_release);

	zassert_ok(helper_join(0, K_SECONDS(1), &ret0));
	zassert_ok(helper_join(1, K_SECONDS(1), &ret1));
	zassert_ok(ret0);
	zassert_ok(ret1);

	zassert_equal(g_fake.uplink_count, 2);
	assert_data_msg(0, g_payload, sizeof(g_payload));
	assert_data_msg(1, g_payload2, sizeof(g_payload2));
}

static int cb_overflow(zcbor_state_t *zs, void *user_data)
{
	size_t *free = user_data;

	*free = hio_cloud_cbor_free(zs);

	/* The error is ignored on purpose: the zcbor state keeps it */
	(void)hio_cloud_cbor_put_raw(zs, g_big, *free + 1);

	return 0;
}

ZTEST(hio_cloud_send_data_cb, test_overflow_nothing_sent)
{
	size_t free = 0;

	zassert_equal(hio_cloud_send_data_cb(cb_overflow, &free, K_FOREVER), -ENOSPC);
	zassert_equal(free, HIO_CLOUD_TRANSFER_BUF_SIZE - HDR_LEN);
	assert_nothing_transferred();
	assert_lock_free();
}

ZTEST(hio_cloud_send_data_cb, test_remaining_timeout_after_encode)
{
	struct cb_ctx ctx = {.sleep = K_MSEC(100)};

	zassert_ok(hio_cloud_send_data_cb(cb_map_1_42, &ctx, K_MSEC(1000)));
	zassert_equal(g_fake.uplink_count, 1);

	assert_timeout_in_ms(0, 800, 900);
}

ZTEST(hio_cloud_send_data_cb, test_remaining_timeout_after_lock_wait)
{
	struct cb_ctx held = {.entered = true, .sleep = K_MSEC(100)};
	struct cb_ctx ctx = {0};
	int ret = INT_MIN;

	/* Helper 0 holds the cloud lock in its callback for 100 ms */
	helper_start(0, send_cb_held, &held);
	zassert_ok(k_sem_take(&m_entered, K_SECONDS(1)));

	zassert_ok(hio_cloud_send_data_cb(cb_map_1_42, &ctx, K_MSEC(1000)));

	zassert_ok(helper_join(0, K_SECONDS(1), &ret));
	zassert_ok(ret);
	zassert_equal(g_fake.uplink_count, 2);

	assert_timeout_in_ms(1, 800, 900);
}

ZTEST(hio_cloud_send_data_cb, test_transfer_error)
{
	struct cb_ctx ctx = {0};

	g_fake.uplink_ret = -EIO;

	zassert_equal(hio_cloud_send_data_cb(cb_map_1_42, &ctx, K_FOREVER), -EIO);
	zassert_equal(g_fake.uplink_count, 1);
	assert_lock_free();
}

/* ---- Cloud API called from the callback ---- */

/* Differs from g_payload in the first byte: the transfer buffer reset only
 * clears the length, so an overwrite with the same bytes would go unnoticed */
static const uint8_t m_inner[] = {0xa1, 0x05, 0x06};

struct nested_ctx {
	int (*nested)(void);
	int nested_ret;
	size_t len_before;
	size_t len_after;
};

/* Encodes {1: 42} with the nested call between the key and the value */
static int cb_outer(zcbor_state_t *zs, void *user_data)
{
	struct nested_ctx *ctx = user_data;

	zcbor_map_start_encode(zs, 1);
	zcbor_uint32_put(zs, 1);

	ctx->len_before = hio_cloud_cbor_len(zs);
	ctx->nested_ret = ctx->nested();
	ctx->len_after = hio_cloud_cbor_len(zs);

	zcbor_uint32_put(zs, 42);
	zcbor_map_end_encode(zs, 1);

	return 0;
}

static void run_nested(int (*nested)(void))
{
	struct nested_ctx ctx = {.nested = nested, .nested_ret = INT_MIN};

	zassert_ok(hio_cloud_send_data_cb(cb_outer, &ctx, K_FOREVER));
	zassert_equal(ctx.nested_ret, -EDEADLK);

	/* The outer message is intact */
	zassert_equal(ctx.len_before, 2);
	zassert_equal(ctx.len_after, ctx.len_before);

	settle();
	zassert_equal(g_fake.uplink_count, 1);
	zassert_equal(g_fake.downlink_count, 0);
	assert_data_msg(0, g_payload, sizeof(g_payload));
	assert_data_msg_crc(0, g_payload, sizeof(g_payload));

	assert_lock_free();
}

ZTEST_SUITE(hio_cloud_send_data_cb_nested, phase_started, NULL, before, NULL, NULL);

static int nested_firmware_update(void)
{
	return hio_cloud_firmware_update("fw");
}

ZTEST(hio_cloud_send_data_cb_nested, test_nested_firmware_update)
{
	run_nested(nested_firmware_update);
}

static int nested_recv(void)
{
	return hio_cloud_recv();
}

ZTEST(hio_cloud_send_data_cb_nested, test_nested_recv)
{
	run_nested(nested_recv);
}

static int nested_send(void)
{
#pragma GCC diagnostic push
#pragma GCC diagnostic ignored "-Wdeprecated-declarations"
	return hio_cloud_send(m_inner, sizeof(m_inner));
#pragma GCC diagnostic pop
}

ZTEST(hio_cloud_send_data_cb_nested, test_nested_send)
{
	run_nested(nested_send);
}

static int nested_send_data(void)
{
	return hio_cloud_send_data(m_inner, sizeof(m_inner), K_FOREVER);
}

ZTEST(hio_cloud_send_data_cb_nested, test_nested_send_data)
{
	run_nested(nested_send_data);
}

static int cb_inner(zcbor_state_t *zs, void *user_data)
{
	m_inner_calls++;

	return zcbor_uint32_put(zs, 7) ? 0 : -EIO;
}

static int nested_send_data_cb(void)
{
	return hio_cloud_send_data_cb(cb_inner, NULL, K_FOREVER);
}

ZTEST(hio_cloud_send_data_cb_nested, test_nested_send_data_cb)
{
	run_nested(nested_send_data_cb);
	zassert_equal(m_inner_calls, 0);
}
```
