## CMakeLists.txt
```
cmake_minimum_required(VERSION 3.20.0)

find_package(Zephyr REQUIRED HINTS $ENV{ZEPHYR_BASE})

project(test)

# The hio_lte Kconfig is not part of this test build, so supply the symbols
# hio_lte.c needs at compile time (defaults taken from subsys/hio_lte/Kconfig).
add_compile_definitions(CONFIG_HIO_LTE_LOG_LEVEL=3)
add_compile_definitions(CONFIG_HIO_LTE_INIT_PRIORITY=99)
add_compile_definitions(CONFIG_HIO_LTE_SCAN_MAX_ENTRIES=10)
add_compile_definitions(CONFIG_HIO_LTE_SCAN_MAX_CELLS=14)
add_compile_definitions(CONFIG_HIO_LTE_CEREG_HISTORY=3)
add_compile_definitions(CONFIG_HIO_LTE_SCAN_AUTO=1)
add_compile_definitions(CONFIG_HIO_LTE_SCAN_AUTO_EVERY=1)

set(HIO_LTE_DIR ${CMAKE_CURRENT_SOURCE_DIR}/../../../subsys/hio_lte)

include_directories(${HIO_LTE_DIR})

# hio_lte_talk.h (pulled in by hio_lte.c) includes nrf_modem_at.h. Only the
# declarations are needed here — the modem library itself is faked away — so put
# nrfxlib's headers on the path rather than stubbing them.
include_directories(${ZEPHYR_BASE}/../nrfxlib/nrf_modem/include)
target_sources(app PRIVATE ${HIO_LTE_DIR}/hio_lte.c)
target_sources(app PRIVATE ${HIO_LTE_DIR}/hio_lte_parse.c)
target_sources(app PRIVATE ${HIO_LTE_DIR}/hio_lte_state.c)
target_sources(app PRIVATE ${HIO_LTE_DIR}/hio_lte_str.c)
target_sources(app PRIVATE ${HIO_LTE_DIR}/hio_lte_util.c)
target_sources(app PRIVATE src/fake_flow.c)
target_sources(app PRIVATE src/test_transaction.c)
target_sources(app PRIVATE src/test_scan.c)
```

## prj.conf
```kconfig
CONFIG_ZTEST=y

# hio_lte signals transaction completion with k_event.
CONFIG_EVENTS=y
CONFIG_HEAP_MEM_POOL_SIZE=256
CONFIG_MAIN_STACK_SIZE=4096

CONFIG_LOG=y
CONFIG_CBPRINTF_FP_SUPPORT=y

CONFIG_REQUIRES_FULL_LIBC=y
```

## src/fake_flow.c
```c
/*
 * Copyright (c) 2026 HARDWARIO a.s.
 *
 * SPDX-License-Identifier: LicenseRef-HARDWARIO-5-Clause
 */

/* Link-level fakes for hio_lte.c's dependencies. Flow calls succeed; modem
 * events are injected by the test via fake_flow_event_cb. */

#include "hio_lte_config.h"
#include "hio_lte_flow.h"
#include "hio_lte_talk.h"

#include <hio/hio_lte.h>
#include <hio/hio_rtc.h>

#include <zephyr/kernel.h>

#include <stdint.h>

struct hio_lte_config g_hio_lte_config;

/* Observed by the tests: how many datagrams the FSM actually handed to the
 * modem, and the parameter block it used for the most recent one. */
atomic_t fake_flow_send_count = ATOMIC_INIT(0);
const struct hio_lte_send_recv_param *fake_flow_last_send_param;

/* Stands in for the time nrf_send() spends waiting for RRC. Holding the FSM
 * inside the send is what lets a caller's deadline expire while its param is
 * still published, which is the condition the transfer needs to go wrong. */
uint32_t fake_flow_send_block_ms;

/* Counts FSM entries into PREPARE (modem power-up). */
atomic_t fake_flow_start_count = ATOMIC_INIT(0);

HIO_LTE_FSM_EVENT_delegate_cb fake_flow_event_cb;

int hio_lte_config_init(void)
{
	return 0;
}

int hio_lte_flow_init(HIO_LTE_FSM_EVENT_delegate_cb cb)
{
	fake_flow_event_cb = cb;
	return 0;
}

int hio_lte_flow_send(const struct hio_lte_send_recv_param *param)
{
	fake_flow_last_send_param = param;
	atomic_inc(&fake_flow_send_count);

	if (fake_flow_send_block_ms != 0) {
		k_sleep(K_MSEC(fake_flow_send_block_ms));
	}

	return 0;
}

int hio_lte_flow_recv(const struct hio_lte_send_recv_param *param)
{
	ARG_UNUSED(param);
	return -ETIMEDOUT;
}

int hio_lte_flow_start(void)
{
	atomic_inc(&fake_flow_start_count);
	return 0;
}

int hio_lte_flow_stop(void)
{
	return 0;
}

int hio_lte_flow_prepare(void)
{
	return 0;
}

int hio_lte_flow_cfun(int cfun)
{
	ARG_UNUSED(cfun);
	return 0;
}

int hio_lte_flow_sim_info(void)
{
	return 0;
}

int hio_lte_flow_sim_fplmn(void)
{
	return 0;
}

int hio_lte_flow_open_socket(const struct hio_lte_socket_config *socket_config,
			     bool load_dtls_session)
{
	ARG_UNUSED(socket_config);
	ARG_UNUSED(load_dtls_session);
	return 0;
}

int hio_lte_flow_close_socket(bool save_dtls_session)
{
	ARG_UNUSED(save_dtls_session);
	return 0;
}

int hio_lte_flow_check(void)
{
	return 0;
}

int hio_lte_flow_set_sndtimeo(int timeout_sec)
{
	ARG_UNUSED(timeout_sec);
	return 0;
}

int hio_lte_flow_coneval(void)
{
	return 0;
}

int hio_lte_flow_cmd(const char *cmd)
{
	ARG_UNUSED(cmd);
	return 0;
}

int hio_lte_flow_set_psk(const char *identity, const char *psk_hex)
{
	ARG_UNUSED(identity);
	ARG_UNUSED(psk_hex);
	return 0;
}

/* Long enough for the test to inject REGISTERED before attach times out. */
#define FAKE_ATTACH_TIMEOUT K_SECONDS(60)

struct hio_lte_attach_timeout hio_lte_flow_attach_policy_periodic(int attempt, k_timeout_t pause)
{
	ARG_UNUSED(attempt);
	return (struct hio_lte_attach_timeout){.attach_timeout = FAKE_ATTACH_TIMEOUT,
					       .retry_delay = pause};
}

struct hio_lte_attach_timeout hio_lte_flow_attach_policy_progressive(int attempt)
{
	ARG_UNUSED(attempt);
	return (struct hio_lte_attach_timeout){.attach_timeout = FAKE_ATTACH_TIMEOUT,
					       .retry_delay = K_SECONDS(1)};
}

int hio_lte_talk_ncellmeas(int p1, int p2)
{
	ARG_UNUSED(p1);
	ARG_UNUSED(p2);
	return 0;
}

int hio_rtc_get_ts(int64_t *ts)
{
	if (ts != NULL) {
		*ts = 0;
	}
	return 0;
}
```

## src/fsm_helpers.h
```c
/*
 * Copyright (c) 2026 HARDWARIO a.s.
 *
 * SPDX-License-Identifier: LicenseRef-HARDWARIO-5-Clause
 */

#ifndef FSM_HELPERS_H_
#define FSM_HELPERS_H_

#include "hio_lte_config.h"
#include "hio_lte_flow.h"

#include <hio/hio_lte.h>

#include <zephyr/kernel.h>
#include <zephyr/ztest.h>

#include <string.h>

extern HIO_LTE_FSM_EVENT_delegate_cb fake_flow_event_cb;

/* Drive the FSM to READY, playing the modem's URCs. */
static inline void fsm_bring_up(void)
{
	static const struct hio_lte_socket_config cfg = {.port = 5002, .addr = "192.0.2.1"};

	zassert_ok(hio_lte_enable(&cfg));
	k_sleep(K_MSEC(50));
	fake_flow_event_cb(HIO_LTE_FSM_EVENT_SIMDETECTED);
	k_sleep(K_MSEC(50));
	fake_flow_event_cb(HIO_LTE_FSM_EVENT_REGISTERED);
	zassert_ok(hio_lte_wait_for_connected(K_SECONDS(1)), "FSM did not reach READY");
}

static inline bool fsm_in(const char *state)
{
	const char *current;

	return !hio_lte_get_fsm_state(&current) && !strcmp(current, state);
}

#endif /* FSM_HELPERS_H_ */
```

## src/test_scan.c
```c
/*
 * Copyright (c) 2026 HARDWARIO a.s.
 *
 * SPDX-License-Identifier: LicenseRef-HARDWARIO-5-Clause
 */

/* Network scan (SCAN state): CFUN=2, cells then networks, then reattach. */

#include "fsm_helpers.h"

#include <hio/hio_lte.h>

#include <zephyr/kernel.h>
#include <zephyr/ztest.h>

extern atomic_t fake_flow_scan_cells_count;
extern atomic_t fake_flow_scan_plmn_count;
extern bool fake_flow_scan_auto;
extern int fake_flow_last_cfun;
extern uint32_t fake_attach_timeout_ms;
extern uint32_t fake_retry_delay_ms;
extern atomic_t fake_flow_scan_abort_count;

/* Past the CFUN=4 -> CFUN=2 step and SCAN_SETTLE_DELAY. */
#define SETTLE_MS 3200

static void fsm_down(void)
{
	g_hio_lte_config.test = false;
	zassert_ok(hio_lte_disable());
	zassert_ok(hio_lte_wait_for_disable(K_SECONDS(10)));
}

static void scan_after(void *fixture)
{
	ARG_UNUSED(fixture);
	fsm_down();
}

static void scan_before(void *fixture)
{
	ARG_UNUSED(fixture);

	fsm_down();

	fake_attach_timeout_ms = 60000;
	fake_retry_delay_ms = 0;
	fake_flow_scan_auto = false;
	atomic_clear(&fake_flow_scan_cells_count);
	atomic_clear(&fake_flow_scan_plmn_count);
	atomic_clear(&fake_flow_scan_abort_count);
}

ZTEST_SUITE(hio_lte_scan, NULL, NULL, scan_before, scan_after, NULL);

ZTEST(hio_lte_scan, test_rejected_in_test_mode)
{
	g_hio_lte_config.test = true;
	zassert_equal(hio_lte_scan(HIO_LTE_SCAN_ALL), -ENOTSUP);
}

ZTEST(hio_lte_scan, test_rejected_when_disabled)
{
	zassert_equal(hio_lte_scan(HIO_LTE_SCAN_ALL), -ENODEV);
}

ZTEST(hio_lte_scan, test_rejects_invalid_mode)
{
	zassert_equal(hio_lte_scan(HIO_LTE_SCAN_CELLS + 1), -EINVAL);
}

/* From READY: RX-only, cells, networks, then a full reattach. */
ZTEST(hio_lte_scan, test_from_ready_runs_both_and_reattaches)
{
	fsm_bring_up();

	zassert_ok(hio_lte_scan(HIO_LTE_SCAN_ALL));
	k_sleep(K_MSEC(1100));
	zassert_true(fsm_in("scan"));
	zassert_equal(fake_flow_last_cfun, 2);
	zassert_equal(hio_lte_scan(HIO_LTE_SCAN_ALL), -EALREADY);
	zassert_equal(hio_lte_wait_for_scan(K_NO_WAIT), -ETIMEDOUT);

	k_sleep(K_MSEC(SETTLE_MS - 1100));
	zassert_equal(atomic_get(&fake_flow_scan_cells_count), 1);
	zassert_equal(atomic_get(&fake_flow_scan_plmn_count), 0);

	fake_flow_event_cb(HIO_LTE_FSM_EVENT_NCELLMEAS);
	k_sleep(K_MSEC(50));
	zassert_equal(atomic_get(&fake_flow_scan_plmn_count), 1);
	zassert_false(fake_flow_scan_auto);

	fake_flow_event_cb(HIO_LTE_FSM_EVENT_COPS_DONE);
	k_sleep(K_MSEC(50));
	zassert_true(fsm_in("prepare"));
	zassert_ok(hio_lte_wait_for_scan(K_NO_WAIT));

	fake_flow_event_cb(HIO_LTE_FSM_EVENT_SIMDETECTED);
	k_sleep(K_MSEC(50));
	fake_flow_event_cb(HIO_LTE_FSM_EVENT_REGISTERED);
	zassert_ok(hio_lte_wait_for_connected(K_SECONDS(1)), "no reconnect after scan");
}

ZTEST(hio_lte_scan, test_plmn_only_skips_cells)
{
	fsm_bring_up();

	zassert_ok(hio_lte_scan(HIO_LTE_SCAN_PLMN));
	k_sleep(K_MSEC(SETTLE_MS));
	zassert_equal(atomic_get(&fake_flow_scan_cells_count), 0);
	zassert_equal(atomic_get(&fake_flow_scan_plmn_count), 1);

	fake_flow_event_cb(HIO_LTE_FSM_EVENT_COPS_DONE);
	k_sleep(K_MSEC(50));
	zassert_true(fsm_in("prepare"));
}

ZTEST(hio_lte_scan, test_cells_only_skips_plmn)
{
	fsm_bring_up();

	zassert_ok(hio_lte_scan(HIO_LTE_SCAN_CELLS));
	k_sleep(K_MSEC(SETTLE_MS));
	zassert_equal(atomic_get(&fake_flow_scan_cells_count), 1);

	fake_flow_event_cb(HIO_LTE_FSM_EVENT_NCELLMEAS);
	k_sleep(K_MSEC(50));
	zassert_equal(atomic_get(&fake_flow_scan_plmn_count), 0);
	zassert_true(fsm_in("prepare"));
}

ZTEST(hio_lte_scan, test_interrupts_attach)
{
	static const struct hio_lte_socket_config cfg = {.port = 5002, .addr = "192.0.2.1"};

	zassert_ok(hio_lte_enable(&cfg));
	k_sleep(K_MSEC(50));
	fake_flow_event_cb(HIO_LTE_FSM_EVENT_SIMDETECTED);
	k_sleep(K_MSEC(50));
	zassert_true(fsm_in("attach"));

	zassert_ok(hio_lte_scan(HIO_LTE_SCAN_PLMN));
	k_sleep(K_MSEC(1100));
	zassert_true(fsm_in("scan"));
}

/* Plays %XSIM: 1 for PREPARE. Only there: the FSM event ring is small, and
 * flooding it drops real events. */
static bool m_sim_ticking;
static void sim_tick(struct k_work *work);
static K_WORK_DELAYABLE_DEFINE(m_sim_work, sim_tick);

static void sim_tick(struct k_work *work)
{
	ARG_UNUSED(work);

	if (!m_sim_ticking) {
		return;
	}
	if (fsm_in("prepare")) {
		fake_flow_event_cb(HIO_LTE_FSM_EVENT_SIMDETECTED);
	}
	k_work_schedule(&m_sim_work, K_MSEC(200));
}

/* Third failed attempt: the scan runs within the retry delay, which resumes
 * after it without counting another attempt. */
ZTEST(hio_lte_scan, test_auto_scan_in_retry_delay)
{
	static const struct hio_lte_socket_config cfg = {.port = 5002, .addr = "192.0.2.1"};

	fake_attach_timeout_ms = 100;
	/* Above SCAN_AUTO_MIN_DELAY. */
	fake_retry_delay_ms = 20 * 60 * 1000;

	zassert_ok(hio_lte_enable(&cfg));
	m_sim_ticking = true;
	k_work_schedule(&m_sim_work, K_MSEC(20));

	/* Two zero delays (5 s CFUN=4 settle each), then the third attempt. */
	for (int i = 0; i < 300 && atomic_get(&fake_flow_scan_cells_count) == 0; i++) {
		k_sleep(K_MSEC(100));
	}
	m_sim_ticking = false;

	zassert_equal(atomic_get(&fake_flow_scan_cells_count), 1, "auto scan did not run");
	zassert_true(fake_flow_scan_auto);

	fake_flow_event_cb(HIO_LTE_FSM_EVENT_NCELLMEAS);
	k_sleep(K_MSEC(50));
	fake_flow_event_cb(HIO_LTE_FSM_EVENT_COPS_DONE);
	k_sleep(K_SECONDS(6));
	zassert_true(fsm_in("retry_delay"));
	zassert_equal(fake_flow_last_cfun, 4);

	int attempt;
	zassert_ok(hio_lte_get_curr_attach_info(&attempt, NULL, NULL, NULL));
	zassert_equal(attempt, 3, "scan counted as an attach attempt");
}

/* While scanning the device is not connected: a transfer is refused at once
 * (-EBUSY, not counted as a server failure) instead of timing out. */
ZTEST(hio_lte_scan, test_send_during_scan_is_refused)
{
	static uint8_t uplink[16];

	fsm_bring_up();
	zassert_ok(hio_lte_scan(HIO_LTE_SCAN_PLMN));
	k_sleep(K_MSEC(1100));
	zassert_true(fsm_in("scan"));
	zassert_equal(hio_lte_wait_for_connected(K_NO_WAIT), -ETIMEDOUT,
		      "still reported as connected");

	struct hio_lte_send_recv_param param = {
		.send_buf = uplink,
		.send_len = sizeof(uplink),
		.timeout = K_SECONDS(5),
	};

	int64_t start = k_uptime_get();
	zassert_equal(hio_lte_send_recv(&param), -EBUSY);
	zassert_true(k_uptime_get() - start < 1000, "caller waited for its deadline");
}

/* Leaving the scan early publishes what it has; the request is gone after it. */
ZTEST(hio_lte_scan, test_disable_during_scan)
{
	fsm_bring_up();
	zassert_ok(hio_lte_scan(HIO_LTE_SCAN_ALL));
	k_sleep(K_MSEC(1100));
	zassert_true(fsm_in("scan"));

	zassert_ok(hio_lte_disable());
	zassert_ok(hio_lte_wait_for_disable(K_SECONDS(2)));
	zassert_equal(atomic_get(&fake_flow_scan_abort_count), 1);
	zassert_ok(hio_lte_wait_for_scan(K_NO_WAIT), "waiter not released");

	/* A late cell search result must not wake the modem. */
	fake_flow_event_cb(HIO_LTE_FSM_EVENT_NCELLMEAS);
	k_sleep(K_MSEC(50));
	zassert_true(fsm_in("disabled"));
}
```

## src/test_transaction.c
```c
/*
 * Copyright (c) 2026 HARDWARIO a.s.
 *
 * SPDX-License-Identifier: LicenseRef-HARDWARIO-5-Clause
 */

/* Ownership contract of hio_lte_send_recv().
 *
 * The param passed in is the caller's own storage — hio_cloud_transfer builds it
 * as a per-attempt stack local. hio_lte publishes it in m_send_recv_param so the
 * FSM work queue can act on it, which means the handle must not outlive the
 * call: once hio_lte_send_recv() returns, the FSM must no longer hold a pointer
 * into a frame the caller is about to reuse.
 *
 * These tests recreate the field condition by holding the FSM inside
 * hio_lte_flow_send() (fake_flow_send_block_ms) for longer than the caller's
 * deadline, which is what nrf_send() does while it waits for RRC. */

#include <hio/hio_lte.h>

#include <zephyr/kernel.h>
#include <zephyr/ztest.h>

/* Module-internal handle the FSM work queue reads (hio_lte.c). */
extern struct hio_lte_send_recv_param *m_send_recv_param;

extern atomic_t fake_flow_send_count;
extern const struct hio_lte_send_recv_param *fake_flow_last_send_param;
extern uint32_t fake_flow_send_block_ms;

#define UPLINK_LEN 481

/* Comfortably longer than CALLER_DEADLINE_MS, so the caller always gives up
 * first, and long enough that the FSM is still inside the send when it does. */
#define SEND_BLOCK_MS     400
#define CALLER_DEADLINE_MS 100

static uint8_t m_uplink[UPLINK_LEN];

static K_THREAD_STACK_DEFINE(m_holder_stack, 2048);
static struct k_thread m_holder_thread;

static struct hio_lte_send_recv_param m_holder_param;
static int m_holder_ret;

static void reset_fakes(void *fixture)
{
	ARG_UNUSED(fixture);

	/* Let any send left running by the previous test drain, so its
	 * bookkeeping cannot leak into this one. */
	k_sleep(K_MSEC(SEND_BLOCK_MS * 2));

	fake_flow_send_block_ms = 0;
	fake_flow_last_send_param = NULL;
	atomic_clear(&fake_flow_send_count);
}

ZTEST_SUITE(hio_lte_transaction, NULL, NULL, reset_fakes, NULL, NULL);

/* A caller that gives up must take its handle with it. */
ZTEST(hio_lte_transaction, test_timeout_releases_caller_param)
{
	fake_flow_send_block_ms = SEND_BLOCK_MS;

	struct hio_lte_send_recv_param param = {
		.send_buf = m_uplink,
		.send_len = sizeof(m_uplink),
		.timeout = K_MSEC(CALLER_DEADLINE_MS),
	};

	int ret = hio_lte_send_recv(&param);

	zassert_equal(ret, -ETIMEDOUT, "expected the call to end on its own deadline, got %d",
		      ret);
	zassert_is_null(m_send_recv_param,
			"FSM still holds the caller's param after the caller gave up");
}

/* The abandoned frame must never reach the modem. Left published, the handle
 * survives into the FSM's own retry, so a later on_enter_send() transmits from —
 * and validates its result against — whatever now occupies that stack slot. */
ZTEST(hio_lte_transaction, test_abandoned_param_is_never_sent_again)
{
	fake_flow_send_block_ms = SEND_BLOCK_MS;

	struct hio_lte_send_recv_param param = {
		.send_buf = m_uplink,
		.send_len = sizeof(m_uplink),
		.timeout = K_MSEC(CALLER_DEADLINE_MS),
	};

	int ret = hio_lte_send_recv(&param);
	zassert_equal(ret, -ETIMEDOUT, "expected the call to end on its own deadline, got %d",
		      ret);

	int sends_at_giveup = atomic_get(&fake_flow_send_count);

	/* Long enough for the FSM to finish the in-flight send and come back
	 * round through ERROR/READY to another send attempt. */
	k_sleep(K_SECONDS(7));

	zassert_equal(atomic_get(&fake_flow_send_count), sends_at_giveup,
		      "FSM transmitted again after the caller abandoned the transaction");
	zassert_not_equal(fake_flow_last_send_param, &param,
			  "FSM is still using the abandoned caller param");
}

static void holder_entry(void *p1, void *p2, void *p3)
{
	ARG_UNUSED(p1);
	ARG_UNUSED(p2);
	ARG_UNUSED(p3);

	m_holder_ret = hio_lte_send_recv(&m_holder_param);
}

/* Only one transaction can be in flight, because there is only one handle for
 * the FSM to read. A second caller that cannot take the lock must fail instead
 * of overwriting the handle — otherwise the FSM is pointed at this caller's
 * buffers while the first caller is still blocked waiting for its own. */
ZTEST(hio_lte_transaction, test_concurrent_caller_does_not_steal_transaction)
{
	m_holder_param = (struct hio_lte_send_recv_param){
		.send_buf = m_uplink,
		.send_len = sizeof(m_uplink),
		.timeout = K_SECONDS(2),
	};

	k_thread_create(&m_holder_thread, m_holder_stack, K_THREAD_STACK_SIZEOF(m_holder_stack),
			holder_entry, NULL, NULL, NULL, K_PRIO_PREEMPT(0), 0, K_NO_WAIT);

	/* Let the holder publish its param and block on its own deadline. */
	k_sleep(K_MSEC(200));
	zassert_equal_ptr(m_send_recv_param, &m_holder_param,
			  "holder did not publish its transaction");

	struct hio_lte_send_recv_param intruder = {
		.send_buf = m_uplink,
		.send_len = sizeof(m_uplink),
		.timeout = K_MSEC(CALLER_DEADLINE_MS),
	};

	int ret = hio_lte_send_recv(&intruder);

	zassert_equal(ret, -EBUSY, "second caller should be rejected as busy, got %d", ret);
	zassert_equal_ptr(m_send_recv_param, &m_holder_param,
			  "second caller retargeted the in-flight transaction");

	zassert_ok(k_thread_join(&m_holder_thread, K_SECONDS(5)), "holder did not finish");
	zassert_equal(m_holder_ret, -ETIMEDOUT, "holder should end on its own deadline, got %d",
		      m_holder_ret);
}
```
