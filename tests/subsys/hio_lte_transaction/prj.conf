## CMakeLists.txt
```
cmake_minimum_required(VERSION 3.20.0)

find_package(Zephyr REQUIRED HINTS $ENV{ZEPHYR_BASE})

project(test)

# The hio_lte Kconfig is not part of this test build, so supply the symbols
# hio_lte.c needs at compile time (defaults taken from subsys/hio_lte/Kconfig).
add_compile_definitions(CONFIG_HIO_LTE_LOG_LEVEL=3)
add_compile_definitions(CONFIG_HIO_LTE_INIT_PRIORITY=99)
add_compile_definitions(CONFIG_HIO_LTE_SCAN_MAX_ENTRIES=10)
add_compile_definitions(CONFIG_HIO_LTE_SCAN_MAX_CELLS=14)
add_compile_definitions(CONFIG_HIO_LTE_CEREG_HISTORY=3)
add_compile_definitions(CONFIG_HIO_LTE_SCAN_AUTO=1)
add_compile_definitions(CONFIG_HIO_LTE_SCAN_AUTO_EVERY=1)
# The product configuration: a measurement requested on every enable.
zephyr_get(HIO_LTE_NCELLMEAS)
if(HIO_LTE_NCELLMEAS)
  add_compile_definitions(CONFIG_HIO_LTE_NCELLMEAS=1)
endif()

set(HIO_LTE_DIR ${CMAKE_CURRENT_SOURCE_DIR}/../../../subsys/hio_lte)

include_directories(${HIO_LTE_DIR})

# hio_lte_talk.h (pulled in by hio_lte.c) includes nrf_modem_at.h. Only the
# declarations are needed here — the modem library itself is faked away — so put
# nrfxlib's headers on the path rather than stubbing them.
include_directories(${ZEPHYR_BASE}/../nrfxlib/nrf_modem/include)
target_sources(app PRIVATE ${HIO_LTE_DIR}/hio_lte.c)
target_sources(app PRIVATE ${HIO_LTE_DIR}/hio_lte_parse.c)
target_sources(app PRIVATE ${HIO_LTE_DIR}/hio_lte_state.c)
target_sources(app PRIVATE ${HIO_LTE_DIR}/hio_lte_str.c)
target_sources(app PRIVATE ${HIO_LTE_DIR}/hio_lte_util.c)
# The 'lte' shell commands, run through the dummy shell backend.
target_sources(app PRIVATE ${HIO_LTE_DIR}/hio_lte_shell.c)
target_sources(app PRIVATE ${HIO_LTE_DIR}/../hio_util/hio_util.c)
target_sources(app PRIVATE src/fake_flow.c)
target_sources(app PRIVATE src/test_transaction.c)
target_sources(app PRIVATE src/test_scan.c)
target_sources(app PRIVATE src/test_callbacks.c)
target_sources(app PRIVATE src/test_no_psm.c)
target_sources(app PRIVATE src/test_ncellmeas.c)
target_sources(app PRIVATE src/test_shell.c)
target_sources(app PRIVATE src/test_txn_abort.c)
```

## prj.conf
```kconfig
CONFIG_ZTEST=y

# hio_lte signals transaction completion with k_event.
CONFIG_EVENTS=y
CONFIG_HEAP_MEM_POOL_SIZE=256
CONFIG_MAIN_STACK_SIZE=4096

CONFIG_LOG=y
CONFIG_CBPRINTF_FP_SUPPORT=y

CONFIG_REQUIRES_FULL_LIBC=y

# 'lte' shell commands through the dummy backend.
CONFIG_SHELL=y
CONFIG_SHELL_LOG_BACKEND=n
CONFIG_SHELL_BACKEND_SERIAL=n
CONFIG_SHELL_BACKEND_DUMMY=y
CONFIG_SHELL_BACKEND_DUMMY_BUF_SIZE=4096
```

## src/fake_flow.c
```c
/*
 * Copyright (c) 2026 HARDWARIO a.s.
 *
 * SPDX-License-Identifier: LicenseRef-HARDWARIO-5-Clause
 */

/* Link-level fakes for hio_lte.c's dependencies. Flow calls succeed; modem
 * events are injected by the test via fake_flow_event_cb. */

#include "hio_lte_config.h"
#include "hio_lte_flow.h"
#include "hio_lte_talk.h"

#include <hio/hio_config.h>
#include <hio/hio_lte.h>
#include <hio/hio_rtc.h>

#include <zephyr/kernel.h>

#include <stdint.h>
#include <stdio.h>
#include <string.h>

struct hio_lte_config g_hio_lte_config;

/* Observed by the tests: how many datagrams the FSM actually handed to the
 * modem, and the parameter block it used for the most recent one. */
atomic_t fake_flow_send_count = ATOMIC_INIT(0);
const struct hio_lte_send_recv_param *fake_flow_last_send_param;

/* Stands in for the time nrf_send() spends waiting for RRC. Holding the FSM
 * inside the send is what lets a caller's deadline expire while its param is
 * still published, which is the condition the transfer needs to go wrong. */
uint32_t fake_flow_send_block_ms;

/* Counts FSM entries into PREPARE (modem power-up). */
atomic_t fake_flow_start_count = ATOMIC_INIT(0);

HIO_LTE_FSM_EVENT_delegate_cb fake_flow_event_cb;

int hio_lte_config_init(void)
{
	return 0;
}

int hio_lte_flow_init(HIO_LTE_FSM_EVENT_delegate_cb cb)
{
	fake_flow_event_cb = cb;
	return 0;
}

/* The send's result, after its block. */
int fake_flow_send_ret;

/* Non-zero: the send keeps the CPU (busy wait) for this long, so a caller of
 * lower priority cannot run before the FSM is done with the send. */
uint32_t fake_flow_send_busy_ms;

/* What the modem took from send_buf: copied when the send ends, as nrf_send
 * reads the caller's buffer until it returns. */
uint8_t fake_flow_wire[64];
size_t fake_flow_wire_len;

/* Inside a send or a recv, the calls of hio_lte_flow_stop() made meanwhile, and
 * the uptime at which the last send or recv returned. */
atomic_t fake_flow_in_io = ATOMIC_INIT(0);
atomic_t fake_flow_stop_in_io = ATOMIC_INIT(0);
int64_t fake_flow_io_exit_ms;

/* The thread the FSM runs on (seen in the send). */
k_tid_t fake_flow_fsm_thread;

int hio_lte_flow_send(const struct hio_lte_send_recv_param *param)
{
	fake_flow_fsm_thread = k_current_get();
	fake_flow_last_send_param = param;
	atomic_inc(&fake_flow_send_count);
	atomic_set(&fake_flow_in_io, 1);

	if (fake_flow_send_block_ms != 0) {
		k_sleep(K_MSEC(fake_flow_send_block_ms));
	}

	if (fake_flow_send_busy_ms != 0) {
		k_busy_wait(fake_flow_send_busy_ms * USEC_PER_MSEC);
	}

	fake_flow_wire_len = MIN(param->send_len, sizeof(fake_flow_wire));
	memcpy(fake_flow_wire, param->send_buf, fake_flow_wire_len);

	fake_flow_io_exit_ms = k_uptime_get();
	atomic_set(&fake_flow_in_io, 0);

	return fake_flow_send_ret;
}

/* Non-zero: block for fake_flow_recv_block_ms, then receive this many bytes,
 * each fake_flow_recv_fill, written into the caller's recv_buf. */
size_t fake_flow_recv_len;
uint32_t fake_flow_recv_block_ms;
uint8_t fake_flow_recv_fill = 0x5a;

int hio_lte_flow_recv(const struct hio_lte_send_recv_param *param)
{
	if (!fake_flow_recv_len) {
		return -ETIMEDOUT;
	}

	atomic_set(&fake_flow_in_io, 1);
	k_sleep(K_MSEC(fake_flow_recv_block_ms));

	size_t len = MIN(fake_flow_recv_len, param->recv_size - *param->recv_len);

	memset((uint8_t *)param->recv_buf + *param->recv_len, fake_flow_recv_fill, len);
	*param->recv_len += len;

	fake_flow_io_exit_ms = k_uptime_get();
	atomic_set(&fake_flow_in_io, 0);

	return 0;
}

int hio_lte_flow_start(void)
{
	fake_flow_fsm_thread = k_current_get();
	atomic_inc(&fake_flow_start_count);
	return 0;
}

/* The time AT+CFUN=0 and the modem library shutdown take. */
uint32_t fake_flow_stop_ms;

int hio_lte_flow_stop(void)
{
	if (atomic_get(&fake_flow_in_io)) {
		atomic_inc(&fake_flow_stop_in_io);
	}

	if (fake_flow_stop_ms) {
		k_sleep(K_MSEC(fake_flow_stop_ms));
	}

	return 0;
}

int hio_lte_flow_prepare(void)
{
	return 0;
}

int fake_flow_last_cfun = -1;

/* Runs inside the command, as the URCs the modem sends before its OK. */
void (*fake_flow_cfun_hook)(int cfun);

int hio_lte_flow_cfun(int cfun)
{
	if (fake_flow_cfun_hook) {
		fake_flow_cfun_hook(cfun);
	}

	fake_flow_last_cfun = cfun;
	return 0;
}

int hio_lte_flow_sim_info(void)
{
	return 0;
}

int hio_lte_flow_sim_fplmn(void)
{
	return 0;
}

/* The time the socket open takes. */
uint32_t fake_flow_open_ms;

int hio_lte_flow_open_socket(const struct hio_lte_socket_config *socket_config,
			     bool load_dtls_session)
{
	ARG_UNUSED(socket_config);
	ARG_UNUSED(load_dtls_session);

	if (fake_flow_open_ms) {
		k_sleep(K_MSEC(fake_flow_open_ms));
	}

	return 0;
}

int hio_lte_flow_close_socket(bool save_dtls_session)
{
	ARG_UNUSED(save_dtls_session);
	return 0;
}

/* The time the socket check takes. */
uint32_t fake_flow_check_ms;

int hio_lte_flow_check(void)
{
	if (fake_flow_check_ms) {
		k_sleep(K_MSEC(fake_flow_check_ms));
	}

	return 0;
}

/* SNDTIMEO of the last send. */
int fake_flow_sndtimeo_sec = -1;

int hio_lte_flow_set_sndtimeo(int timeout_sec)
{
	fake_flow_sndtimeo_sec = timeout_sec;
	return 0;
}

/* The time AT%CONEVAL takes. */
uint32_t fake_flow_coneval_ms;

int hio_lte_flow_coneval(void)
{
	if (fake_flow_coneval_ms) {
		k_sleep(K_MSEC(fake_flow_coneval_ms));
	}

	return 0;
}

int hio_lte_flow_cmd(const char *cmd)
{
	ARG_UNUSED(cmd);
	return 0;
}

int hio_lte_flow_set_psk(const char *identity, const char *psk_hex)
{
	ARG_UNUSED(identity);
	ARG_UNUSED(psk_hex);
	return 0;
}

/* Default is long enough for the test to inject REGISTERED in time. */
uint32_t fake_attach_timeout_ms = 60000;
/* Delay after every third attempt, like the periodic policy. */
uint32_t fake_retry_delay_ms;

struct hio_lte_attach_timeout hio_lte_flow_attach_policy_periodic(int attempt, k_timeout_t pause)
{
	ARG_UNUSED(pause);
	return (struct hio_lte_attach_timeout){
		.attach_timeout = K_MSEC(fake_attach_timeout_ms),
		.retry_delay = attempt % 3 == 2 ? K_MSEC(fake_retry_delay_ms) : K_NO_WAIT};
}

struct hio_lte_attach_timeout hio_lte_flow_attach_policy_progressive(int attempt)
{
	return hio_lte_flow_attach_policy_periodic(attempt, K_NO_WAIT);
}

atomic_t fake_flow_scan_cells_count = ATOMIC_INIT(0);
atomic_t fake_flow_scan_plmn_count = ATOMIC_INIT(0);
bool fake_flow_scan_auto;

void hio_lte_flow_scan_begin(enum hio_lte_scan_mode mode, bool auto_triggered)
{
	ARG_UNUSED(mode);
	fake_flow_scan_auto = auto_triggered;
}

void hio_lte_flow_scan_end(void)
{
}

uint8_t fake_flow_scan_cells_act;
atomic_t fake_flow_scan_rat_count = ATOMIC_INIT(0);
bool fake_flow_scan_rat_lte_m;
bool fake_flow_scan_rat_nb_iot;
/* Uptime of the last RAT switch and of the last cell search start. */
int64_t fake_flow_scan_rat_ms;
int64_t fake_flow_scan_cells_ms;

/* Runs inside the RAT switch, as the URCs the modem sends meanwhile. */
void (*fake_flow_scan_rat_hook)(void);

/* The scan steps in order, e.g. "rat:m cells:7 plmn:7 ". */
char fake_flow_scan_trace[128];

static void scan_trace(const char *fmt, int arg)
{
	size_t len = strlen(fake_flow_scan_trace);

	snprintf(fake_flow_scan_trace + len, sizeof(fake_flow_scan_trace) - len, fmt, arg);
}

/* Non-zero: the searches of test mode never end, their waits return it. */
int fake_flow_scan_wait_ret;

int hio_lte_flow_scan_rat(bool lte_m, bool nb_iot)
{
	if (fake_flow_scan_rat_hook) {
		fake_flow_scan_rat_hook();
	}

	scan_trace(lte_m && nb_iot ? "rat:mn " : lte_m ? "rat:m " : "rat:n ", 0);
	fake_flow_scan_rat_lte_m = lte_m;
	fake_flow_scan_rat_nb_iot = nb_iot;
	fake_flow_scan_rat_ms = k_uptime_get();
	atomic_inc(&fake_flow_scan_rat_count);
	return 0;
}

int hio_lte_flow_scan_cells_start(uint8_t act)
{
	scan_trace("cells:%u ", act);
	fake_flow_scan_cells_act = act;
	fake_flow_scan_cells_ms = k_uptime_get();
	atomic_inc(&fake_flow_scan_cells_count);
	return 0;
}

int hio_lte_flow_scan_cells_wait(k_timeout_t timeout)
{
	if (fake_flow_scan_wait_ret) {
		k_sleep(timeout);
	}
	return fake_flow_scan_wait_ret;
}

int64_t fake_flow_scan_plmn_ms;
uint8_t fake_flow_scan_plmn_act;

int hio_lte_flow_scan_plmn_start(uint8_t act)
{
	scan_trace("plmn:%u ", act);
	fake_flow_scan_plmn_act = act;
	fake_flow_scan_plmn_ms = k_uptime_get();
	atomic_inc(&fake_flow_scan_plmn_count);
	return 0;
}

int hio_lte_flow_scan_plmn_wait(k_timeout_t timeout)
{
	if (fake_flow_scan_wait_ret) {
		k_sleep(timeout);
	}
	return fake_flow_scan_wait_ret;
}

atomic_t fake_flow_scan_abort_count = ATOMIC_INIT(0);

void hio_lte_flow_scan_abort(void)
{
	atomic_inc(&fake_flow_scan_abort_count);
}

int hio_lte_flow_abort(void)
{
	return 0;
}

atomic_t fake_flow_ncellmeas_count = ATOMIC_INIT(0);

static nrf_modem_at_resp_handler_t m_ncellmeas_resp_cb;

int hio_lte_talk_ncellmeas_cb(int p1, int p2, nrf_modem_at_resp_handler_t cb)
{
	ARG_UNUSED(p1);
	ARG_UNUSED(p2);
	m_ncellmeas_resp_cb = cb;
	atomic_inc(&fake_flow_ncellmeas_count);
	return 0;
}

/* The modem's response to the last AT%NCELLMEAS (in ISR context there). */
void fake_flow_ncellmeas_resp(const char *resp)
{
	if (m_ncellmeas_resp_cb) {
		m_ncellmeas_resp_cb(resp);
	}
}

/* The measurement of test mode, without the FSM. */
atomic_t fake_flow_ncellmeas_test_count = ATOMIC_INIT(0);
int fake_flow_ncellmeas_start_ret;
static K_SEM_DEFINE(m_ncellmeas_test_sem, 0, 1);
static const char *m_ncellmeas_test_error;

int hio_lte_flow_ncellmeas_start(void)
{
	k_sem_reset(&m_ncellmeas_test_sem);
	atomic_inc(&fake_flow_ncellmeas_test_count);
	return fake_flow_ncellmeas_start_ret;
}

int hio_lte_flow_ncellmeas_wait(k_timeout_t timeout, char *error, size_t size)
{
	if (k_sem_take(&m_ncellmeas_test_sem, timeout)) {
		return -EAGAIN;
	}

	if (m_ncellmeas_test_error) {
		snprintf(error, size, "%s", m_ncellmeas_test_error);
		return -EIO;
	}

	return 0;
}

/* The URC (stored by the test before) or the refusal of the modem. */
void fake_flow_ncellmeas_done(const char *error)
{
	m_ncellmeas_test_error = error;
	k_sem_give(&m_ncellmeas_test_sem);
}

/* Used by the 'lte' shell commands only. */
int hio_lte_flow_xmodemtrace(int lvl)
{
	return 0;
}

int hio_lte_talk_at_cmd(const char *s)
{
	return 0;
}

int hio_lte_talk_bypass_set_cb(hio_lte_talk_bypass_cb cb, void *user_data)
{
	return 0;
}

int hio_config_shell_cmd(const struct shell *shell, size_t argc, char **argv)
{
	return 0;
}

/* Runs inside the FSM's metrics update before a send or a recv. */
void (*fake_rtc_hook)(void);

int hio_rtc_get_ts(int64_t *ts)
{
	if (fake_rtc_hook) {
		fake_rtc_hook();
	}

	if (ts != NULL) {
		*ts = 0;
	}
	return 0;
}
```

## src/fsm_helpers.h
```c
/*
 * Copyright (c) 2026 HARDWARIO a.s.
 *
 * SPDX-License-Identifier: LicenseRef-HARDWARIO-5-Clause
 */

#ifndef FSM_HELPERS_H_
#define FSM_HELPERS_H_

#include "hio_lte_config.h"
#include "hio_lte_flow.h"
#include "hio_lte_state.h"

#include <hio/hio_lte.h>

#include <zephyr/kernel.h>
#include <zephyr/ztest.h>

#include <string.h>

extern HIO_LTE_FSM_EVENT_delegate_cb fake_flow_event_cb;

/* Drive the FSM to READY, playing the modem's URCs. */
static inline void fsm_bring_up(void)
{
	static const struct hio_lte_socket_config cfg = {.port = 5002, .addr = "192.0.2.1"};

	zassert_ok(hio_lte_enable(&cfg));
	k_sleep(K_MSEC(50));
	fake_flow_event_cb(HIO_LTE_FSM_EVENT_SIMDETECTED);
	k_sleep(K_MSEC(50));
	fake_flow_event_cb(HIO_LTE_FSM_EVENT_REGISTERED);
	zassert_ok(hio_lte_wait_for_connected(K_SECONDS(1)), "FSM did not reach READY");
}

static inline bool fsm_in(const char *state)
{
	const char *current;

	return !hio_lte_get_fsm_state(&current) && !strcmp(current, state);
}

/* Registered, with the PSM active time the network granted (-1: none, so the
 * ready state switches the radio off). */
static inline void fsm_set_psm(int active_time)
{
	struct hio_lte_cereg_param param = {
		.valid = true,
		.stat = HIO_LTE_CEREG_PARAM_STAT_REGISTERED_HOME,
		.act = HIO_LTE_CEREG_PARAM_ACT_LTE,
		.active_time = active_time,
		.periodic_tau_ext = active_time < 0 ? -1 : 3600,
	};

	hio_lte_state_set_cereg_param(&param);
}

/* The modem registers during a scan (+CEREG: 1): the state before the event,
 * as in the flow. */
static inline void fsm_scan_registers(void)
{
	fsm_set_psm(0);
	fake_flow_event_cb(HIO_LTE_FSM_EVENT_REGISTERED);
}

/* hio_lte_schedule_ncellmeas() first after an enable: with
 * CONFIG_HIO_LTE_NCELLMEAS the enable has requested one. */
#define FIRST_NCELLMEAS_RET (IS_ENABLED(CONFIG_HIO_LTE_NCELLMEAS) ? -EALREADY : 0)

/* With CONFIG_HIO_LTE_NCELLMEAS, end the measurement the enable requested: the
 * release of the RRC connection starts it. */
static inline void fsm_boot_ncellmeas(void)
{
	if (!IS_ENABLED(CONFIG_HIO_LTE_NCELLMEAS)) {
		return;
	}

	zassert_equal(hio_lte_wait_for_ncellmeas(K_NO_WAIT), -ETIMEDOUT, "none requested");
	k_sleep(K_MSEC(50));
	zassert_true(fsm_in("ready"));
	fake_flow_event_cb(HIO_LTE_FSM_EVENT_CSCON_0);
	k_sleep(K_MSEC(50));
	zassert_true(fsm_in("ncellmeas"), "the release did not start it");
	fake_flow_event_cb(HIO_LTE_FSM_EVENT_NCELLMEAS);
	zassert_ok(hio_lte_wait_for_ncellmeas(K_SECONDS(1)), "measurement request not ended");
	/* The callbacks run after the done bit. */
	k_sleep(K_MSEC(50));
}

/* End a measurement request a test left behind: the others expect none. */
static inline void fsm_end_ncellmeas(void)
{
	if (!hio_lte_wait_for_ncellmeas(K_NO_WAIT)) {
		return;
	}

	g_hio_lte_config.test = false;
	zassert_ok(hio_lte_disable());
	zassert_ok(hio_lte_wait_for_disable(K_SECONDS(10)));
	fsm_set_psm(0);
	fsm_bring_up();
	k_sleep(K_MSEC(50));
	(void)hio_lte_schedule_ncellmeas();
	k_sleep(K_MSEC(50));
	fake_flow_event_cb(HIO_LTE_FSM_EVENT_NCELLMEAS);
	zassert_ok(hio_lte_wait_for_ncellmeas(K_SECONDS(1)), "measurement request not ended");
}

#endif /* FSM_HELPERS_H_ */
```

## src/test_callbacks.c
```c
/*
 * Copyright (c) 2026 HARDWARIO a.s.
 *
 * SPDX-License-Identifier: LicenseRef-HARDWARIO-5-Clause
 */

/* LTE event callbacks (hio_lte_add_callback()). */

#include "fsm_helpers.h"

#include <hio/hio_lte.h>

#include <zephyr/kernel.h>
#include <zephyr/ztest.h>

static atomic_t m_cb_count;
static enum hio_lte_event m_cb_events[4];
static void *m_cb_user_data;
static atomic_t m_cb_once_count;

static void cb_handler(struct hio_lte_cb *cb, enum hio_lte_event event)
{
	atomic_val_t n = atomic_inc(&m_cb_count);

	if (n < ARRAY_SIZE(m_cb_events)) {
		m_cb_events[n] = event;
	}

	m_cb_user_data = cb->user_data;
}

/* Removes itself on the first event. */
static void cb_once_handler(struct hio_lte_cb *cb, enum hio_lte_event event)
{
	atomic_inc(&m_cb_once_count);
	hio_lte_remove_callback(cb);
}

static void callbacks_before(void *fixture)
{
	ARG_UNUSED(fixture);

	g_hio_lte_config.test = false;
	zassert_ok(hio_lte_disable());
	zassert_ok(hio_lte_wait_for_disable(K_SECONDS(2)));
}

ZTEST_SUITE(hio_lte_callbacks, NULL, NULL, callbacks_before, NULL, NULL);

ZTEST(hio_lte_callbacks, test_cscon)
{
	static int user_data;
	static struct hio_lte_cb cb = {.handler = cb_handler, .user_data = &user_data};
	static struct hio_lte_cb once = {.handler = cb_once_handler};
	static struct hio_lte_cb no_handler;

	zassert_equal(hio_lte_add_callback(NULL), -EINVAL);
	zassert_equal(hio_lte_add_callback(&no_handler), -EINVAL);
	zassert_equal(hio_lte_remove_callback(NULL), -EINVAL);

	/* Ahead of cb: removing itself must not stop the others. */
	zassert_ok(hio_lte_add_callback(&once));
	zassert_ok(hio_lte_add_callback(&cb));
	zassert_equal(hio_lte_add_callback(&cb), -EALREADY);

	fsm_bring_up();
	fake_flow_event_cb(HIO_LTE_FSM_EVENT_CSCON_1);
	fake_flow_event_cb(HIO_LTE_FSM_EVENT_CSCON_0);
	k_sleep(K_MSEC(50));

	zassert_equal(atomic_get(&m_cb_count), 2);
	zassert_equal(m_cb_events[0], HIO_LTE_EVENT_CSCON_1);
	zassert_equal(m_cb_events[1], HIO_LTE_EVENT_CSCON_0);
	zassert_equal_ptr(m_cb_user_data, &user_data);

	zassert_equal(atomic_get(&m_cb_once_count), 1, "not removed by its handler");
	zassert_equal(hio_lte_remove_callback(&once), -ENOENT);

	zassert_ok(hio_lte_remove_callback(&cb));
	zassert_equal(hio_lte_remove_callback(&cb), -ENOENT);
}
```

## src/test_ncellmeas.c
```c
/*
 * Copyright (c) 2026 HARDWARIO a.s.
 *
 * SPDX-License-Identifier: LicenseRef-HARDWARIO-5-Clause
 */

/* Neighbour cell measurement on request (NCELLMEAS state). */

#include "fsm_helpers.h"

#include <hio/hio_lte.h>

#include <zephyr/kernel.h>
#include <zephyr/ztest.h>

extern atomic_t fake_flow_ncellmeas_count;
extern atomic_t fake_flow_send_count;
extern int fake_flow_last_cfun;
extern void fake_flow_ncellmeas_resp(const char *resp);

static atomic_t m_done_count;
static int m_wait_at_start;

static void done_handler(struct hio_lte_cb *cb, enum hio_lte_event event)
{
	ARG_UNUSED(cb);

	if (event == HIO_LTE_EVENT_NCELLMEAS_DONE) {
		atomic_inc(&m_done_count);
	}
}

static struct hio_lte_cb m_cb = {.handler = done_handler};

static void fsm_down(void)
{
	g_hio_lte_config.test = false;
	zassert_ok(hio_lte_disable());
	zassert_ok(hio_lte_wait_for_disable(K_SECONDS(10)));
}

/* The result URC, as the flow reports it. */
static void urc(void)
{
	fake_flow_event_cb(HIO_LTE_FSM_EVENT_NCELLMEAS);
	k_sleep(K_MSEC(50));
}

static void measured(void)
{
	urc();
	zassert_true(fsm_in("ready"));
	zassert_ok(hio_lte_wait_for_ncellmeas(K_NO_WAIT), "waiter not released");
	zassert_equal(atomic_get(&m_done_count), 1);
}

static void *ncellmeas_setup(void)
{
	/* Before any request of these tests. */
	m_wait_at_start = hio_lte_wait_for_ncellmeas(K_NO_WAIT);
	zassert_ok(hio_lte_add_callback(&m_cb));

	return NULL;
}

static void ncellmeas_before(void *fixture)
{
	ARG_UNUSED(fixture);

	/* With CONFIG_HIO_LTE_NCELLMEAS, other suites leave the one of their
	 * enable. */
	fsm_end_ncellmeas();
	fsm_down();
	fsm_set_psm(0);
	atomic_clear(&m_done_count);
	atomic_clear(&fake_flow_ncellmeas_count);
}

static void ncellmeas_after(void *fixture)
{
	ARG_UNUSED(fixture);

	fsm_end_ncellmeas();
	fsm_down();
}

ZTEST_SUITE(hio_lte_ncellmeas, NULL, ncellmeas_setup, ncellmeas_before, ncellmeas_after, NULL);

ZTEST(hio_lte_ncellmeas, test_nothing_requested)
{
	/* Other suites have enabled LTE, which requests one. */
	Z_TEST_SKIP_IFDEF(CONFIG_HIO_LTE_NCELLMEAS);

	zassert_ok(m_wait_at_start);
}

ZTEST(hio_lte_ncellmeas, test_rejected_in_test_mode)
{
	g_hio_lte_config.test = true;
	zassert_equal(hio_lte_schedule_ncellmeas(), -ENOTSUP);
	zassert_ok(hio_lte_wait_for_ncellmeas(K_NO_WAIT));
}

/* Registered and the RRC connection idle: it starts at once. */
ZTEST(hio_lte_ncellmeas, test_from_ready_measures_at_once)
{
	fsm_bring_up();
	k_sleep(K_SECONDS(1));
	zassert_true(fsm_in("ready"));

	zassert_equal(hio_lte_schedule_ncellmeas(), FIRST_NCELLMEAS_RET);
	k_sleep(K_MSEC(50));
	zassert_true(fsm_in("ncellmeas"));
	zassert_equal(atomic_get(&fake_flow_ncellmeas_count), 1);
	zassert_equal(hio_lte_wait_for_ncellmeas(K_NO_WAIT), -ETIMEDOUT);

	/* Served by the running one, no second measurement after it. */
	zassert_equal(hio_lte_schedule_ncellmeas(), -EALREADY);
	k_sleep(K_MSEC(50));
	measured();
	k_sleep(K_SECONDS(1));
	zassert_true(fsm_in("ready"));
	zassert_equal(atomic_get(&fake_flow_ncellmeas_count), 1, "measured twice");
}

/* With the RRC connection open it waits for its release. */
ZTEST(hio_lte_ncellmeas, test_waits_for_rrc_release)
{
	fsm_bring_up();
	fake_flow_event_cb(HIO_LTE_FSM_EVENT_CSCON_1);
	k_sleep(K_MSEC(50));

	zassert_equal(hio_lte_schedule_ncellmeas(), FIRST_NCELLMEAS_RET);
	k_sleep(K_SECONDS(1));
	zassert_true(fsm_in("ready"));
	zassert_equal(atomic_get(&fake_flow_ncellmeas_count), 0);

	fake_flow_event_cb(HIO_LTE_FSM_EVENT_CSCON_0);
	k_sleep(K_MSEC(50));
	zassert_true(fsm_in("ncellmeas"));
	measured();
}

/* Requested while busy (here attaching): it starts once ready. */
ZTEST(hio_lte_ncellmeas, test_requested_while_attaching)
{
	static const struct hio_lte_socket_config cfg = {.port = 5002, .addr = "192.0.2.1"};

	zassert_ok(hio_lte_enable(&cfg));
	k_sleep(K_MSEC(50));
	fake_flow_event_cb(HIO_LTE_FSM_EVENT_SIMDETECTED);
	k_sleep(K_MSEC(50));
	zassert_true(fsm_in("attach"));

	zassert_equal(hio_lte_schedule_ncellmeas(), FIRST_NCELLMEAS_RET);
	k_sleep(K_MSEC(50));
	zassert_true(fsm_in("attach"));

	fake_flow_event_cb(HIO_LTE_FSM_EVENT_REGISTERED);
	k_sleep(K_MSEC(50));
	zassert_true(fsm_in("ncellmeas"));
	measured();
}

/* Requested in PSM sleep: the modem measures without waiting for the next
 * connection. */
static void measuring_from_sleep(void)
{
	fsm_bring_up();
	k_sleep(K_MSEC(50));
	fake_flow_event_cb(HIO_LTE_FSM_EVENT_XMODEMSLEEP);
	k_sleep(K_MSEC(50));
	zassert_true(fsm_in("sleep"));

	zassert_equal(hio_lte_schedule_ncellmeas(), FIRST_NCELLMEAS_RET);
	k_sleep(K_MSEC(50));
	zassert_true(fsm_in("ncellmeas"));
}

ZTEST(hio_lte_ncellmeas, test_from_psm_sleep_measures_at_once)
{
	measuring_from_sleep();

	/* The command accepted: the result follows as a URC. */
	fake_flow_ncellmeas_resp("OK\r\n");
	k_sleep(K_MSEC(50));
	zassert_true(fsm_in("ncellmeas"), "ended by OK");
	measured();
}

/* No PSM granted: the ready state switches the radio off (CFUN=4). */
static void radio_off(void)
{
	fsm_set_psm(-1);
	fsm_bring_up();
	/* The radio stays on for a requested measurement. */
	fsm_boot_ncellmeas();
	atomic_clear(&m_done_count);
	atomic_clear(&fake_flow_ncellmeas_count);
	for (int i = 0; i < 40 && fake_flow_last_cfun != 4; i++) {
		k_sleep(K_MSEC(50));
	}
	zassert_equal(fake_flow_last_cfun, 4);
}

/* With the radio off it attaches first; the release of that connection starts
 * the measurement. */
static void attaches_then_measures(void)
{
	zassert_equal(fake_flow_last_cfun, 1);
	zassert_true(fsm_in("attach"));
	zassert_equal(atomic_get(&fake_flow_ncellmeas_count), 0);

	fake_flow_event_cb(HIO_LTE_FSM_EVENT_CSCON_1);
	fake_flow_event_cb(HIO_LTE_FSM_EVENT_REGISTERED);
	zassert_ok(hio_lte_wait_for_connected(K_SECONDS(1)));
	k_sleep(K_SECONDS(1));
	zassert_true(fsm_in("ready"));

	fake_flow_event_cb(HIO_LTE_FSM_EVENT_CSCON_0);
	k_sleep(K_MSEC(50));
	zassert_true(fsm_in("ncellmeas"));
	measured();
}

ZTEST(hio_lte_ncellmeas, test_from_sleep_with_radio_off_attaches)
{
	radio_off();
	fake_flow_event_cb(HIO_LTE_FSM_EVENT_XMODEMSLEEP);
	k_sleep(K_MSEC(50));
	zassert_true(fsm_in("sleep"));

	zassert_ok(hio_lte_schedule_ncellmeas());
	k_sleep(K_MSEC(50));
	attaches_then_measures();
}

/* Requested after CFUN=4, before the sleep state: no measurement with the radio
 * off, the sleep state wakes it. */
ZTEST(hio_lte_ncellmeas, test_from_ready_with_radio_off_attaches)
{
	radio_off();
	zassert_true(fsm_in("ready"));

	zassert_ok(hio_lte_schedule_ncellmeas());
	k_sleep(K_MSEC(50));
	zassert_true(fsm_in("ready"));
	zassert_equal(atomic_get(&fake_flow_ncellmeas_count), 0);

	fake_flow_event_cb(HIO_LTE_FSM_EVENT_XMODEMSLEEP);
	k_sleep(K_MSEC(50));
	attaches_then_measures();
}

/* Requested in READY with the connection idle: it starts at once. */
static void measuring_from_ready(void)
{
	fsm_bring_up();
	k_sleep(K_MSEC(50));
	zassert_equal(hio_lte_schedule_ncellmeas(), FIRST_NCELLMEAS_RET);
	k_sleep(K_MSEC(50));
	zassert_true(fsm_in("ncellmeas"));
}

/* No URC within the watchdog: the request stays for the next connection and
 * is not retried in a loop; asked again, it measures again. */
ZTEST(hio_lte_ncellmeas, test_watchdog_keeps_request)
{
	measuring_from_ready();

	k_sleep(K_SECONDS(61));
	zassert_true(fsm_in("ready"));
	zassert_equal(hio_lte_wait_for_ncellmeas(K_NO_WAIT), -ETIMEDOUT, "request dropped");
	zassert_equal(atomic_get(&m_done_count), 0);

	k_sleep(K_SECONDS(2));
	zassert_true(fsm_in("ready"), "measured again without a request");
	zassert_equal(atomic_get(&fake_flow_ncellmeas_count), 1);

	zassert_equal(hio_lte_schedule_ncellmeas(), -EALREADY);
	k_sleep(K_MSEC(50));
	zassert_true(fsm_in("ncellmeas"));
	zassert_equal(atomic_get(&fake_flow_ncellmeas_count), 2);
	measured();
}

/* The request event without a request starts nothing. */
ZTEST(hio_lte_ncellmeas, test_stray_request_event)
{
	fsm_bring_up();
	k_sleep(K_MSEC(50));
	fake_flow_event_cb(HIO_LTE_FSM_EVENT_NCELLMEAS_REQ);
	k_sleep(K_MSEC(50));
	zassert_true(fsm_in("ready"));

	fake_flow_event_cb(HIO_LTE_FSM_EVENT_XMODEMSLEEP);
	k_sleep(K_MSEC(50));
	zassert_true(fsm_in("sleep"));
	fake_flow_event_cb(HIO_LTE_FSM_EVENT_NCELLMEAS_REQ);
	k_sleep(K_MSEC(50));
	zassert_true(fsm_in("sleep"));
	zassert_equal(atomic_get(&fake_flow_ncellmeas_count), 0);
}

/* A request left by the watchdog runs at the release of the next connection. */
ZTEST(hio_lte_ncellmeas, test_after_watchdog_measures_at_release)
{
	measuring_from_ready();
	k_sleep(K_SECONDS(61));
	zassert_true(fsm_in("ready"));

	fake_flow_event_cb(HIO_LTE_FSM_EVENT_CSCON_1);
	k_sleep(K_MSEC(50));
	zassert_true(fsm_in("ready"));
	fake_flow_event_cb(HIO_LTE_FSM_EVENT_CSCON_0);
	k_sleep(K_MSEC(50));
	zassert_true(fsm_in("ncellmeas"), "not started by the release");
	zassert_equal(atomic_get(&fake_flow_ncellmeas_count), 2);
	measured();
}

/* Asked again while it runs: served by the running one, so after the watchdog
 * it waits for the next connection like any other. */
ZTEST(hio_lte_ncellmeas, test_repeat_while_running_not_rearmed)
{
	measuring_from_ready();
	k_sleep(K_SECONDS(10));
	zassert_equal(hio_lte_schedule_ncellmeas(), -EALREADY);

	k_sleep(K_SECONDS(51));
	zassert_true(fsm_in("ready"));
	k_sleep(K_SECONDS(2));
	zassert_true(fsm_in("ready"), "measured again without a request");
	zassert_equal(atomic_get(&fake_flow_ncellmeas_count), 1);
}

/* The result arrives just after the watchdog; without PSM the radio then goes
 * off as after any measurement. */
ZTEST(hio_lte_ncellmeas, test_late_result_ends_request)
{
	measuring_from_ready();
	fsm_set_psm(-1);
	k_sleep(K_SECONDS(61));
	zassert_true(fsm_in("ready"));
	zassert_equal(hio_lte_wait_for_ncellmeas(K_NO_WAIT), -ETIMEDOUT);
	zassert_equal(fake_flow_last_cfun, 1);

	measured();
	k_sleep(K_SECONDS(1));
	zassert_equal(atomic_get(&fake_flow_ncellmeas_count), 1);
	zassert_equal(fake_flow_last_cfun, 4, "radio left on");
}

/* The modem refuses the command (it does in CFUN=2): no result follows, the
 * request ends at once as failed. */
ZTEST(hio_lte_ncellmeas, test_refused_ends_request)
{
	hio_lte_state_set_ncellmeas_param(&(struct hio_lte_ncellmeas_param){0});
	measuring_from_ready();

	fake_flow_ncellmeas_resp("ERROR\r\n");
	k_sleep(K_MSEC(50));
	zassert_true(fsm_in("ready"));
	zassert_ok(hio_lte_wait_for_ncellmeas(K_NO_WAIT), "waiter not released");
	zassert_equal(atomic_get(&m_done_count), 1);

	struct hio_lte_ncellmeas_param param;

	zassert_ok(hio_lte_get_ncellmeas_param(&param));
	zassert_true(param.valid);
	zassert_equal(param.status, 1, "not stored as failed");

	k_sleep(K_SECONDS(1));
	zassert_equal(atomic_get(&fake_flow_ncellmeas_count), 1, "tried again");
}

static K_THREAD_STACK_DEFINE(m_thread_stack, 2048);
static struct k_thread m_thread;

static uint8_t m_uplink[8];
static struct hio_lte_send_recv_param m_send_param;
static int m_send_ret;

static void send_entry(void *p1, void *p2, void *p3)
{
	ARG_UNUSED(p1);
	ARG_UNUSED(p2);
	ARG_UNUSED(p3);

	m_send_ret = hio_lte_send_recv(&m_send_param);
}

/* A transaction from a thread of its own. */
static void send_start(k_timeout_t timeout)
{
	m_send_param = (struct hio_lte_send_recv_param){
		.send_buf = m_uplink,
		.send_len = sizeof(m_uplink),
		.timeout = timeout,
	};
	m_send_ret = 1;
	atomic_clear(&fake_flow_send_count);
	k_thread_create(&m_thread, m_thread_stack, K_THREAD_STACK_SIZEOF(m_thread_stack),
			send_entry, NULL, NULL, NULL, K_PRIO_PREEMPT(0), 0, K_NO_WAIT);
	k_sleep(K_MSEC(50));
}

/* The network grants the connection and the uplink goes out. */
static void send_done(void)
{
	fake_flow_event_cb(HIO_LTE_FSM_EVENT_CSCON_1);
	zassert_ok(k_thread_join(&m_thread, K_SECONDS(1)), "transaction did not end");
	zassert_ok(m_send_ret);
}

/* A transaction waits for the running measurement. */
ZTEST(hio_lte_ncellmeas, test_transaction_waits_for_measurement)
{
	measuring_from_sleep();
	send_start(K_SECONDS(120));
	k_sleep(K_SECONDS(5));
	zassert_true(fsm_in("ncellmeas"));
	zassert_equal(atomic_get(&fake_flow_send_count), 0, "sent while measuring");

	urc();
	zassert_ok(hio_lte_wait_for_ncellmeas(K_NO_WAIT));
	zassert_equal(atomic_get(&fake_flow_send_count), 1, "not sent after it");
	send_done();
}

/* The deadline of a waiting transaction does not abort the measurement. */
ZTEST(hio_lte_ncellmeas, test_transaction_deadline_keeps_measurement)
{
	measuring_from_sleep();
	send_start(K_SECONDS(5));
	zassert_ok(k_thread_join(&m_thread, K_SECONDS(10)));
	zassert_equal(m_send_ret, -ETIMEDOUT);
	k_sleep(K_MSEC(50));
	zassert_true(fsm_in("ncellmeas"), "measurement aborted");

	measured();
	k_sleep(K_SECONDS(1));
	zassert_equal(atomic_get(&fake_flow_send_count), 0, "abandoned transaction sent");
	zassert_equal(atomic_get(&fake_flow_ncellmeas_count), 1);
}

/* A transaction and a request both pending on entering READY: the transaction
 * goes first, the release of its connection starts the measurement. */
ZTEST(hio_lte_ncellmeas, test_transaction_before_measurement)
{
	static const struct hio_lte_socket_config cfg = {.port = 5002, .addr = "192.0.2.1"};

	zassert_ok(hio_lte_enable(&cfg));
	k_sleep(K_MSEC(50));
	fake_flow_event_cb(HIO_LTE_FSM_EVENT_SIMDETECTED);
	k_sleep(K_MSEC(50));
	zassert_true(fsm_in("attach"));
	send_start(K_SECONDS(120));
	zassert_equal(hio_lte_schedule_ncellmeas(), FIRST_NCELLMEAS_RET);

	fake_flow_event_cb(HIO_LTE_FSM_EVENT_REGISTERED);
	k_sleep(K_MSEC(50));
	zassert_true(fsm_in("send"));
	zassert_equal(atomic_get(&fake_flow_send_count), 1);
	zassert_equal(atomic_get(&fake_flow_ncellmeas_count), 0, "measured first");
	send_done();
	k_sleep(K_MSEC(50));
	zassert_true(fsm_in("ready"));

	fake_flow_event_cb(HIO_LTE_FSM_EVENT_CSCON_0);
	k_sleep(K_MSEC(50));
	zassert_true(fsm_in("ncellmeas"));
	measured();
}

static int m_waiter_ret;

static void waiter_entry(void *p1, void *p2, void *p3)
{
	ARG_UNUSED(p1);
	ARG_UNUSED(p2);
	ARG_UNUSED(p3);

	if (!hio_lte_wait_for_ncellmeas(K_SECONDS(5))) {
		m_waiter_ret = hio_lte_schedule_ncellmeas();
	}
}

/* The done bit comes while the request is still set: a request made at that
 * moment (here by a waiter it releases, which runs before the FSM thread goes
 * on) is served by this result, it never stays pending with the done bit set. */
ZTEST(hio_lte_ncellmeas, test_request_at_result_served_by_it)
{
	measuring_from_ready();
	m_waiter_ret = 1;
	k_thread_create(&m_thread, m_thread_stack, K_THREAD_STACK_SIZEOF(m_thread_stack),
			waiter_entry, NULL, NULL, NULL, K_PRIO_PREEMPT(0), 0, K_NO_WAIT);
	k_sleep(K_MSEC(50));

	urc();
	zassert_ok(k_thread_join(&m_thread, K_SECONDS(1)));
	zassert_equal(m_waiter_ret, -EALREADY);
	zassert_ok(hio_lte_wait_for_ncellmeas(K_NO_WAIT));
	k_sleep(K_SECONDS(1));
	zassert_true(fsm_in("ready"));
	zassert_equal(atomic_get(&fake_flow_ncellmeas_count), 1);
}

/* CONFIG_HIO_LTE_NCELLMEAS: every enable requests one, which waits for the
 * release of the RRC connection. */
ZTEST(hio_lte_ncellmeas, test_enable_requests_one)
{
	Z_TEST_SKIP_IFNDEF(CONFIG_HIO_LTE_NCELLMEAS);

	zassert_ok(hio_lte_wait_for_ncellmeas(K_NO_WAIT));
	fsm_bring_up();
	zassert_equal(hio_lte_wait_for_ncellmeas(K_NO_WAIT), -ETIMEDOUT, "done before it ran");
	k_sleep(K_SECONDS(1));
	zassert_true(fsm_in("ready"));
	zassert_equal(atomic_get(&fake_flow_ncellmeas_count), 0, "measured before the release");

	fake_flow_event_cb(HIO_LTE_FSM_EVENT_CSCON_1);
	fake_flow_event_cb(HIO_LTE_FSM_EVENT_CSCON_0);
	k_sleep(K_MSEC(50));
	zassert_true(fsm_in("ncellmeas"));
	measured();
}

/* CONFIG_HIO_LTE_NCELLMEAS: a request repeated while one ran does not make the
 * one of the next enable urgent. */
ZTEST(hio_lte_ncellmeas, test_repeat_not_left_for_next_enable)
{
	Z_TEST_SKIP_IFNDEF(CONFIG_HIO_LTE_NCELLMEAS);

	measuring_from_ready();
	zassert_equal(hio_lte_schedule_ncellmeas(), -EALREADY);
	k_sleep(K_MSEC(50));
	measured();

	fsm_down();
	fsm_bring_up();
	k_sleep(K_SECONDS(1));
	zassert_true(fsm_in("ready"), "measured before the release");
	zassert_equal(atomic_get(&fake_flow_ncellmeas_count), 1);
}

/* A disable drops a request and releases its waiter; it is not left for the
 * next enable. */
ZTEST(hio_lte_ncellmeas, test_disable_drops_request)
{
	fsm_bring_up();
	fake_flow_event_cb(HIO_LTE_FSM_EVENT_CSCON_1);
	k_sleep(K_MSEC(50));
	zassert_equal(hio_lte_schedule_ncellmeas(), FIRST_NCELLMEAS_RET);
	zassert_equal(hio_lte_wait_for_ncellmeas(K_NO_WAIT), -ETIMEDOUT);

	fsm_down();
	zassert_ok(hio_lte_wait_for_ncellmeas(K_NO_WAIT), "waiter not released");
	zassert_equal(atomic_get(&m_done_count), 0, "reported as measured");

	if (!IS_ENABLED(CONFIG_HIO_LTE_NCELLMEAS)) {
		fsm_bring_up();
		k_sleep(K_SECONDS(1));
		zassert_true(fsm_in("ready"));
		zassert_equal(atomic_get(&fake_flow_ncellmeas_count), 0, "left for the enable");
		zassert_ok(hio_lte_wait_for_ncellmeas(K_NO_WAIT));
	}
}
```

## src/test_no_psm.c
```c
/*
 * Copyright (c) 2026 HARDWARIO a.s.
 *
 * SPDX-License-Identifier: LicenseRef-HARDWARIO-5-Clause
 */

/* Network without PSM: the ready state switches the modem off (CFUN=4) and the
 * modem reports "+CEREG: 0", which must not hide the last registration. */

#include "fsm_helpers.h"
#include "hio_lte_parse.h"
#include "hio_lte_state.h"

#include <hio/hio_lte.h>

#include <zephyr/kernel.h>
#include <zephyr/shell/shell_dummy.h>
#include <zephyr/ztest.h>

extern int fake_flow_last_cfun;
extern void (*fake_flow_cfun_hook)(int cfun);
extern atomic_t fake_flow_scan_plmn_count;

static void set_cereg(enum hio_lte_cereg_param_stat stat)
{
	struct hio_lte_cereg_param param = {
		.valid = true,
		.stat = stat,
		.cid = 0xAE520,
		.act = HIO_LTE_CEREG_PARAM_ACT_NBIOT,
		.active_time = -1,
		.periodic_tau_ext = -1,
	};

	if (stat == HIO_LTE_CEREG_PARAM_STAT_REGISTERED_ROAMING) {
		strcpy(param.tac, "B4DC");
	} else {
		/* As parsed from "+CEREG: <stat>". */
		param.cid = 0;
		param.act = 0;
		param.active_time = GRPS_TIMER_INVALID;
		param.periodic_tau_ext = GRPS_TIMER_INVALID;
	}

	hio_lte_state_set_cereg_param(&param);
}

static const char *shell_cmd(const char *cmd)
{
	const struct shell *sh = shell_backend_dummy_get_ptr();
	size_t size;

	WAIT_FOR(shell_ready(sh), 20000, k_msleep(1));
	shell_backend_dummy_clear_output(sh);
	int ret = shell_execute_cmd(sh, cmd);
	const char *out = shell_backend_dummy_get_output(sh, &size);
	zassert_ok(ret, "%s failed: %d: %s", cmd, ret, out);

	return out;
}

static void cfun4_reports_not_registered(int cfun)
{
	if (cfun == 4) {
		set_cereg(HIO_LTE_CEREG_PARAM_STAT_NOT_REGISTERED);
	}
}

static void fsm_down(void)
{
	g_hio_lte_config.test = false;
	zassert_ok(hio_lte_disable());
	zassert_ok(hio_lte_wait_for_disable(K_SECONDS(2)));
}

static void no_psm_before(void *fixture)
{
	ARG_UNUSED(fixture);

	fsm_down();
	/* The scan has a step per configured RAT. */
	strcpy(g_hio_lte_config.mode, "lte-m,nb-iot");
	fake_flow_last_cfun = -1;
	fake_flow_cfun_hook = cfun4_reports_not_registered;
}

static void no_psm_after(void *fixture)
{
	ARG_UNUSED(fixture);

	fsm_down();
	fake_flow_cfun_hook = NULL;
}

ZTEST_SUITE(hio_lte_no_psm, NULL, NULL, no_psm_before, no_psm_after, NULL);

/* Ready, PSM not granted: wait for the ready timeout to switch the radio off. */
static void radio_off_after_ready(void)
{
	set_cereg(HIO_LTE_CEREG_PARAM_STAT_REGISTERED_ROAMING);
	fsm_bring_up();
	/* The radio stays on for a requested measurement. */
	fsm_boot_ncellmeas();

	for (int i = 0; i < 40 && fake_flow_last_cfun != 4; i++) {
		k_sleep(K_MSEC(50));
	}

	zassert_equal(fake_flow_last_cfun, 4, "no CFUN=4 without PSM");
}

static void assert_cereg_stat(enum hio_lte_cereg_param_stat stat)
{
	struct hio_lte_cereg_param out;

	zassert_ok(hio_lte_get_cereg_param(&out));
	zassert_equal(out.stat, stat, "stat %d", out.stat);
}

ZTEST(hio_lte_no_psm, test_cfun4_keeps_registration_until_attach)
{
	radio_off_after_ready();

	struct hio_lte_cereg_param out;

	zassert_ok(hio_lte_get_cereg_param(&out));
	zassert_equal(out.stat, HIO_LTE_CEREG_PARAM_STAT_REGISTERED_ROAMING);
	zassert_str_equal(out.tac, "B4DC");
	zassert_equal(out.act, HIO_LTE_CEREG_PARAM_ACT_NBIOT);
	zassert_equal(out.active_time, -1);

	const char *text = shell_cmd("lte state");
	zassert_not_null(strstr(text, "cereg: registered-roaming"), "%s", text);
	zassert_not_null(strstr(text, "psm: not granted"), "%s", text);

	/* Wake: CFUN=1 and attach, where a loss of the network counts again. */
	fake_flow_event_cb(HIO_LTE_FSM_EVENT_XMODEMSLEEP);
	k_sleep(K_MSEC(50));
	zassert_true(fsm_in("sleep"));
	fake_flow_event_cb(HIO_LTE_FSM_EVENT_READY);
	k_sleep(K_MSEC(50));
	zassert_equal(fake_flow_last_cfun, 1);
	zassert_true(fsm_in("attach"));

	set_cereg(HIO_LTE_CEREG_PARAM_STAT_SEARCHING);
	assert_cereg_stat(HIO_LTE_CEREG_PARAM_STAT_SEARCHING);

	/* No PSM line without a registration. */
	text = shell_cmd("lte state");
	zassert_not_null(strstr(text, "cereg: searching"), "%s", text);
	zassert_is_null(strstr(text, "psm:"), "%s", text);
}

ZTEST(hio_lte_no_psm, test_state_shows_granted_psm)
{
	struct hio_lte_cereg_param param = {
		.valid = true,
		.stat = HIO_LTE_CEREG_PARAM_STAT_REGISTERED_HOME,
		.act = HIO_LTE_CEREG_PARAM_ACT_LTE,
		.active_time = 0,
		.periodic_tau_ext = 86400,
	};

	hio_lte_state_set_cereg_param(&param);

	const char *text = shell_cmd("lte state");
	zassert_not_null(strstr(text, "psm: active-time 0s, periodic-tau 1d 00h 00m 00s"), "%s",
			 text);
}

ZTEST(hio_lte_no_psm, test_disable_turns_radio_on)
{
	radio_off_after_ready();

	fsm_down();

	set_cereg(HIO_LTE_CEREG_PARAM_STAT_NOT_REGISTERED);
	assert_cereg_stat(HIO_LTE_CEREG_PARAM_STAT_NOT_REGISTERED);
}

ZTEST(hio_lte_no_psm, test_error_turns_radio_on)
{
	radio_off_after_ready();

	fake_flow_event_cb(HIO_LTE_FSM_EVENT_ERROR);
	k_sleep(K_MSEC(50));
	zassert_true(fsm_in("error"));

	set_cereg(HIO_LTE_CEREG_PARAM_STAT_NOT_REGISTERED);
	assert_cereg_stat(HIO_LTE_CEREG_PARAM_STAT_NOT_REGISTERED);
}

ZTEST(hio_lte_no_psm, test_scan_turns_radio_on)
{
	radio_off_after_ready();

	zassert_ok(hio_lte_scan(HIO_LTE_SCAN_PLMN));
	k_sleep(K_MSEC(50));
	zassert_true(fsm_in("scan"));

	set_cereg(HIO_LTE_CEREG_PARAM_STAT_NOT_REGISTERED);
	assert_cereg_stat(HIO_LTE_CEREG_PARAM_STAT_NOT_REGISTERED);
}

/* The modem is in CFUN=4 already, the first switch of the scan brings no
 * "+CEREG: 0": the NB-IoT registration of before must not count for the
 * network search in LTE-M. */
ZTEST(hio_lte_no_psm, test_scan_from_radio_off_waits_for_registration)
{
	radio_off_after_ready();
	atomic_clear(&fake_flow_scan_plmn_count);

	zassert_ok(hio_lte_scan(HIO_LTE_SCAN_ALL));
	/* No CSCON: the cell search starts after the attach window. */
	k_sleep(K_MSEC(10200));
	zassert_true(fsm_in("scan"));
	fake_flow_event_cb(HIO_LTE_FSM_EVENT_NCELLMEAS);
	k_sleep(K_MSEC(50));
	zassert_equal(atomic_get(&fake_flow_scan_plmn_count), 0,
		      "searched on the registration of before");

	fsm_scan_registers();
	k_sleep(K_MSEC(50));
	zassert_equal(atomic_get(&fake_flow_scan_plmn_count), 1, "not searched once registered");
}
```

## src/test_transaction.c
```c
/*
 * Copyright (c) 2026 HARDWARIO a.s.
 *
 * SPDX-License-Identifier: LicenseRef-HARDWARIO-5-Clause
 */

/* Ownership contract of hio_lte_send_recv().
 *
 * The param passed in is the caller's own storage — hio_cloud_transfer builds it
 * as a per-attempt stack local. hio_lte publishes it in m_send_recv_param so the
 * FSM work queue can act on it, which means the handle must not outlive the
 * call: once hio_lte_send_recv() returns, the FSM must no longer hold a pointer
 * into a frame the caller is about to reuse.
 *
 * These tests recreate the field condition by holding the FSM inside
 * hio_lte_flow_send() (fake_flow_send_block_ms) for longer than the caller's
 * deadline, which is what nrf_send() does while it waits for RRC. */

#include <hio/hio_lte.h>

#include <zephyr/kernel.h>
#include <zephyr/ztest.h>

/* Module-internal handle the FSM work queue reads (hio_lte.c). */
extern struct hio_lte_send_recv_param *m_send_recv_param;

extern atomic_t fake_flow_send_count;
extern const struct hio_lte_send_recv_param *fake_flow_last_send_param;
extern uint32_t fake_flow_send_block_ms;

#define UPLINK_LEN 481

/* Comfortably longer than CALLER_DEADLINE_MS, so the caller always gives up
 * first, and long enough that the FSM is still inside the send when it does. */
#define SEND_BLOCK_MS     400
#define CALLER_DEADLINE_MS 100

static uint8_t m_uplink[UPLINK_LEN];

static K_THREAD_STACK_DEFINE(m_holder_stack, 2048);
static struct k_thread m_holder_thread;

static struct hio_lte_send_recv_param m_holder_param;
static int m_holder_ret;

static void reset_fakes(void *fixture)
{
	ARG_UNUSED(fixture);

	/* Let any send left running by the previous test drain, so its
	 * bookkeeping cannot leak into this one. */
	k_sleep(K_MSEC(SEND_BLOCK_MS * 2));

	fake_flow_send_block_ms = 0;
	fake_flow_last_send_param = NULL;
	atomic_clear(&fake_flow_send_count);
}

ZTEST_SUITE(hio_lte_transaction, NULL, NULL, reset_fakes, NULL, NULL);

/* A caller that gives up must take its handle with it. */
ZTEST(hio_lte_transaction, test_timeout_releases_caller_param)
{
	fake_flow_send_block_ms = SEND_BLOCK_MS;

	struct hio_lte_send_recv_param param = {
		.send_buf = m_uplink,
		.send_len = sizeof(m_uplink),
		.timeout = K_MSEC(CALLER_DEADLINE_MS),
	};

	int ret = hio_lte_send_recv(&param);

	zassert_equal(ret, -ETIMEDOUT, "expected the call to end on its own deadline, got %d",
		      ret);
	zassert_is_null(m_send_recv_param,
			"FSM still holds the caller's param after the caller gave up");
}

/* The abandoned frame must never reach the modem. Left published, the handle
 * survives into the FSM's own retry, so a later on_enter_send() transmits from —
 * and validates its result against — whatever now occupies that stack slot. */
ZTEST(hio_lte_transaction, test_abandoned_param_is_never_sent_again)
{
	fake_flow_send_block_ms = SEND_BLOCK_MS;

	struct hio_lte_send_recv_param param = {
		.send_buf = m_uplink,
		.send_len = sizeof(m_uplink),
		.timeout = K_MSEC(CALLER_DEADLINE_MS),
	};

	int ret = hio_lte_send_recv(&param);
	zassert_equal(ret, -ETIMEDOUT, "expected the call to end on its own deadline, got %d",
		      ret);

	int sends_at_giveup = atomic_get(&fake_flow_send_count);

	/* Long enough for the FSM to finish the in-flight send and come back
	 * round through ERROR/READY to another send attempt. */
	k_sleep(K_SECONDS(7));

	zassert_equal(atomic_get(&fake_flow_send_count), sends_at_giveup,
		      "FSM transmitted again after the caller abandoned the transaction");
	zassert_not_equal(fake_flow_last_send_param, &param,
			  "FSM is still using the abandoned caller param");
}

static void holder_entry(void *p1, void *p2, void *p3)
{
	ARG_UNUSED(p1);
	ARG_UNUSED(p2);
	ARG_UNUSED(p3);

	m_holder_ret = hio_lte_send_recv(&m_holder_param);
}

/* Only one transaction can be in flight, because there is only one handle for
 * the FSM to read. A second caller that cannot take the lock must fail instead
 * of overwriting the handle — otherwise the FSM is pointed at this caller's
 * buffers while the first caller is still blocked waiting for its own. */
ZTEST(hio_lte_transaction, test_concurrent_caller_does_not_steal_transaction)
{
	m_holder_param = (struct hio_lte_send_recv_param){
		.send_buf = m_uplink,
		.send_len = sizeof(m_uplink),
		.timeout = K_SECONDS(2),
	};

	k_thread_create(&m_holder_thread, m_holder_stack, K_THREAD_STACK_SIZEOF(m_holder_stack),
			holder_entry, NULL, NULL, NULL, K_PRIO_PREEMPT(0), 0, K_NO_WAIT);

	/* Let the holder publish its param and block on its own deadline. */
	k_sleep(K_MSEC(200));
	zassert_equal_ptr(m_send_recv_param, &m_holder_param,
			  "holder did not publish its transaction");

	struct hio_lte_send_recv_param intruder = {
		.send_buf = m_uplink,
		.send_len = sizeof(m_uplink),
		.timeout = K_MSEC(CALLER_DEADLINE_MS),
	};

	int ret = hio_lte_send_recv(&intruder);

	zassert_equal(ret, -EBUSY, "second caller should be rejected as busy, got %d", ret);
	zassert_equal_ptr(m_send_recv_param, &m_holder_param,
			  "second caller retargeted the in-flight transaction");

	zassert_ok(k_thread_join(&m_holder_thread, K_SECONDS(5)), "holder did not finish");
	zassert_equal(m_holder_ret, -ETIMEDOUT, "holder should end on its own deadline, got %d",
		      m_holder_ret);
}
```
